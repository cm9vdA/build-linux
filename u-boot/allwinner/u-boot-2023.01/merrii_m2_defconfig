## u-boot/allwinner/u-boot-2023.01/merrii_m2_defconfig
```kconfig
CONFIG_ARM=y
CONFIG_ARCH_SUNXI=y
CONFIG_MACH_SUN7I=y
CONFIG_DEFAULT_DEVICE_TREE="sun7i-a20-m2"
CONFIG_DRAM_CLK=432
CONFIG_MMC0_CD_PIN="PH1"
CONFIG_MMC_SUNXI_SLOT_EXTRA=2
CONFIG_AHCI=y
CONFIG_SD_BOOT=y
# CONFIG_SYS_MALLOC_CLEAR_ON_INIT is not set
CONFIG_USE_PREBOOT=y
CONFIG_SPL=y
CONFIG_SPL_I2C=y
CONFIG_CMD_DFU=y
CONFIG_CMD_USB_MASS_STORAGE=y
CONFIG_SCSI_AHCI=y
CONFIG_SYS_64BIT_LBA=y
CONFIG_DFU_RAM=y
CONFIG_FASTBOOT_CMD_OEM_FORMAT=y
CONFIG_SYS_I2C_MVTWSI=y
CONFIG_SYS_I2C_SLAVE=0x7f
CONFIG_SYS_I2C_SPEED=400000
CONFIG_SYS_PROMPT="M2 =>"
CONFIG_PHY_REALTEK=y
CONFIG_ETH_DESIGNWARE=y
CONFIG_MII=y
CONFIG_SUN7I_GMAC=y
CONFIG_SCSI=y
CONFIG_USB_EHCI_HCD=y
CONFIG_USB_OHCI_HCD=y
CONFIG_USB_MUSB_GADGET=y
```

## u-boot/m2/u-boot-2020.10/Merrii_M2_defconfig
```kconfig
CONFIG_ARM=y
CONFIG_ARCH_SUNXI=y
CONFIG_MACH_SUN7I=y
CONFIG_DEFAULT_DEVICE_TREE="sun7i-a20-m2"
CONFIG_DRAM_CLK=432
CONFIG_MMC0_CD_PIN="PH1"
CONFIG_MMC_SUNXI_SLOT_EXTRA=2
CONFIG_SD_BOOT=y

#CONFIG_VIDEO_VGA=y
#CONFIG_VIDEO_COMPOSITE=y

# CONFIG_SYS_MALLOC_CLEAR_ON_INIT is not set
# CONFIG_BOOTM_NETBSD is not set
# CONFIG_BOOTM_PLAN9 is not set
# CONFIG_BOOTM_RTEMS is not set
# CONFIG_BOOTM_VXWORKS is not set
# CONFIG_ANDROID_BOOT_IMAGE is not set
# CONFIG_EFI_PARTITION is not set
# CONFIG_EFI_LOADER is not set
# CONFIG_EFI_LOAD_FILE2_INITRD is not set
# CONFIG_EFI_SECURE_BOOT is not set
# CONFIG_PARTITION_TYPE_GUID is not set
# CONFIG_CMD_GPT is not set

#CONFIG_VIDEO_LCD_MODE="x:1024,y:600,depth:18,pclk_khz:45000,le:150,ri:16,up:21,lo:2,hs:10,vs:2,sync:3,vmode:0"
#CONFIG_VIDEO_LCD_DCLK_PHASE=0
#CONFIG_VIDEO_LCD_POWER="PH8"
#CONFIG_VIDEO_LCD_BL_EN="PH7"
#CONFIG_VIDEO_LCD_BL_PWM="PB02"

CONFIG_USE_PREBOOT=y
CONFIG_SPL=y
CONFIG_SPL_I2C_SUPPORT=y
CONFIG_SPL_SPI_SUNXI=y
CONFIG_SYS_RELOC_GD_ENV_ADDR=y
CONFIG_SUN7I_GMAC=y
CONFIG_PHY_REALTEK=y
CONFIG_ETH_DESIGNWARE=y
CONFIG_MII=y
CONFIG_RGMII=y
CONFIG_USB_EHCI_HCD=y
CONFIG_USB_OHCI_HCD=y
CONFIG_USB_MUSB_GADGET=y
CONFIG_SYS_USB_EVENT_POLL_VIA_INT_QUEUE=y
CONFIG_CMD_USB_MASS_STORAGE=y
CONFIG_CMD_DFU=y
CONFIG_DFU_RAM=y
CONFIG_FASTBOOT_CMD_OEM_FORMAT=y
CONFIG_SCSI=y
CONFIG_AHCI=y
CONFIG_SCSI_AHCI=y
```
