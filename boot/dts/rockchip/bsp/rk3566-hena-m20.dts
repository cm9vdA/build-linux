/dts-v1/;

/ {
	compatible = "rockchip,rk3566-rk817-tablet", "rockchip,rk3566";
	interrupt-parent = <0x01>;
	#address-cells = <0x02>;
	#size-cells = <0x02>;
	model = "Rockchip RK3566 RK817 TABLET LP4X Board";

	ddr_timing {
		compatible = "rockchip,ddr-timing";
		ddr2_speed_bin = <0x00>;
		ddr3_speed_bin = <0x15>;
		ddr4_speed_bin = <0x0c>;
		pd_idle = <0x0d>;
		sr_idle = <0x5d>;
		sr_mc_gate_idle = <0x00>;
		srpd_lite_idle = <0x00>;
		standby_idle = <0x00>;
		auto_pd_dis_freq = <0x42a>;
		auto_sr_dis_freq = <0x320>;
		ddr2_dll_dis_freq = <0x12c>;
		ddr3_dll_dis_freq = <0x12c>;
		ddr4_dll_dis_freq = <0x271>;
		phy_dll_dis_freq = <0x190>;
		ddr2_odt_dis_freq = <0x64>;
		phy_ddr2_odt_dis_freq = <0x64>;
		ddr2_drv = <0x02>;
		ddr2_odt = <0x40>;
		phy_ddr2_ca_drv = <0x00>;
		phy_ddr2_ck_drv = <0x00>;
		phy_ddr2_dq_drv = <0x00>;
		phy_ddr2_odt = <0x00>;
		ddr3_odt_dis_freq = <0x14d>;
		phy_ddr3_odt_dis_freq = <0x14d>;
		ddr3_drv = <0x02>;
		ddr3_odt = <0x40>;
		phy_ddr3_ca_drv = <0x00>;
		phy_ddr3_ck_drv = <0x00>;
		phy_ddr3_dq_drv = <0x00>;
		phy_ddr3_odt = <0x00>;
		phy_lpddr2_odt_dis_freq = <0x14d>;
		lpddr2_drv = <0x02>;
		phy_lpddr2_ca_drv = <0x00>;
		phy_lpddr2_ck_drv = <0x00>;
		phy_lpddr2_dq_drv = <0x00>;
		phy_lpddr2_odt = <0x00>;
		lpddr3_odt_dis_freq = <0x14d>;
		phy_lpddr3_odt_dis_freq = <0x14d>;
		lpddr3_drv = <0x01>;
		lpddr3_odt = <0x02>;
		phy_lpddr3_ca_drv = <0x00>;
		phy_lpddr3_ck_drv = <0x00>;
		phy_lpddr3_dq_drv = <0x00>;
		phy_lpddr3_odt = <0x00>;
		lpddr4_odt_dis_freq = <0x14d>;
		phy_lpddr4_odt_dis_freq = <0x14d>;
		lpddr4_drv = <0x30>;
		lpddr4_dq_odt = <0x01>;
		lpddr4_ca_odt = <0x00>;
		phy_lpddr4_ca_drv = <0x00>;
		phy_lpddr4_ck_cs_drv = <0x00>;
		phy_lpddr4_dq_drv = <0x00>;
		phy_lpddr4_odt = <0x00>;
		ddr4_odt_dis_freq = <0x271>;
		phy_ddr4_odt_dis_freq = <0x271>;
		ddr4_drv = <0x00>;
		ddr4_odt = <0x200>;
		phy_ddr4_ca_drv = <0x00>;
		phy_ddr4_ck_drv = <0x00>;
		phy_ddr4_dq_drv = <0x00>;
		phy_ddr4_odt = <0x00>;
		phandle = <0x98>;
	};

	aliases {
		csi2dphy0 = "/csi2-dphy0";
		csi2dphy1 = "/csi2-dphy1";
		csi2dphy2 = "/csi2-dphy2";
		dsi0 = "/dsi@fe060000";
		dsi1 = "/dsi@fe070000";
		ethernet1 = "/ethernet@fe010000";
		gpio0 = "/pinctrl/gpio@fdd60000";
		gpio1 = "/pinctrl/gpio@fe740000";
		gpio2 = "/pinctrl/gpio@fe750000";
		gpio3 = "/pinctrl/gpio@fe760000";
		gpio4 = "/pinctrl/gpio@fe770000";
		i2c0 = "/i2c@fdd40000";
		i2c1 = "/i2c@fe5a0000";
		i2c2 = "/i2c@fe5b0000";
		i2c3 = "/i2c@fe5c0000";
		i2c4 = "/i2c@fe5d0000";
		i2c5 = "/i2c@fe5e0000";
		mmc0 = "/dwmmc@fe2b0000";
		mmc1 = "/dwmmc@fe2c0000";
		mmc2 = "/sdhci@fe310000";
		mmc3 = "/dwmmc@fe000000";
		serial0 = "/serial@fdd50000";
		serial1 = "/serial@fe650000";
		serial2 = "/serial@fe660000";
		serial3 = "/serial@fe670000";
		serial4 = "/serial@fe680000";
		serial5 = "/serial@fe690000";
		serial6 = "/serial@fe6a0000";
		serial7 = "/serial@fe6b0000";
		serial8 = "/serial@fe6c0000";
		serial9 = "/serial@fe6d0000";
		spi0 = "/spi@fe610000";
		spi1 = "/spi@fe620000";
		spi2 = "/spi@fe630000";
		spi3 = "/spi@fe640000";
	};

	cpus {
		#address-cells = <0x02>;
		#size-cells = <0x00>;

		cpu@0 {
			device_type = "cpu";
			compatible = "arm,cortex-a55";
			reg = <0x00 0x00>;
			enable-method = "psci";
			clocks = <0x02 0x00>;
			operating-points-v2 = <0x03>;
			cpu-idle-states = <0x04>;
			#cooling-cells = <0x02>;
			dynamic-power-coefficient = <0xbb>;
			reg-name = "vdd_cpu";
			phandle = <0x08>;

			power-model {
				compatible = "simple-power-model";
				leakage-range = <0x0a 0x28>;
				ls = <0xffffdc14 0x18d8 0x00>;
				static-coefficient = <0x186a0>;
				ts = <0x1476e 0x3263d 0xffffef34 0x47>;
				thermal-zone = "soc-thermal";
			};
		};

		cpu@100 {
			device_type = "cpu";
			compatible = "arm,cortex-a55";
			reg = <0x00 0x100>;
			enable-method = "psci";
			clocks = <0x02 0x00>;
			operating-points-v2 = <0x03>;
			cpu-idle-states = <0x04>;
			phandle = <0x09>;
		};

		cpu@200 {
			device_type = "cpu";
			compatible = "arm,cortex-a55";
			reg = <0x00 0x200>;
			enable-method = "psci";
			clocks = <0x02 0x00>;
			operating-points-v2 = <0x03>;
			cpu-idle-states = <0x04>;
			phandle = <0x0a>;
		};

		cpu@300 {
			device_type = "cpu";
			compatible = "arm,cortex-a55";
			reg = <0x00 0x300>;
			enable-method = "psci";
			clocks = <0x02 0x00>;
			operating-points-v2 = <0x03>;
			cpu-idle-states = <0x04>;
			phandle = <0x0b>;
		};

		idle-states {
			entry-method = "psci";

			cpu-sleep {
				compatible = "arm,idle-state";
				local-timer-stop;
				arm,psci-suspend-param = <0x10000>;
				entry-latency-us = <0x64>;
				exit-latency-us = <0x78>;
				min-residency-us = <0x3e8>;
				phandle = <0x04>;
			};
		};
	};

	cpu0-opp-table {
		compatible = "operating-points-v2";
		opp-shared;
		mbist-vmin = <0xc96a8 0xdbba0 0xe7ef0>;
		nvmem-cells = <0x05 0x06 0x07>;
		nvmem-cell-names = "leakage", "pvtm", "mbist-vmin";
		rockchip,pvtm-voltage-sel = <0x00 0x14050 0x00 0x14051 0x16b48 0x01 0x16b49 0x186a0 0x02>;
		rockchip,pvtm-freq = <0x639c0>;
		rockchip,pvtm-volt = <0xdbba0>;
		rockchip,pvtm-ch = <0x00 0x05>;
		rockchip,pvtm-sample-time = <0x3e8>;
		rockchip,pvtm-number = <0x0a>;
		rockchip,pvtm-error = <0x3e8>;
		rockchip,pvtm-ref-temp = <0x28>;
		rockchip,pvtm-temp-prop = <0x1a 0x1a>;
		rockchip,thermal-zone = "soc-thermal";
		rockchip,temp-hysteresis = <0x1388>;
		rockchip,low-temp = <0x00>;
		rockchip,low-temp-adjust-volt = <0x00 0x648 0x124f8>;
		phandle = <0x03>;

		opp-408000000 {
			opp-hz = <0x00 0x18519600>;
			opp-microvolt = <0xc96a8 0xc96a8 0x118c30>;
			clock-latency-ns = <0x9c40>;
		};

		opp-600000000 {
			opp-hz = <0x00 0x23c34600>;
			opp-microvolt = <0xc96a8 0xc96a8 0x118c30>;
			clock-latency-ns = <0x9c40>;
		};

		opp-816000000 {
			opp-hz = <0x00 0x30a32c00>;
			opp-microvolt = <0xc96a8 0xc96a8 0x118c30>;
			clock-latency-ns = <0x9c40>;
			opp-suspend;
		};

		opp-1104000000 {
			opp-hz = <0x00 0x41cdb400>;
			opp-microvolt = <0xdbba0 0xdbba0 0x118c30>;
			clock-latency-ns = <0x9c40>;
		};

		opp-1416000000 {
			opp-hz = <0x00 0x54667200>;
			opp-microvolt = <0xf4240 0xf4240 0x118c30>;
			clock-latency-ns = <0x9c40>;
		};

		opp-1608000000 {
			opp-hz = <0x00 0x5fd82200>;
			opp-microvolt = <0x106738 0x106738 0x118c30>;
			clock-latency-ns = <0x9c40>;
		};

		opp-1800000000 {
			opp-hz = <0x00 0x6b49d200>;
			opp-microvolt = <0x112a88 0x112a88 0x118c30>;
			clock-latency-ns = <0x9c40>;
		};
	};

	arm-pmu {
		compatible = "arm,cortex-a55-pmu", "arm,armv8-pmuv3";
		interrupts = <0x00 0xe4 0x04 0x00 0xe5 0x04 0x00 0xe6 0x04 0x00 0xe7 0x04>;
		interrupt-affinity = <0x08 0x09 0x0a 0x0b>;
	};

	cpuinfo {
		compatible = "rockchip,cpuinfo";
		nvmem-cells = <0x0c 0x0d 0x0e>;
		nvmem-cell-names = "id", "cpu-version", "cpu-code";
	};

	display-subsystem {
		compatible = "rockchip,display-subsystem";
		memory-region = <0x0f 0x10>;
		memory-region-names = "drm-logo", "drm-cubic-lut";
		ports = <0x11>;
		devfreq = <0x12>;
		phandle = <0x12f>;

		route {

			route-dsi0 {
				status = "okay";
				logo,uboot = "logo.bmp";
				logo,kernel = "logo_kernel.bmp";
				logo,mode = "center";
				charge_logo,mode = "center";
				connect = <0x13>;
				phandle = <0x130>;
			};

			route-dsi1 {
				status = "disabled";
				logo,uboot = "logo.bmp";
				logo,kernel = "logo_kernel.bmp";
				logo,mode = "center";
				charge_logo,mode = "center";
				connect = <0x14>;
				phandle = <0x131>;
			};

			route-edp {
				status = "disabled";
				logo,uboot = "logo.bmp";
				logo,kernel = "logo_kernel.bmp";
				logo,mode = "center";
				charge_logo,mode = "center";
				connect = <0x15>;
				phandle = <0x132>;
			};

			route-hdmi {
				status = "okay";
				logo,uboot = "logo.bmp";
				logo,kernel = "logo_kernel.bmp";
				logo,mode = "center";
				charge_logo,mode = "center";
				connect = <0x16>;
				phandle = <0x133>;
			};

			route-lvds {
				status = "disabled";
				logo,uboot = "logo.bmp";
				logo,kernel = "logo_kernel.bmp";
				logo,mode = "center";
				charge_logo,mode = "center";
				connect = <0x17>;
				phandle = <0x134>;
			};

			route-rgb {
				status = "disabled";
				logo,uboot = "logo.bmp";
				logo,kernel = "logo_kernel.bmp";
				logo,mode = "center";
				charge_logo,mode = "center";
				connect = <0x18>;
				phandle = <0x135>;
			};
		};
	};

	firmware {

		optee {
			compatible = "linaro,optee-tz";
			method = "smc";
			phandle = <0x136>;
		};

		scmi {
			compatible = "arm,scmi-smc";
			shmem = <0x19>;
			arm,smc-id = <0x82000010>;
			#address-cells = <0x01>;
			#size-cells = <0x00>;
			phandle = <0x137>;

			protocol@14 {
				reg = <0x14>;
				#clock-cells = <0x01>;
				rockchip,clk-init = "Tfr";
				phandle = <0x02>;
			};
		};

		sdei {
			compatible = "arm,sdei-1.0";
			method = "smc";
			phandle = <0x138>;
		};
	};

	mpp-srv {
		compatible = "rockchip,mpp-service";
		rockchip,taskqueue-count = <0x06>;
		rockchip,resetgroup-count = <0x06>;
		status = "okay";
		phandle = <0x65>;
	};

	psci {
		compatible = "arm,psci-1.0";
		method = "smc";
	};

	reserved-memory {
		#address-cells = <0x02>;
		#size-cells = <0x02>;
		ranges;
		phandle = <0x139>;

		drm-logo@00000000 {
			compatible = "rockchip,drm-logo";
			reg = <0x00 0x00 0x00 0x00>;
			phandle = <0x0f>;
		};

		drm-cubic-lut@00000000 {
			compatible = "rockchip,drm-cubic-lut";
			reg = <0x00 0x00 0x00 0x00>;
			phandle = <0x10>;
		};

		linux,cma {
			compatible = "shared-dma-pool";
			inactive;
			reusable;
			reg = <0x00 0x10000000 0x00 0x800000>;
			linux,cma-default;
		};

		ramoops@110000 {
			compatible = "ramoops";
			reg = <0x00 0x110000 0x00 0xf0000>;
			record-size = <0x20000>;
			console-size = <0x80000>;
			ftrace-size = <0x00>;
			pmsg-size = <0x50000>;
			phandle = <0x13a>;
		};
	};

	rockchip-suspend {
		compatible = "rockchip,pm-rk3568";
		status = "okay";
		rockchip,sleep-debug-en = <0x01>;
		rockchip,sleep-mode-config = <0x5ec>;
		rockchip,wakeup-config = <0x10>;
		phandle = <0x13b>;
	};

	rockchip-system-monitor {
		compatible = "rockchip,system-monitor";
		rockchip,thermal-zone = "soc-thermal";
		phandle = <0x13c>;
	};

	thermal-zones {
		phandle = <0x13d>;

		soc-thermal {
			polling-delay-passive = <0x14>;
			polling-delay = <0x3e8>;
			sustainable-power = <0x5c3>;
			thermal-sensors = <0x1a 0x00>;
			phandle = <0x13e>;

			trips {

				trip-point-0 {
					temperature = <0x11170>;
					hysteresis = <0x7d0>;
					type = "passive";
					phandle = <0x13f>;
				};

				trip-point-1 {
					temperature = <0x14c08>;
					hysteresis = <0x7d0>;
					type = "passive";
					phandle = <0x1b>;
				};

				soc-crit {
					temperature = <0x1c138>;
					hysteresis = <0x7d0>;
					type = "critical";
					phandle = <0x140>;
				};
			};

			cooling-maps {

				map0 {
					trip = <0x1b>;
					cooling-device = <0x08 0xffffffff 0xffffffff>;
					contribution = <0x400>;
				};

				map1 {
					trip = <0x1b>;
					cooling-device = <0x1c 0xffffffff 0xffffffff>;
					contribution = <0x400>;
				};
			};
		};

		gpu-thermal {
			polling-delay-passive = <0x14>;
			polling-delay = <0x3e8>;
			thermal-sensors = <0x1a 0x01>;
			phandle = <0x141>;
		};
	};

	timer {
		compatible = "arm,armv8-timer";
		interrupts = <0x01 0x0d 0xf04 0x01 0x0e 0xf04 0x01 0x0b 0xf04 0x01 0x0a 0xf04>;
		arm,no-tick-in-suspend;
	};

	external-gmac1-clock {
		compatible = "fixed-clock";
		clock-frequency = <0x7735940>;
		clock-output-names = "gmac1_clkin";
		#clock-cells = <0x00>;
		phandle = <0x142>;
	};

	xpcs-gmac1-clock {
		compatible = "fixed-clock";
		clock-frequency = <0x7735940>;
		clock-output-names = "clk_gmac1_xpcs_mii";
		#clock-cells = <0x00>;
		phandle = <0x143>;
	};

	i2s1-mclkin-rx {
		compatible = "fixed-clock";
		#clock-cells = <0x00>;
		clock-frequency = <0xbb8000>;
		clock-output-names = "i2s1_mclkin_rx";
		phandle = <0x144>;
	};

	i2s1-mclkin-tx {
		compatible = "fixed-clock";
		#clock-cells = <0x00>;
		clock-frequency = <0xbb8000>;
		clock-output-names = "i2s1_mclkin_tx";
		phandle = <0x145>;
	};

	i2s2-mclkin {
		compatible = "fixed-clock";
		#clock-cells = <0x00>;
		clock-frequency = <0xbb8000>;
		clock-output-names = "i2s2_mclkin";
		phandle = <0x146>;
	};

	i2s3-mclkin {
		compatible = "fixed-clock";
		#clock-cells = <0x00>;
		clock-frequency = <0xbb8000>;
		clock-output-names = "i2s3_mclkin";
		phandle = <0x147>;
	};

	mpll {
		compatible = "fixed-clock";
		#clock-cells = <0x00>;
		clock-frequency = <0x2faf0800>;
		clock-output-names = "mpll";
		phandle = <0x148>;
	};

	xin24m {
		compatible = "fixed-clock";
		#clock-cells = <0x00>;
		clock-frequency = <0x16e3600>;
		clock-output-names = "xin24m";
		phandle = <0x149>;
	};

	scmi-shmem@10f000 {
		compatible = "arm,scmi-shmem";
		reg = <0x00 0x10f000 0x00 0x100>;
		phandle = <0x19>;
	};

	sata@fc400000 {
		compatible = "snps,dwc-ahci";
		reg = <0x00 0xfc400000 0x00 0x1000>;
		clocks = <0x1d 0x9b 0x1d 0x9c 0x1d 0x9d>;
		clock-names = "sata", "pmalive", "rxoob";
		interrupts = <0x00 0x5f 0x04>;
		interrupt-names = "hostc";
		phys = <0x1e 0x01>;
		phy-names = "sata-phy";
		ports-implemented = <0x01>;
		power-domains = <0x1f 0x0f>;
		status = "disabled";
		phandle = <0x14a>;
	};

	sata@fc800000 {
		compatible = "snps,dwc-ahci";
		reg = <0x00 0xfc800000 0x00 0x1000>;
		clocks = <0x1d 0xa0 0x1d 0xa1 0x1d 0xa2>;
		clock-names = "sata", "pmalive", "rxoob";
		interrupts = <0x00 0x60 0x04>;
		interrupt-names = "hostc";
		phys = <0x20 0x01>;
		phy-names = "sata-phy";
		ports-implemented = <0x01>;
		power-domains = <0x1f 0x0f>;
		status = "disabled";
		phandle = <0x14b>;
	};

	usbdrd {
		compatible = "rockchip,rk3568-dwc3", "rockchip,rk3399-dwc3";
		clocks = <0x1d 0xa6 0x1d 0xa7 0x1d 0xa5 0x1d 0x7f>;
		clock-names = "ref_clk", "suspend_clk", "bus_clk", "pipe_clk";
		#address-cells = <0x02>;
		#size-cells = <0x02>;
		ranges;
		status = "okay";
		phandle = <0x14c>;

		dwc3@fcc00000 {
			compatible = "snps,dwc3";
			reg = <0x00 0xfcc00000 0x00 0x400000>;
			interrupts = <0x00 0xa9 0x04>;
			dr_mode = "otg";
			phys = <0x21>;
			phy-names = "usb2-phy";
			phy_type = "utmi_wide";
			power-domains = <0x1f 0x0f>;
			resets = <0x1d 0x94>;
			reset-names = "usb3-otg";
			snps,dis_enblslpm_quirk;
			snps,dis-u2-freeclk-exists-quirk;
			snps,dis-del-phy-power-chg-quirk;
			snps,dis-tx-ipgap-linecheck-quirk;
			snps,xhci-trb-ent-quirk;
			status = "okay";
			extcon = <0x22>;
			maximum-speed = "high-speed";
			snps,dis_u2_susphy_quirk;
			phandle = <0x14d>;
		};
	};

	usbhost {
		compatible = "rockchip,rk3568-dwc3", "rockchip,rk3399-dwc3";
		clocks = <0x1d 0xa9 0x1d 0xaa 0x1d 0xa8 0x1d 0x7f>;
		clock-names = "ref_clk", "suspend_clk", "bus_clk", "pipe_clk";
		#address-cells = <0x02>;
		#size-cells = <0x02>;
		ranges;
		status = "disabled";
		phandle = <0x14e>;

		dwc3@fd000000 {
			compatible = "snps,dwc3";
			reg = <0x00 0xfd000000 0x00 0x400000>;
			interrupts = <0x00 0xaa 0x04>;
			dr_mode = "host";
			phys = <0x23 0x1e 0x04>;
			phy-names = "usb2-phy", "usb3-phy";
			phy_type = "utmi_wide";
			power-domains = <0x1f 0x0f>;
			resets = <0x1d 0x95>;
			reset-names = "usb3-host";
			snps,dis_enblslpm_quirk;
			snps,dis-u2-freeclk-exists-quirk;
			snps,dis-del-phy-power-chg-quirk;
			snps,dis-tx-ipgap-linecheck-quirk;
			snps,xhci-trb-ent-quirk;
			status = "disabled";
			phandle = <0x14f>;
		};
	};

	interrupt-controller@fd400000 {
		compatible = "arm,gic-v3";
		#interrupt-cells = <0x03>;
		#address-cells = <0x02>;
		#size-cells = <0x02>;
		ranges;
		interrupt-controller;
		reg = <0x00 0xfd400000 0x00 0x10000 0x00 0xfd460000 0x00 0xc0000>;
		interrupts = <0x01 0x09 0x04>;
		phandle = <0x01>;

		interrupt-controller@fd440000 {
			compatible = "arm,gic-v3-its";
			msi-controller;
			#msi-cells = <0x01>;
			reg = <0x00 0xfd440000 0x00 0x20000>;
			phandle = <0x9c>;
		};
	};

	usb@fd800000 {
		compatible = "generic-ehci";
		reg = <0x00 0xfd800000 0x00 0x40000>;
		interrupts = <0x00 0x82 0x04>;
		clocks = <0x1d 0xbd 0x1d 0xbe 0x1d 0xbc 0x24>;
		clock-names = "usbhost", "arbiter", "pclk", "utmi";
		phys = <0x25>;
		phy-names = "usb2-phy";
		status = "disabled";
		phandle = <0x150>;
	};

	usb@fd840000 {
		compatible = "generic-ohci";
		reg = <0x00 0xfd840000 0x00 0x40000>;
		interrupts = <0x00 0x83 0x04>;
		clocks = <0x1d 0xbd 0x1d 0xbe 0x1d 0xbc 0x24>;
		clock-names = "usbhost", "arbiter", "pclk", "utmi";
		phys = <0x25>;
		phy-names = "usb2-phy";
		status = "disabled";
		phandle = <0x151>;
	};

	usb@fd880000 {
		compatible = "generic-ehci";
		reg = <0x00 0xfd880000 0x00 0x40000>;
		interrupts = <0x00 0x85 0x04>;
		clocks = <0x1d 0xbf 0x1d 0xc0 0x1d 0xbc 0x24>;
		clock-names = "usbhost", "arbiter", "pclk", "utmi";
		phys = <0x26>;
		phy-names = "usb2-phy";
		status = "disabled";
		phandle = <0x152>;
	};

	usb@fd8c0000 {
		compatible = "generic-ohci";
		reg = <0x00 0xfd8c0000 0x00 0x40000>;
		interrupts = <0x00 0x86 0x04>;
		clocks = <0x1d 0xbf 0x1d 0xc0 0x1d 0xbc 0x24>;
		clock-names = "usbhost", "arbiter", "pclk", "utmi";
		phys = <0x26>;
		phy-names = "usb2-phy";
		status = "disabled";
		phandle = <0x153>;
	};

	syscon@fda00000 {
		compatible = "rockchip,rk3568-xpcs", "syscon";
		reg = <0x00 0xfda00000 0x00 0x200000>;
		status = "disabled";
		phandle = <0x154>;
	};

	syscon@fdc20000 {
		compatible = "rockchip,rk3568-pmugrf", "syscon", "simple-mfd";
		reg = <0x00 0xfdc20000 0x00 0x10000>;
		phandle = <0x32>;

		io-domains {
			compatible = "rockchip,rk3568-pmu-io-voltage-domain";
			status = "okay";
			pmuio1-supply = <0x27>;
			pmuio2-supply = <0x28>;
			vccio1-supply = <0x29>;
			vccio3-supply = <0x2a>;
			vccio4-supply = <0x28>;
			vccio5-supply = <0x2b>;
			vccio6-supply = <0x2c>;
			vccio7-supply = <0x2b>;
			phandle = <0x155>;
		};

		reboot-mode {
			compatible = "syscon-reboot-mode";
			offset = <0x200>;
			mode-bootloader = <0x5242c301>;
			mode-charge = <0x5242c30b>;
			mode-fastboot = <0x5242c309>;
			mode-loader = <0x5242c301>;
			mode-normal = <0x5242c300>;
			mode-recovery = <0x5242c303>;
			mode-ums = <0x5242c30c>;
			mode-panic = <0x5242c307>;
			mode-watchdog = <0x5242c308>;
			phandle = <0x156>;
		};
	};

	syscon@fdc50000 {
		compatible = "rockchip,rk3568-pipegrf", "syscon";
		reg = <0x00 0xfdc50000 0x00 0x1000>;
		phandle = <0xfb>;
	};

	syscon@fdc60000 {
		compatible = "rockchip,rk3568-grf", "syscon", "simple-mfd";
		reg = <0x00 0xfdc60000 0x00 0x10000>;
		phandle = <0x31>;

		io-domains {
			compatible = "rockchip,rk3568-io-voltage-domain";
			status = "disabled";
			phandle = <0x157>;
		};

		lvds {
			compatible = "rockchip,rk3568-lvds";
			phys = <0x2d>;
			phy-names = "phy";
			status = "disabled";
			phandle = <0x158>;

			ports {
				#address-cells = <0x01>;
				#size-cells = <0x00>;

				port@0 {
					reg = <0x00>;
					#address-cells = <0x01>;
					#size-cells = <0x00>;

					endpoint@1 {
						reg = <0x01>;
						remote-endpoint = <0x17>;
						status = "disabled";
						phandle = <0x84>;
					};

					endpoint@2 {
						reg = <0x02>;
						remote-endpoint = <0x2e>;
						status = "disabled";
						phandle = <0x85>;
					};
				};
			};
		};

		rgb {
			compatible = "rockchip,rk3568-rgb";
			pinctrl-names = "default";
			pinctrl-0 = <0x2f>;
			status = "disabled";
			phandle = <0x159>;

			ports {
				#address-cells = <0x01>;
				#size-cells = <0x00>;

				port@0 {
					reg = <0x00>;
					#address-cells = <0x01>;
					#size-cells = <0x00>;

					endpoint@2 {
						reg = <0x02>;
						remote-endpoint = <0x18>;
						status = "disabled";
						phandle = <0x86>;
					};
				};
			};
		};
	};

	syscon@fdc70000 {
		compatible = "rockchip,pipe-phy-grf", "syscon";
		reg = <0x00 0xfdc70000 0x00 0x1000>;
		phandle = <0x15a>;
	};

	syscon@fdc80000 {
		compatible = "rockchip,pipe-phy-grf", "syscon";
		reg = <0x00 0xfdc80000 0x00 0x1000>;
		phandle = <0xfc>;
	};

	syscon@fdc90000 {
		compatible = "rockchip,pipe-phy-grf", "syscon";
		reg = <0x00 0xfdc90000 0x00 0x1000>;
		phandle = <0xfd>;
	};

	syscon@fdca0000 {
		compatible = "rockchip,rk3568-usb2phy-grf", "syscon";
		reg = <0x00 0xfdca0000 0x00 0x8000>;
		phandle = <0x10e>;
	};

	syscon@fdca8000 {
		compatible = "rockchip,rk3568-usb2phy-grf", "syscon";
		reg = <0x00 0xfdca8000 0x00 0x8000>;
		phandle = <0x10f>;
	};

	edp-phy@fdcb0000 {
		compatible = "rockchip,rk3568-edp-phy";
		reg = <0x00 0xfdcb0000 0x00 0x8000>;
		clocks = <0x30 0x29 0x1d 0x192>;
		clock-names = "refclk", "pclk";
		resets = <0x1d 0x1d6>;
		reset-names = "apb";
		#phy-cells = <0x00>;
		status = "disabled";
		phandle = <0x94>;
	};

	sram@fdcc0000 {
		compatible = "mmio-sram";
		reg = <0x00 0xfdcc0000 0x00 0xb000>;
		#address-cells = <0x01>;
		#size-cells = <0x01>;
		ranges = <0x00 0x00 0xfdcc0000 0xb000>;
		phandle = <0x15b>;

		rkvdec-sram@0 {
			reg = <0x00 0xb000>;
			phandle = <0x6d>;
		};
	};

	clock-controller@fdd00000 {
		compatible = "rockchip,rk3568-pmucru";
		reg = <0x00 0xfdd00000 0x00 0x1000>;
		rockchip,grf = <0x31>;
		rockchip,pmugrf = <0x32>;
		#clock-cells = <0x01>;
		#reset-cells = <0x01>;
		assigned-clocks = <0x30 0x32>;
		assigned-clock-parents = <0x30 0x05>;
		phandle = <0x30>;
	};

	clock-controller@fdd20000 {
		compatible = "rockchip,rk3568-cru";
		reg = <0x00 0xfdd20000 0x00 0x1000>;
		rockchip,grf = <0x31>;
		#clock-cells = <0x01>;
		#reset-cells = <0x01>;
		assigned-clocks = <0x30 0x05 0x1d 0x106 0x1d 0x10b 0x30 0x01 0x30 0x2b 0x1d 0x03 0x1d 0x19b 0x1d 0x09 0x1d 0x19c 0x1d 0x19d 0x1d 0x1a1 0x1d 0x19e 0x1d 0x19f 0x1d 0x1a0 0x1d 0x04 0x1d 0x10d 0x1d 0x10e 0x1d 0x173 0x1d 0x174 0x1d 0x175 0x1d 0x176 0x1d 0xc9 0x1d 0xca 0x1d 0x06 0x1d 0x7e 0x1d 0x7f 0x1d 0x3d 0x1d 0x41 0x1d 0x45 0x1d 0x49 0x1d 0x4d 0x1d 0x4d 0x1d 0x55 0x1d 0x51 0x1d 0x5d 0x1d 0xdd>;
		assigned-clock-rates = <0x8000 0x11e1a300 0x11e1a300 0xbebc200 0x5f5e100 0x3b9aca00 0x1dcd6500 0x13d92d40 0xee6b280 0x7735940 0x5f5e100 0x3b9aca0 0x2faf080 0x17d7840 0x46cf7100 0x8f0d180 0x5f5e100 0x1dcd6500 0x17d78400 0x8f0d180 0x5f5e100 0x11e1a300 0x8f0d180 0x47868c00 0x17d78400 0x5f5e100 0x46cf7100 0x46cf7100 0x46cf7100 0x46cf7100 0x46cf7100 0x46cf7100 0x46cf7100 0x46cf7100 0x46cf7100 0x1dcd6500>;
		assigned-clock-parents = <0x30 0x08 0x1d 0x04 0x1d 0x04>;
		phandle = <0x1d>;
	};

	i2c@fdd40000 {
		compatible = "rockchip,rk3399-i2c";
		reg = <0x00 0xfdd40000 0x00 0x1000>;
		clocks = <0x30 0x07 0x30 0x2d>;
		clock-names = "i2c", "pclk";
		interrupts = <0x00 0x2e 0x04>;
		pinctrl-names = "default";
		pinctrl-0 = <0x33>;
		#address-cells = <0x01>;
		#size-cells = <0x00>;
		status = "okay";
		phandle = <0x15c>;

		tcs4525@1c {
			compatible = "tcs,tcs452x";
			reg = <0x1c>;
			vin-supply = <0x34>;
			regulator-compatible = "fan53555-reg";
			regulator-name = "vdd_cpu";
			regulator-min-microvolt = <0xadf34>;
			regulator-max-microvolt = <0x1535b0>;
			regulator-ramp-delay = <0x8fc>;
			fcs,suspend-voltage-selector = <0x01>;
			regulator-boot-on;
			regulator-always-on;
			phandle = <0x15d>;

			regulator-state-mem {
				regulator-off-in-suspend;
			};
		};

		tcs4526@10 {
			compatible = "tcs,tcs452x";
			reg = <0x10>;
			vin-supply = <0x34>;
			regulator-compatible = "fan53555-reg";
			regulator-name = "vdd_cpu";
			regulator-min-microvolt = <0xadf34>;
			regulator-max-microvolt = <0x1535b0>;
			regulator-ramp-delay = <0x8fc>;
			fcs,suspend-voltage-selector = <0x01>;
			regulator-boot-on;
			regulator-always-on;
			phandle = <0x15e>;

			regulator-state-mem {
				regulator-off-in-suspend;
			};
		};

		xz3215@60 {
			compatible = "xz3216";
			reg = <0x60>;
			phandle = <0x15f>;

			regulators {
				#address-cells = <0x01>;
				#size-cells = <0x00>;

				regulator@0 {
					reg = <0x00>;
					vin-supply = <0x34>;
					regulator-compatible = "xz_dcdc1";
					regulator-name = "vdd_cpu";
					regulator-min-microvolt = <0x93378>;
					regulator-max-microvolt = <0x155cc0>;
					regulator-ramp-delay = <0x3e8>;
					regulator-always-on;
					regulator-boot-on;
					fcs,suspend-voltage-selector = <0x01>;
					regulator-initial-state = <0x03>;
					phandle = <0x160>;

					regulator-state-mem {
						regulator-off-in-suspend;
					};
				};
			};
		};

		syr837@40 {
			compatible = "silergy,syr827";
			reg = <0x40>;
			vin-supply = <0x34>;
			regulator-compatible = "fan53555-reg";
			regulator-name = "vdd_cpu";
			regulator-min-microvolt = <0xadf34>;
			regulator-max-microvolt = <0x16e360>;
			regulator-ramp-delay = <0x3e8>;
			fcs,suspend-voltage-selector = <0x01>;
			regulator-always-on;
			regulator-initial-state = <0x03>;
			phandle = <0x161>;

			regulator-state-mem {
				regulator-off-in-suspend;
			};
		};

		pmic@20 {
			compatible = "rockchip,rk817";
			reg = <0x20>;
			interrupt-parent = <0x35>;
			interrupts = <0x03 0x08>;
			pinctrl-names = "default", "pmic-sleep", "pmic-power-off", "pmic-reset";
			pinctrl-0 = <0x36>;
			pinctrl-1 = <0x37 0x38>;
			pinctrl-2 = <0x39 0x3a>;
			pinctrl-3 = <0x39 0x3b>;
			rockchip,system-power-controller;
			wakeup-source;
			#clock-cells = <0x01>;
			clock-output-names = "rk808-clkout1", "rk808-clkout2";
			pmic-reset-func = <0x00>;
			not-save-power-en = <0x01>;
			vcc1-supply = <0x34>;
			vcc2-supply = <0x34>;
			vcc3-supply = <0x34>;
			vcc4-supply = <0x34>;
			vcc5-supply = <0x34>;
			vcc6-supply = <0x34>;
			vcc7-supply = <0x34>;
			vcc8-supply = <0x34>;
			vcc9-supply = <0x3c>;
			phandle = <0x124>;

			pwrkey {
				status = "okay";
			};

			pinctrl_rk8xx {
				gpio-controller;
				#gpio-cells = <0x02>;
				phandle = <0x162>;

				rk817_slppin_null {
					pins = "gpio_slp";
					function = "pin_fun0";
					phandle = <0x163>;
				};

				rk817_slppin_slp {
					pins = "gpio_slp";
					function = "pin_fun1";
					phandle = <0x38>;
				};

				rk817_slppin_pwrdn {
					pins = "gpio_slp";
					function = "pin_fun2";
					phandle = <0x3a>;
				};

				rk817_slppin_rst {
					pins = "gpio_slp";
					function = "pin_fun3";
					phandle = <0x3b>;
				};
			};

			regulators {

				DCDC_REG1 {
					regulator-always-on;
					regulator-boot-on;
					regulator-min-microvolt = <0x7a120>;
					regulator-max-microvolt = <0x149970>;
					regulator-init-microvolt = <0xdbba0>;
					regulator-ramp-delay = <0x1771>;
					regulator-initial-mode = <0x02>;
					regulator-name = "vdd_logic";
					phandle = <0x99>;

					regulator-state-mem {
						regulator-off-in-suspend;
						regulator-suspend-microvolt = <0xdbba0>;
					};
				};

				DCDC_REG2 {
					regulator-always-on;
					regulator-boot-on;
					regulator-min-microvolt = <0x7a120>;
					regulator-max-microvolt = <0x149970>;
					regulator-init-microvolt = <0xdbba0>;
					regulator-ramp-delay = <0x1771>;
					regulator-initial-mode = <0x02>;
					regulator-name = "vdd_gpu";
					phandle = <0x62>;

					regulator-state-mem {
						regulator-off-in-suspend;
					};
				};

				DCDC_REG3 {
					regulator-always-on;
					regulator-boot-on;
					regulator-initial-mode = <0x02>;
					regulator-name = "vcc_ddr";
					phandle = <0x164>;

					regulator-state-mem {
						regulator-on-in-suspend;
					};
				};

				DCDC_REG4 {
					regulator-always-on;
					regulator-boot-on;
					regulator-min-microvolt = <0x325aa0>;
					regulator-max-microvolt = <0x325aa0>;
					regulator-initial-mode = <0x02>;
					regulator-name = "vcc_3v3";
					phandle = <0x2b>;

					regulator-state-mem {
						regulator-on-in-suspend;
						regulator-suspend-microvolt = <0x325aa0>;
					};
				};

				LDO_REG1 {
					regulator-always-on;
					regulator-boot-on;
					regulator-min-microvolt = <0x1b7740>;
					regulator-max-microvolt = <0x1b7740>;
					regulator-name = "vcca1v8_pmu";
					phandle = <0x28>;

					regulator-state-mem {
						regulator-on-in-suspend;
						regulator-suspend-microvolt = <0x1b7740>;
					};
				};

				LDO_REG2 {
					regulator-always-on;
					regulator-boot-on;
					regulator-min-microvolt = <0x124f80>;
					regulator-max-microvolt = <0x124f80>;
					regulator-name = "vdda_0v9";
					phandle = <0x165>;

					regulator-state-mem {
						regulator-off-in-suspend;
					};
				};

				LDO_REG3 {
					regulator-always-on;
					regulator-boot-on;
					regulator-min-microvolt = <0xdbba0>;
					regulator-max-microvolt = <0xdbba0>;
					regulator-name = "vdda0v9_pmu";
					phandle = <0x166>;

					regulator-state-mem {
						regulator-on-in-suspend;
						regulator-suspend-microvolt = <0xdbba0>;
					};
				};

				LDO_REG4 {
					regulator-always-on;
					regulator-boot-on;
					regulator-min-microvolt = <0x325aa0>;
					regulator-max-microvolt = <0x325aa0>;
					regulator-name = "vccio_acodec";
					phandle = <0x29>;

					regulator-state-mem {
						regulator-off-in-suspend;
					};
				};

				LDO_REG5 {
					regulator-always-on;
					regulator-boot-on;
					regulator-min-microvolt = <0x1b7740>;
					regulator-max-microvolt = <0x325aa0>;
					regulator-name = "vccio_sd";
					phandle = <0x2a>;

					regulator-state-mem {
						regulator-off-in-suspend;
					};
				};

				LDO_REG6 {
					regulator-always-on;
					regulator-boot-on;
					regulator-min-microvolt = <0x325aa0>;
					regulator-max-microvolt = <0x325aa0>;
					regulator-name = "vcc3v3_pmu";
					phandle = <0x27>;

					regulator-state-mem {
						regulator-on-in-suspend;
						regulator-suspend-microvolt = <0x2dc6c0>;
					};
				};

				LDO_REG7 {
					regulator-always-on;
					regulator-boot-on;
					regulator-min-microvolt = <0x1b7740>;
					regulator-max-microvolt = <0x1b7740>;
					regulator-name = "vcc_1v8";
					phandle = <0xfa>;

					regulator-state-mem {
						regulator-off-in-suspend;
					};
				};

				LDO_REG8 {
					regulator-always-on;
					regulator-boot-on;
					regulator-min-microvolt = <0x1b7740>;
					regulator-max-microvolt = <0x1b7740>;
					regulator-name = "vcc1v8_dvp";
					phandle = <0x2c>;

					regulator-state-mem {
						regulator-off-in-suspend;
					};
				};

				LDO_REG9 {
					regulator-always-on;
					regulator-boot-on;
					regulator-min-microvolt = <0x2ab980>;
					regulator-max-microvolt = <0x2ab980>;
					regulator-name = "vcc2v8_dvp";
					phandle = <0x167>;

					regulator-state-mem {
						regulator-off-in-suspend;
					};
				};

				BOOST {
					regulator-always-on;
					regulator-boot-on;
					regulator-min-microvolt = <0x47b760>;
					regulator-max-microvolt = <0x5265c0>;
					regulator-name = "boost";
					phandle = <0x3c>;

					regulator-state-mem {
						regulator-off-in-suspend;
					};
				};

				OTG_SWITCH {
					regulator-name = "otg_switch";
					phandle = <0x168>;

					regulator-state-mem {
						regulator-off-in-suspend;
					};
				};
			};

			battery {
				compatible = "rk817,battery";
				ocv_table = <0xd48 0xdde 0xe2f 0xe6c 0xe91 0xea9 0xeb6 0xeba 0xebf 0xec9 0xed9 0xef2 0xf18 0xf38 0xf58 0xf7b 0xfa2 0xfce 0xffc 0x102e 0x106e>;
				ntc_table = <0x15f4a 0x1577a 0x14ee2 0x13bbe 0x12d9a 0x1284a 0x12002 0x118aa 0x11224 0x1087e 0xfbae 0xef92 0xe420 0xd944 0xcf08 0xc54e 0xbc20 0xb36a 0xab22 0xa352 0x9be6 0x94de 0x8e30 0x87d2 0x81ce 0x7c1a 0x76ac 0x717a 0x6c98 0x67e8 0x6374 0x5f3c 0x5b36 0x5762 0x53c0 0x5046 0x4cf4 0x49d4 0x46d2 0x43ee 0x4132 0x3e94 0x3c1e 0x39bc 0x3778 0x3548 0x3336 0x3142 0x2f58 0x2d8c 0x2bd4 0x2a26 0x2896 0x2710 0x259e 0x2436 0x22e2 0x21a2 0x206c 0x1f40 0x1e1e 0x1d06 0x1c02 0x1b08 0x1a0e 0x1928 0x184c 0x1770 0x16a8 0x15e0 0x1522 0x146e 0x13ba 0x1310 0x1270 0x11da 0x1144 0x10ae 0x1022 0xfd2 0xf82 0xf0a 0xe92 0xe1a 0xdca 0xd98 0xd48 0xd0c 0xcda 0xc80 0xc30 0xbd6 0xb86 0xad2 0x9ba 0x974 0x92e 0x8e8 0x8a2 0x866 0x82a 0x7ee 0x7b2 0x776 0x744 0x708 0x6d6 0x6a4 0x67c 0x65e 0x640>;
				ntc_degree_from = <0x01 0x1e>;
				design_capacity = <0xde1>;
				design_qmax = <0xf44>;
				bat_res = <0x64>;
				sleep_enter_current = <0x96>;
				sleep_exit_current = <0xb4>;
				sleep_filter_current = <0x64>;
				power_off_thresd = <0xd48>;
				zero_algorithm_vol = <0xf0a>;
				max_soc_offset = <0x3c>;
				monitor_sec = <0x05>;
				sample_res = <0x0a>;
				virtual_power = <0x00>;
			};

			charger {
				compatible = "rk817,charger";
				min_input_voltage = <0x1194>;
				max_input_current = <0x5dc>;
				max_chrg_current = <0x7d0>;
				max_chrg_voltage = <0x109a>;
				chrg_term_mode = <0x00>;
				chrg_finish_cur = <0x12c>;
				virtual_power = <0x00>;
				dc_det_adc = <0x00>;
				extcon = <0x22>;
			};

			codec {
				#sound-dai-cells = <0x00>;
				compatible = "rockchip,rk817-codec";
				clocks = <0x1d 0x1a3>;
				clock-names = "mclk";
				assigned-clocks = <0x1d 0x1a3 0x1d 0x1a6>;
				assigned-clock-rates = <0xbb8000>;
				assigned-clock-parents = <0x1d 0x48 0x1d 0x48>;
				pinctrl-names = "default";
				pinctrl-0 = <0x3d>;
				hp-volume = <0x10>;
				spk-volume = <0x24>;
				capture-volume = <0x10>;
				use-ext-amplifier;
				spk-ctl-gpios = <0x3e 0x02 0x00>;
				status = "okay";
				phandle = <0x122>;
			};
		};
	};

	serial@fdd50000 {
		compatible = "rockchip,rk3568-uart", "snps,dw-apb-uart";
		reg = <0x00 0xfdd50000 0x00 0x100>;
		interrupts = <0x00 0x74 0x04>;
		clocks = <0x30 0x0b 0x30 0x2c>;
		clock-names = "baudclk", "apb_pclk";
		reg-shift = <0x02>;
		reg-io-width = <0x04>;
		dmas = <0x3f 0x00 0x3f 0x01>;
		pinctrl-names = "default";
		pinctrl-0 = <0x40>;
		status = "disabled";
		phandle = <0x169>;
	};

	pwm@fdd70000 {
		compatible = "rockchip,rk3568-pwm", "rockchip,rk3328-pwm";
		reg = <0x00 0xfdd70000 0x00 0x10>;
		#pwm-cells = <0x03>;
		pinctrl-names = "active";
		pinctrl-0 = <0x41>;
		clocks = <0x30 0x0d 0x30 0x30>;
		clock-names = "pwm", "pclk";
		status = "disabled";
		phandle = <0x16a>;
	};

	pwm@fdd70010 {
		compatible = "rockchip,rk3568-pwm", "rockchip,rk3328-pwm";
		reg = <0x00 0xfdd70010 0x00 0x10>;
		#pwm-cells = <0x03>;
		pinctrl-names = "active";
		pinctrl-0 = <0x42>;
		clocks = <0x30 0x0d 0x30 0x30>;
		clock-names = "pwm", "pclk";
		status = "disabled";
		phandle = <0x16b>;
	};

	pwm@fdd70020 {
		compatible = "rockchip,rk3568-pwm", "rockchip,rk3328-pwm";
		reg = <0x00 0xfdd70020 0x00 0x10>;
		#pwm-cells = <0x03>;
		pinctrl-names = "active";
		pinctrl-0 = <0x43>;
		clocks = <0x30 0x0d 0x30 0x30>;
		clock-names = "pwm", "pclk";
		status = "disabled";
		phandle = <0x16c>;
	};

	pwm@fdd70030 {
		compatible = "rockchip,rk3568-pwm", "rockchip,rk3328-pwm";
		reg = <0x00 0xfdd70030 0x00 0x10>;
		interrupts = <0x00 0x52 0x04 0x00 0x56 0x04>;
		#pwm-cells = <0x03>;
		pinctrl-names = "active";
		pinctrl-0 = <0x44>;
		clocks = <0x30 0x0d 0x30 0x30>;
		clock-names = "pwm", "pclk";
		status = "disabled";
		phandle = <0x16d>;
	};

	power-management@fdd90000 {
		compatible = "rockchip,rk3568-pmu", "syscon", "simple-mfd";
		reg = <0x00 0xfdd90000 0x00 0x1000>;
		phandle = <0x16e>;

		power-controller {
			compatible = "rockchip,rk3568-power-controller";
			#power-domain-cells = <0x01>;
			#address-cells = <0x01>;
			#size-cells = <0x00>;
			status = "okay";
			phandle = <0x1f>;

			pd_npu@6 {
				reg = <0x06>;
				clocks = <0x1d 0x27 0x1d 0x25 0x1d 0x26>;
				pm_qos = <0x45>;
			};

			pd_gpu@7 {
				reg = <0x07>;
				clocks = <0x1d 0x19 0x1d 0x1a>;
				pm_qos = <0x46>;
			};

			pd_vi@8 {
				reg = <0x08>;
				clocks = <0x1d 0xcc 0x1d 0xcd>;
				pm_qos = <0x47 0x48 0x49>;
			};

			pd_vo@9 {
				reg = <0x09>;
				clocks = <0x1d 0xda 0x1d 0xdb 0x1d 0xdc>;
				pm_qos = <0x4a 0x4b 0x4c>;
			};

			pd_rga@10 {
				reg = <0x0a>;
				clocks = <0x1d 0xf1 0x1d 0xf2>;
				pm_qos = <0x4d 0x4e 0x4f 0x50 0x51 0x52>;
			};

			pd_vpu@11 {
				reg = <0x0b>;
				clocks = <0x1d 0xed>;
				pm_qos = <0x53>;
			};

			pd_rkvdec@13 {
				clocks = <0x1d 0x107>;
				reg = <0x0d>;
				pm_qos = <0x54>;
			};

			pd_rkvenc@14 {
				reg = <0x0e>;
				clocks = <0x1d 0x102>;
				pm_qos = <0x55 0x56 0x57>;
			};

			pd_pipe@15 {
				reg = <0x0f>;
				clocks = <0x1d 0x7f>;
				pm_qos = <0x58 0x59 0x5a 0x5b 0x5c>;
			};
		};
	};

	pvtm@fde00000 {
		compatible = "rockchip,rk3568-core-pvtm";
		reg = <0x00 0xfde00000 0x00 0x100>;
		#address-cells = <0x01>;
		#size-cells = <0x00>;

		pvtm@0 {
			reg = <0x00>;
			clocks = <0x1d 0x13 0x1d 0x1c2>;
			clock-names = "clk", "pclk";
			resets = <0x1d 0x1a 0x1d 0x19>;
			reset-names = "rts", "rst-p";
			thermal-zone = "soc-thermal";
		};
	};

	npu@fde40000 {
		compatible = "rockchip,rk3568-rknpu", "rockchip,rknpu";
		reg = <0x00 0xfde40000 0x00 0x10000>;
		interrupts = <0x00 0x97 0x04>;
		clocks = <0x02 0x02 0x1d 0x23 0x1d 0x28 0x1d 0x29>;
		clock-names = "scmi_clk", "clk", "aclk", "hclk";
		assigned-clocks = <0x1d 0x23>;
		assigned-clock-rates = <0x23c34600>;
		resets = <0x1d 0x2b 0x1d 0x2c>;
		reset-names = "srst_a", "srst_h";
		power-domains = <0x1f 0x06>;
		operating-points-v2 = <0x5d>;
		iommus = <0x5e>;
		status = "disabled";
		phandle = <0x16f>;
	};

	npu-opp-table {
		compatible = "operating-points-v2";
		mbist-vmin = <0xc96a8 0xdbba0 0xe7ef0>;
		nvmem-cells = <0x5f 0x06 0x07>;
		nvmem-cell-names = "leakage", "pvtm", "mbist-vmin";
		rockchip,temp-hysteresis = <0x1388>;
		rockchip,low-temp = <0x00>;
		rockchip,low-temp-adjust-volt = <0x00 0x2bc 0xc350>;
		phandle = <0x5d>;

		opp-200000000 {
			opp-hz = <0x00 0xbebc200>;
			opp-microvolt = <0xc96a8 0xc96a8 0xf4240>;
		};

		opp-300000000 {
			opp-hz = <0x00 0x11b3dc40>;
			opp-microvolt = <0xc96a8 0xc96a8 0xf4240>;
		};

		opp-400000000 {
			opp-hz = <0x00 0x17d78400>;
			opp-microvolt = <0xc96a8 0xc96a8 0xf4240>;
		};

		opp-600000000 {
			opp-hz = <0x00 0x2367b880>;
			opp-microvolt = <0xc96a8 0xc96a8 0xf4240>;
		};

		opp-700000000 {
			opp-hz = <0x00 0x29b92700>;
			opp-microvolt = <0xc96a8 0xc96a8 0xf4240>;
		};

		opp-800000000 {
			opp-hz = <0x00 0x2faf0800>;
			opp-microvolt = <0xd59f8 0xd59f8 0xf4240>;
		};

		opp-900000000 {
			opp-hz = <0x00 0x35a4e900>;
			opp-microvolt = <0xe1d48 0xe1d48 0xf4240>;
		};

		opp-1000000000 {
			opp-hz = <0x00 0x3b9aca00>;
			opp-microvolt = <0xf4240 0xf4240 0xf4240>;
			status = "disabled";
		};
	};

	bus-npu {
		compatible = "rockchip,rk3568-bus";
		rockchip,busfreq-policy = "clkfreq";
		clocks = <0x02 0x02>;
		clock-names = "bus";
		operating-points-v2 = <0x60>;
		status = "disabled";
		phandle = <0x170>;
	};

	bus-npu-opp-table {
		compatible = "operating-points-v2";
		opp-shared;
		nvmem-cells = <0x06>;
		nvmem-cell-names = "pvtm";
		rockchip,pvtm-voltage-sel = <0x00 0x14050 0x00 0x14051 0x16b48 0x01 0x16b49 0x186a0 0x02>;
		rockchip,pvtm-ch = <0x00 0x05>;
		phandle = <0x60>;

		opp-1000000000 {
			opp-hz = <0x00 0x3b9aca00>;
			opp-microvolt = <0xe7ef0>;
			opp-microvolt-L0 = <0xe7ef0>;
			opp-microvolt-L1 = <0xe1d48>;
			opp-microvolt-L2 = <0x00>;
		};

		opp-900000000 {
			opp-hz = <0x00 0x35a4e900>;
			opp-microvolt = <0x00>;
		};
	};

	iommu@fde4b000 {
		compatible = "rockchip,iommu-v2";
		reg = <0x00 0xfde4b000 0x00 0x40>;
		interrupts = <0x00 0x97 0x04>;
		interrupt-names = "rknpu_mmu";
		clocks = <0x1d 0x28 0x1d 0x29>;
		clock-names = "aclk", "iface";
		power-domains = <0x1f 0x06>;
		#iommu-cells = <0x00>;
		status = "disabled";
		phandle = <0x5e>;
	};

	gpu@fde60000 {
		compatible = "arm,mali-bifrost";
		reg = <0x00 0xfde60000 0x00 0x4000>;
		interrupts = <0x00 0x27 0x04 0x00 0x29 0x04 0x00 0x28 0x04>;
		interrupt-names = "GPU", "MMU", "JOB";
		upthreshold = <0x28>;
		downdifferential = <0x0a>;
		clocks = <0x02 0x01 0x1d 0x1b>;
		clock-names = "clk_mali", "clk_gpu";
		power-domains = <0x1f 0x07>;
		#cooling-cells = <0x02>;
		operating-points-v2 = <0x61>;
		status = "okay";
		mali-supply = <0x62>;
		phandle = <0x1c>;

		power-model {
			compatible = "simple-power-model";
			leakage-range = <0x05 0x0f>;
			ls = <0xffffa23e 0x5927 0x00>;
			static-coefficient = <0x186a0>;
			dynamic-coefficient = <0x3b9>;
			ts = <0xfffe56a6 0xf87a 0xfffffab5 0x14>;
			thermal-zone = "gpu-thermal";
			phandle = <0x171>;
		};
	};

	opp-table2 {
		compatible = "operating-points-v2";
		mbist-vmin = <0xc96a8 0xdbba0 0xe7ef0>;
		nvmem-cells = <0x63 0x06 0x07>;
		nvmem-cell-names = "leakage", "pvtm", "mbist-vmin";
		phandle = <0x61>;

		opp-200000000 {
			opp-hz = <0x00 0xbebc200>;
			opp-microvolt = <0xc96a8>;
		};

		opp-300000000 {
			opp-hz = <0x00 0x11e1a300>;
			opp-microvolt = <0xc96a8>;
		};

		opp-400000000 {
			opp-hz = <0x00 0x17d78400>;
			opp-microvolt = <0xc96a8>;
		};

		opp-600000000 {
			opp-hz = <0x00 0x23c34600>;
			opp-microvolt = <0xc96a8>;
		};

		opp-700000000 {
			opp-hz = <0x00 0x29b92700>;
			opp-microvolt = <0xdbba0>;
		};

		opp-800000000 {
			opp-hz = <0x00 0x2faf0800>;
			opp-microvolt = <0xf4240>;
		};
	};

	pvtm@fde80000 {
		compatible = "rockchip,rk3568-gpu-pvtm";
		reg = <0x00 0xfde80000 0x00 0x100>;
		#address-cells = <0x01>;
		#size-cells = <0x00>;

		pvtm@1 {
			reg = <0x01>;
			clocks = <0x1d 0x1e 0x1d 0x1d>;
			clock-names = "clk", "pclk";
			resets = <0x1d 0x24 0x1d 0x23>;
			reset-names = "rts", "rst-p";
			thermal-zone = "gpu-thermal";
		};
	};

	pvtm@fde90000 {
		compatible = "rockchip,rk3568-npu-pvtm";
		reg = <0x00 0xfde90000 0x00 0x100>;
		#address-cells = <0x01>;
		#size-cells = <0x00>;

		pvtm@2 {
			reg = <0x02>;
			clocks = <0x1d 0x2b 0x1d 0x2a 0x1d 0x25>;
			clock-names = "clk", "pclk", "hclk";
			resets = <0x1d 0x2e 0x1d 0x2d>;
			reset-names = "rts", "rst-p";
			thermal-zone = "soc-thermal";
		};
	};

	vdpu@fdea0400 {
		compatible = "rockchip,vpu-decoder-v2";
		reg = <0x00 0xfdea0400 0x00 0x400>;
		interrupts = <0x00 0x8b 0x04>;
		interrupt-names = "irq_dec";
		clocks = <0x1d 0xee 0x1d 0xef>;
		clock-names = "aclk_vcodec", "hclk_vcodec";
		resets = <0x1d 0x11a 0x1d 0x11b>;
		reset-names = "video_a", "video_h";
		iommus = <0x64>;
		power-domains = <0x1f 0x0b>;
		rockchip,srv = <0x65>;
		rockchip,taskqueue-node = <0x00>;
		rockchip,resetgroup-node = <0x00>;
		status = "okay";
		phandle = <0x172>;
	};

	iommu@fdea0800 {
		compatible = "rockchip,iommu-v2";
		reg = <0x00 0xfdea0800 0x00 0x40>;
		interrupts = <0x00 0x8a 0x04>;
		interrupt-names = "vdpu_mmu";
		clock-names = "aclk", "iface";
		clocks = <0x1d 0xee 0x1d 0xef>;
		power-domains = <0x1f 0x0b>;
		#iommu-cells = <0x00>;
		status = "okay";
		phandle = <0x64>;
	};

	rk_rga@fdeb0000 {
		compatible = "rockchip,rga2";
		reg = <0x00 0xfdeb0000 0x00 0x1000>;
		interrupts = <0x00 0x5a 0x04>;
		clocks = <0x1d 0xf3 0x1d 0xf4 0x1d 0xf5>;
		clock-names = "aclk_rga", "hclk_rga", "clk_rga";
		power-domains = <0x1f 0x0a>;
		status = "okay";
		phandle = <0x173>;
	};

	ebc@fdec0000 {
		compatible = "rockchip,rk3568-ebc-tcon";
		reg = <0x00 0xfdec0000 0x00 0x5000>;
		interrupts = <0x00 0x11 0x04>;
		clocks = <0x1d 0xf9 0x1d 0xfa>;
		clock-names = "hclk", "dclk";
		power-domains = <0x1f 0x0a>;
		rockchip,grf = <0x31>;
		pinctrl-names = "default";
		pinctrl-0 = <0x66>;
		status = "disabled";
		phandle = <0x174>;
	};

	jpegd@fded0000 {
		compatible = "rockchip,rkv-jpeg-decoder-v1";
		reg = <0x00 0xfded0000 0x00 0x400>;
		interrupts = <0x00 0x3e 0x04>;
		clocks = <0x1d 0xfb 0x1d 0xfc>;
		clock-names = "aclk_vcodec", "hclk_vcodec";
		rockchip,disable-auto-freq;
		resets = <0x1d 0x12c 0x1d 0x12d>;
		reset-names = "video_a", "video_h";
		iommus = <0x67>;
		rockchip,srv = <0x65>;
		rockchip,taskqueue-node = <0x01>;
		rockchip,resetgroup-node = <0x01>;
		power-domains = <0x1f 0x0a>;
		status = "okay";
		phandle = <0x175>;
	};

	iommu@fded0480 {
		compatible = "rockchip,iommu-v2";
		reg = <0x00 0xfded0480 0x00 0x40>;
		interrupts = <0x00 0x3d 0x04>;
		interrupt-names = "jpegd_mmu";
		clock-names = "aclk", "iface";
		clocks = <0x1d 0xfb 0x1d 0xfc>;
		power-domains = <0x1f 0x0a>;
		#iommu-cells = <0x00>;
		status = "okay";
		phandle = <0x67>;
	};

	vepu@fdee0000 {
		compatible = "rockchip,vpu-encoder-v2";
		reg = <0x00 0xfdee0000 0x00 0x400>;
		interrupts = <0x00 0x40 0x04>;
		clocks = <0x1d 0xfd 0x1d 0xfe>;
		clock-names = "aclk_vcodec", "hclk_vcodec";
		rockchip,disable-auto-freq;
		resets = <0x1d 0x12e 0x1d 0x12f>;
		reset-names = "video_a", "video_h";
		iommus = <0x68>;
		rockchip,srv = <0x65>;
		rockchip,taskqueue-node = <0x02>;
		rockchip,resetgroup-node = <0x02>;
		power-domains = <0x1f 0x0a>;
		status = "okay";
		phandle = <0x176>;
	};

	iommu@fdee0800 {
		compatible = "rockchip,iommu-v2";
		reg = <0x00 0xfdee0800 0x00 0x40>;
		interrupts = <0x00 0x3f 0x04>;
		interrupt-names = "vepu_mmu";
		clock-names = "aclk", "iface";
		clocks = <0x1d 0xfd 0x1d 0xfe>;
		power-domains = <0x1f 0x0a>;
		#iommu-cells = <0x00>;
		status = "okay";
		phandle = <0x68>;
	};

	iep@fdef0000 {
		compatible = "rockchip,iep-v2";
		reg = <0x00 0xfdef0000 0x00 0x500>;
		interrupts = <0x00 0x38 0x04>;
		clocks = <0x1d 0xf6 0x1d 0xf7 0x1d 0xf8>;
		clock-names = "aclk", "hclk", "sclk";
		resets = <0x1d 0x127 0x1d 0x128 0x1d 0x129>;
		reset-names = "rst_a", "rst_h", "rst_s";
		power-domains = <0x1f 0x0a>;
		rockchip,srv = <0x65>;
		rockchip,taskqueue-node = <0x05>;
		rockchip,resetgroup-node = <0x05>;
		iommus = <0x69>;
		status = "disabled";
		phandle = <0x177>;
	};

	iommu@fdef0800 {
		compatible = "rockchip,iommu-v2";
		reg = <0x00 0xfdef0800 0x00 0x100>;
		interrupts = <0x00 0x38 0x04>;
		interrupt-names = "iep_mmu";
		clocks = <0x1d 0xf6 0x1d 0xf7>;
		clock-names = "aclk", "iface";
		#iommu-cells = <0x00>;
		power-domains = <0x1f 0x0a>;
		status = "disabled";
		phandle = <0x69>;
	};

	eink@fdf00000 {
		compatible = "rockchip,rk3568-eink-tcon";
		reg = <0x00 0xfdf00000 0x00 0x74>;
		interrupts = <0x00 0xb2 0x04>;
		clocks = <0x1d 0xff 0x1d 0x100>;
		clock-names = "pclk", "hclk";
		status = "disabled";
		phandle = <0x178>;
	};

	rkvenc@fdf40000 {
		compatible = "rockchip,rkv-encoder-v1";
		reg = <0x00 0xfdf40000 0x00 0x400>;
		interrupts = <0x00 0x8c 0x04>;
		interrupt-names = "irq_enc";
		clocks = <0x1d 0x103 0x1d 0x104 0x1d 0x105>;
		clock-names = "aclk_vcodec", "hclk_vcodec", "clk_core";
		rockchip,normal-rates = <0x11b3dc40 0x00 0x11b3dc40>;
		resets = <0x1d 0x133 0x1d 0x134 0x1d 0x135>;
		reset-names = "video_a", "video_h", "video_core";
		assigned-clocks = <0x1d 0x103 0x1d 0x105>;
		assigned-clock-rates = <0x11b3dc40 0x11b3dc40>;
		iommus = <0x6a>;
		node-name = "rkvenc";
		rockchip,srv = <0x65>;
		rockchip,taskqueue-node = <0x03>;
		rockchip,resetgroup-node = <0x03>;
		power-domains = <0x1f 0x0e>;
		operating-points-v2 = <0x6b>;
		status = "okay";
		phandle = <0x179>;
	};

	rkvenc-opp-table {
		compatible = "operating-points-v2";
		nvmem-cells = <0x06>;
		nvmem-cell-names = "pvtm";
		rockchip,pvtm-voltage-sel = <0x00 0x14050 0x00 0x14051 0x16b48 0x01 0x16b49 0x186a0 0x02>;
		rockchip,pvtm-ch = <0x00 0x05>;
		phandle = <0x6b>;

		opp-297000000 {
			opp-hz = <0x00 0x11b3dc40>;
			opp-microvolt = <0xdbba0>;
			opp-microvolt-L0 = <0xdbba0>;
			opp-microvolt-L1 = <0xdbba0>;
			opp-microvolt-L2 = <0xcf850>;
		};

		opp-400000000 {
			opp-hz = <0x00 0x17d78400>;
			opp-microvolt = <0xe7ef0>;
			opp-microvolt-L0 = <0xe7ef0>;
			opp-microvolt-L1 = <0xdbba0>;
			opp-microvolt-L2 = <0xcf850>;
		};
	};

	iommu@fdf40f00 {
		compatible = "rockchip,iommu-v2";
		reg = <0x00 0xfdf40f00 0x00 0x40 0x00 0xfdf40f40 0x00 0x40>;
		interrupts = <0x00 0x8d 0x04 0x00 0x8e 0x04>;
		interrupt-names = "rkvenc_mmu0", "rkvenc_mmu1";
		clocks = <0x1d 0x103 0x1d 0x104>;
		clock-names = "aclk", "iface";
		rockchip,disable-mmu-reset;
		rockchip,enable-cmd-retry;
		#iommu-cells = <0x00>;
		power-domains = <0x1f 0x0e>;
		status = "okay";
		phandle = <0x6a>;
	};

	rkvdec@fdf80200 {
		compatible = "rockchip,rkv-decoder-rk3568", "rockchip,rkv-decoder-v2";
		reg = <0x00 0xfdf80200 0x00 0x400>;
		interrupts = <0x00 0x5b 0x04>;
		interrupt-names = "irq_dec";
		clocks = <0x1d 0x108 0x1d 0x109 0x1d 0x10a 0x1d 0x10b 0x1d 0x10c>;
		clock-names = "aclk_vcodec", "hclk_vcodec", "clk_cabac", "clk_core", "clk_hevc_cabac";
		rockchip,normal-rates = <0x11b3dc40 0x00 0x11b3dc40 0x11b3dc40 0x23c34600>;
		rockchip,advanced-rates = <0x179a7b00 0x00 0x179a7b00 0x179a7b00 0x23c34600>;
		rockchip,default-max-load = <0x1fe000>;
		resets = <0x1d 0x142 0x1d 0x143 0x1d 0x144 0x1d 0x145 0x1d 0x146>;
		assigned-clocks = <0x1d 0x108 0x1d 0x10a 0x1d 0x10b 0x1d 0x10c>;
		assigned-clock-rates = <0x11b3dc40 0x11b3dc40 0x11b3dc40 0x11b3dc40>;
		reset-names = "video_a", "video_h", "video_cabac", "video_core", "video_hevc_cabac";
		power-domains = <0x1f 0x0d>;
		iommus = <0x6c>;
		rockchip,srv = <0x65>;
		rockchip,taskqueue-node = <0x04>;
		rockchip,resetgroup-node = <0x04>;
		rockchip,sram = <0x6d>;
		rockchip,rcb-iova = <0x10000000 0x10000>;
		rockchip,rcb-min-width = <0x200>;
		status = "okay";
		phandle = <0x17a>;
	};

	iommu@fdf80800 {
		compatible = "rockchip,iommu-v2";
		reg = <0x00 0xfdf80800 0x00 0x40 0x00 0xfdf80840 0x00 0x40>;
		interrupts = <0x00 0x5c 0x04>;
		interrupt-names = "rkvdec_mmu";
		clocks = <0x1d 0x108 0x1d 0x109>;
		clock-names = "aclk", "iface";
		power-domains = <0x1f 0x0d>;
		#iommu-cells = <0x00>;
		status = "okay";
		phandle = <0x6c>;
	};

	mipi-csi2@fdfb0000 {
		compatible = "rockchip,rk3568-mipi-csi2";
		reg = <0x00 0xfdfb0000 0x00 0x10000>;
		reg-names = "csihost_regs";
		interrupts = <0x00 0x08 0x04 0x00 0x09 0x04>;
		interrupt-names = "csi-intr1", "csi-intr2";
		clocks = <0x1d 0xd5>;
		clock-names = "pclk_csi2host";
		resets = <0x1d 0xff>;
		reset-names = "srst_csihost_p";
		status = "disabled";
		phandle = <0x17b>;
	};

	rkcif@fdfe0000 {
		compatible = "rockchip,rk3568-cif";
		reg = <0x00 0xfdfe0000 0x00 0x8000>;
		reg-names = "cif_regs";
		interrupts = <0x00 0x92 0x04>;
		interrupt-names = "cif-intr";
		clocks = <0x1d 0xce 0x1d 0xcf 0x1d 0xd0 0x1d 0xd1>;
		clock-names = "aclk_cif", "hclk_cif", "dclk_cif", "iclk_cif_g";
		resets = <0x1d 0xf7 0x1d 0xf8 0x1d 0xf9 0x1d 0xfb 0x1d 0xfa>;
		reset-names = "rst_cif_a", "rst_cif_h", "rst_cif_d", "rst_cif_p", "rst_cif_i";
		assigned-clocks = <0x1d 0xd0>;
		assigned-clock-rates = <0x11e1a300>;
		power-domains = <0x1f 0x08>;
		rockchip,grf = <0x31>;
		iommus = <0x6e>;
		status = "disabled";
		phandle = <0x6f>;
	};

	iommu@fdfe0800 {
		compatible = "rockchip,iommu-v2";
		reg = <0x00 0xfdfe0800 0x00 0x100>;
		interrupts = <0x00 0x92 0x04>;
		interrupt-names = "cif_mmu";
		clocks = <0x1d 0xce 0x1d 0xcf>;
		clock-names = "aclk", "iface";
		power-domains = <0x1f 0x08>;
		rockchip,disable-mmu-reset;
		#iommu-cells = <0x00>;
		status = "disabled";
		phandle = <0x6e>;
	};

	rkcif_dvp {
		compatible = "rockchip,rkcif-dvp";
		rockchip,hw = <0x6f>;
		status = "disabled";
		phandle = <0x70>;
	};

	rkcif_dvp_sditf {
		compatible = "rockchip,rkcif-sditf";
		rockchip,cif = <0x70>;
		status = "disabled";
		phandle = <0x17c>;
	};

	rkcif_mipi_lvds {
		compatible = "rockchip,rkcif-mipi-lvds";
		rockchip,hw = <0x6f>;
		status = "disabled";
		phandle = <0x71>;
	};

	rkcif_mipi_lvds_sditf {
		compatible = "rockchip,rkcif-sditf";
		rockchip,cif = <0x71>;
		status = "disabled";
		phandle = <0x17d>;
	};

	rkisp@fdff0000 {
		compatible = "rockchip,rk3568-rkisp";
		reg = <0x00 0xfdff0000 0x00 0x10000>;
		interrupts = <0x00 0x39 0x04 0x00 0x3a 0x04 0x00 0x3c 0x04>;
		interrupt-names = "mipi_irq", "mi_irq", "isp_irq";
		clocks = <0x1d 0xd2 0x1d 0xd3 0x1d 0xd4>;
		clock-names = "aclk_isp", "hclk_isp", "clk_isp";
		resets = <0x1d 0xfd 0x1d 0xfc>;
		reset-names = "isp", "isp-h";
		rockchip,grf = <0x31>;
		power-domains = <0x1f 0x08>;
		iommus = <0x72>;
		rockchip,iq-feature = <0x3fb 0xf7fe67ff>;
		status = "okay";
		phandle = <0x73>;
	};

	iommu@fdff1a00 {
		compatible = "rockchip,iommu-v2";
		reg = <0x00 0xfdff1a00 0x00 0x100>;
		interrupts = <0x00 0x3b 0x04>;
		interrupt-names = "isp_mmu";
		clocks = <0x1d 0xd2 0x1d 0xd3>;
		clock-names = "aclk", "iface";
		power-domains = <0x1f 0x08>;
		#iommu-cells = <0x00>;
		rockchip,disable-mmu-reset;
		status = "okay";
		phandle = <0x72>;
	};

	rkisp-vir0 {
		compatible = "rockchip,rkisp-vir";
		rockchip,hw = <0x73>;
		status = "okay";
		pinctrl-names = "default";
		pinctrl-0 = <0x74>;
		phandle = <0x17e>;

		port {
			#address-cells = <0x01>;
			#size-cells = <0x00>;

			endpoint@0 {
				reg = <0x00>;
				remote-endpoint = <0x75>;
				phandle = <0x100>;
			};

			endpoint@1 {
				reg = <0x01>;
				remote-endpoint = <0x76>;
				phandle = <0x108>;
			};

			endpoint@2 {
				reg = <0x01>;
				remote-endpoint = <0x77>;
				phandle = <0x10d>;
			};
		};
	};

	rkisp-vir1 {
		compatible = "rockchip,rkisp-vir";
		rockchip,hw = <0x73>;
		status = "disabled";
		phandle = <0x17f>;
	};

	ethernet@fe010000 {
		compatible = "rockchip,rk3568-gmac", "snps,dwmac-4.20a";
		reg = <0x00 0xfe010000 0x00 0x10000>;
		interrupts = <0x00 0x20 0x04 0x00 0x1d 0x04>;
		interrupt-names = "macirq", "eth_wake_irq";
		rockchip,grf = <0x31>;
		clocks = <0x1d 0x186 0x1d 0x189 0x1d 0x189 0x1d 0xc7 0x1d 0xc3 0x1d 0xc4 0x1d 0x189 0x1d 0xc8 0x1d 0xac>;
		clock-names = "stmmaceth", "mac_clk_rx", "mac_clk_tx", "clk_mac_refout", "aclk_mac", "pclk_mac", "clk_mac_speed", "ptp_ref", "pclk_xpcs";
		resets = <0x1d 0xec>;
		reset-names = "stmmaceth";
		snps,mixed-burst;
		snps,tso;
		snps,axi-config = <0x78>;
		snps,mtl-rx-config = <0x79>;
		snps,mtl-tx-config = <0x7a>;
		status = "disabled";
		phandle = <0x180>;

		mdio {
			compatible = "snps,dwmac-mdio";
			#address-cells = <0x01>;
			#size-cells = <0x00>;
			phandle = <0x181>;
		};

		stmmac-axi-config {
			snps,wr_osr_lmt = <0x04>;
			snps,rd_osr_lmt = <0x08>;
			snps,blen = <0x00 0x00 0x00 0x00 0x10 0x08 0x04>;
			phandle = <0x78>;
		};

		rx-queues-config {
			snps,rx-queues-to-use = <0x01>;
			phandle = <0x79>;

			queue0 {
			};
		};

		tx-queues-config {
			snps,tx-queues-to-use = <0x01>;
			phandle = <0x7a>;

			queue0 {
			};
		};
	};

	vop@fe040000 {
		compatible = "rockchip,rk3568-vop";
		reg = <0x00 0xfe040000 0x00 0x3000 0x00 0xfe044000 0x00 0x1000>;
		reg-names = "regs", "gamma_lut";
		rockchip,grf = <0x31>;
		interrupts = <0x00 0x94 0x04>;
		clocks = <0x1d 0xdd 0x1d 0xde 0x1d 0xdf 0x1d 0xe0 0x1d 0xe1>;
		clock-names = "aclk_vop", "hclk_vop", "dclk_vp0", "dclk_vp1", "dclk_vp2";
		iommus = <0x7b>;
		power-domains = <0x1f 0x09>;
		status = "okay";
		support-multi-area;
		assigned-clocks = <0x1d 0xdf 0x1d 0xe0>;
		assigned-clock-parents = <0x30 0x02 0x1d 0x05>;
		phandle = <0x182>;

		ports {
			#address-cells = <0x01>;
			#size-cells = <0x00>;
			phandle = <0x11>;

			port@0 {
				#address-cells = <0x01>;
				#size-cells = <0x00>;
				reg = <0x00>;
				phandle = <0x183>;

				endpoint@0 {
					reg = <0x00>;
					remote-endpoint = <0x7c>;
					phandle = <0x87>;
				};

				endpoint@1 {
					reg = <0x01>;
					remote-endpoint = <0x7d>;
					phandle = <0x14>;
				};

				endpoint@2 {
					reg = <0x02>;
					remote-endpoint = <0x7e>;
					phandle = <0x15>;
				};

				endpoint@3 {
					reg = <0x03>;
					remote-endpoint = <0x7f>;
					phandle = <0x93>;
				};
			};

			port@1 {
				#address-cells = <0x01>;
				#size-cells = <0x00>;
				reg = <0x01>;
				phandle = <0x184>;

				endpoint@0 {
					reg = <0x00>;
					remote-endpoint = <0x80>;
					phandle = <0x13>;
				};

				endpoint@1 {
					reg = <0x01>;
					remote-endpoint = <0x81>;
					phandle = <0x8f>;
				};

				endpoint@2 {
					reg = <0x02>;
					remote-endpoint = <0x82>;
					phandle = <0x95>;
				};

				endpoint@3 {
					reg = <0x03>;
					remote-endpoint = <0x83>;
					phandle = <0x16>;
				};

				endpoint@4 {
					reg = <0x04>;
					remote-endpoint = <0x84>;
					phandle = <0x17>;
				};
			};

			port@2 {
				#address-cells = <0x01>;
				#size-cells = <0x00>;
				reg = <0x02>;
				phandle = <0x185>;

				endpoint@0 {
					reg = <0x00>;
					remote-endpoint = <0x85>;
					phandle = <0x2e>;
				};

				endpoint@1 {
					reg = <0x01>;
					remote-endpoint = <0x86>;
					phandle = <0x18>;
				};
			};
		};
	};

	iommu@fe043e00 {
		compatible = "rockchip,iommu-v2";
		reg = <0x00 0xfe043e00 0x00 0x100 0x00 0xfe043f00 0x00 0x100>;
		interrupts = <0x00 0x94 0x04>;
		interrupt-names = "vop_mmu";
		clocks = <0x1d 0xdd 0x1d 0xde>;
		clock-names = "aclk", "iface";
		#iommu-cells = <0x00>;
		status = "okay";
		phandle = <0x7b>;
	};

	dsi@fe060000 {
		compatible = "rockchip,rk3568-mipi-dsi";
		reg = <0x00 0xfe060000 0x00 0x10000>;
		interrupts = <0x00 0x44 0x04>;
		clocks = <0x1d 0xe8 0x1d 0xda 0x2d>;
		clock-names = "pclk", "hclk", "hs_clk";
		resets = <0x1d 0x110>;
		reset-names = "apb";
		phys = <0x2d>;
		phy-names = "mipi_dphy";
		power-domains = <0x1f 0x09>;
		rockchip,grf = <0x31>;
		#address-cells = <0x01>;
		#size-cells = <0x00>;
		status = "okay";
		phandle = <0x186>;

		ports {
			#address-cells = <0x01>;
			#size-cells = <0x00>;

			port@0 {
				reg = <0x00>;
				#address-cells = <0x01>;
				#size-cells = <0x00>;
				phandle = <0x187>;

				endpoint@0 {
					reg = <0x00>;
					remote-endpoint = <0x87>;
					status = "disabled";
					phandle = <0x7c>;
				};

				endpoint@1 {
					reg = <0x01>;
					remote-endpoint = <0x13>;
					status = "okay";
					phandle = <0x80>;
				};
			};

			port@1 {
				reg = <0x01>;

				endpoint {
					remote-endpoint = <0x88>;
					phandle = <0x8d>;
				};
			};
		};

		panel@0 {
			compatible = "simple-panel-dsi";
			reg = <0x00>;
			backlight = <0x89>;
			enable-gpios = <0x3e 0x09 0x00>;
			reset-gpios = <0x3e 0x13 0x01>;
			pinctrl-names = "default";
			pinctrl-0 = <0x8a 0x8b>;
			prepare-delay-ms = <0x14>;
			reset-delay-ms = <0x14>;
			init-delay-ms = <0x14>;
			stbyb-delay-ms = <0x78>;
			enable-delay-ms = <0x78>;
			disable-delay-ms = <0x14>;
			unprepare-delay-ms = <0x14>;
			width-mm = <0x87>;
			height-mm = <0xd8>;
			dsi,flags = <0xa03>;
			dsi,format = <0x00>;
			dsi,lanes = <0x04>;
			panel-init-sequence = <0x150002e0 0x150002 0xe1931500 0x2e26515 0x2e3f8 0x15000280 0x3150002 0xe0041500 0x22d0315 0x20914 0x150002e0 0x1150002 0x1500 0x2016f15 0x20300 0x15000204 0x6f150002 0xc741500 0x2171015 0x21817 0x15000219 0x150002 0x1a101500 0x21b1715 0x21c00 0x1500021f 0x7e150002 0x20241500 0x2212415 0x2220e 0x15000237 0x9150002 0x38041500 0x2390815 0x23a12 0x1500023c 0x78150002 0x3dff1500 0x23eff15 0x23f7f 0x15000240 0x6150002 0x41a01500 0x24b0415 0x25501 0x15000256 0x1150002 0x57651500 0x2580815 0x25928 0x1500025a 0x2b150002 0x5b131500 0x25d7015 0x25e5e 0x1500025f 0x50150002 0x60451500 0x2614215 0x26233 0x15000263 0x37150002 0x64211500 0x2653915 0x26636 0x15000267 0x36150002 0x68541500 0x2694115 0x26a4a 0x1500026b 0x3d150002 0x6c3a1500 0x26d2f15 0x26e1f 0x1500026f 0x2150002 0x70701500 0x2715e15 0x27250 0x15000273 0x45150002 0x74421500 0x2753315 0x27637 0x15000277 0x21150002 0x78391500 0x2793615 0x27a36 0x1500027b 0x54150002 0x7c411500 0x27d4a15 0x27e3d 0x1500027f 0x3a150002 0x802f1500 0x2811f15 0x28202 0x150002e0 0x2150002 0x1e1500 0x2011f15 0x20217 0x15000203 0x37150002 0x4081500 0x2050a15 0x20604 0x15000207 0x6150002 0x8001500 0x2091f15 0x20a1f 0x1500020b 0x1f150002 0xc1f1500 0x20d1f15 0x20e1f 0x1500020f 0x2150002 0x101f1500 0x2111f15 0x2121f 0x15000213 0x1f150002 0x141f1500 0x2151f15 0x2161e 0x15000217 0x1f150002 0x18171500 0x2193715 0x21a09 0x1500021b 0xb150002 0x1c051500 0x21d0715 0x21e01 0x1500021f 0x1f150002 0x201f1500 0x2211f15 0x2221f 0x15000223 0x1f150002 0x241f1500 0x2250315 0x2261f 0x15000227 0x1f150002 0x281f1500 0x2291f15 0x22a1f 0x1500022b 0x1f150002 0x2c1f1500 0x22d1e15 0x22e17 0x1500022f 0x37150002 0x30071500 0x2310515 0x2320b 0x15000233 0x9150002 0x34031500 0x2351f15 0x2361f 0x15000237 0x1f150002 0x381f1500 0x2391f15 0x23a1f 0x1500023b 0x1150002 0x3c1f1500 0x23d1f15 0x23e1f 0x1500023f 0x1f150002 0x401f1500 0x2411f15 0x2421f 0x15000243 0x1e150002 0x44171500 0x2453715 0x24606 0x15000247 0x4150002 0x480a1500 0x2490815 0x24a02 0x1500024b 0x1f150002 0x4c1f1500 0x24d1f15 0x24e1f 0x1500024f 0x1f150002 0x501f1500 0x2510015 0x2521f 0x15000253 0x1f150002 0x541f1500 0x2551f15 0x2561f 0x15000257 0x1f150002 0x58101500 0x2590015 0x25a00 0x1500025b 0x30150002 0x5c051500 0x25d3015 0x25e01 0x1500025f 0x2150002 0x60301500 0x2610315 0x26204 0x15000263 0x3150002 0x646a1500 0x2657515 0x2660d 0x15000267 0x73150002 0x68091500 0x2690615 0x26a6a 0x1500026b 0x8150002 0x6c001500 0x26d0c15 0x26e04 0x1500026f 0x88150002 0x70001500 0x2710015 0x27206 0x15000273 0x7b150002 0x74001500 0x2758015 0x27600 0x15000277 0xd150002 0x78241500 0x2790015 0x27a00 0x1500027b 0x150002 0x7c001500 0x27d0315 0x27e7b 0x150002e0 0x4150002 0x9101500 0x22b2b15 0x22e44 0x150002e0 0x150002 0xe6021500 0x2e70205 0x78011105 0x14012915 0x23500>;
			panel-exit-sequence = <0x5010128 0x5030110>;

			display-timings {
				native-mode = <0x8c>;

				timing0 {
					clock-frequency = <0x3fe56c0>;
					hactive = <0x320>;
					vactive = <0x500>;
					hfront-porch = <0x12>;
					hsync-len = <0x12>;
					hback-porch = <0x12>;
					vfront-porch = <0x14>;
					vsync-len = <0x04>;
					vback-porch = <0x0c>;
					hsync-active = <0x00>;
					vsync-active = <0x00>;
					de-active = <0x00>;
					pixelclk-active = <0x01>;
					phandle = <0x8c>;
				};

				timing1 {
					clock-frequency = <0x42c1d80>;
					hactive = <0x320>;
					vactive = <0x500>;
					hfront-porch = <0x1e>;
					hsync-len = <0x18>;
					hback-porch = <0x18>;
					vfront-porch = <0x1e>;
					vsync-len = <0x04>;
					vback-porch = <0x14>;
					hsync-active = <0x00>;
					vsync-active = <0x00>;
					de-active = <0x00>;
					pixelclk-active = <0x01>;
					phandle = <0x188>;
				};

				timing2 {
					clock-frequency = <0x3fe56c0>;
					hactive = <0x320>;
					vactive = <0x500>;
					hfront-porch = <0x12>;
					hsync-len = <0x12>;
					hback-porch = <0x12>;
					vfront-porch = <0x14>;
					vsync-len = <0x04>;
					vback-porch = <0x0c>;
					hsync-active = <0x00>;
					vsync-active = <0x00>;
					de-active = <0x00>;
					pixelclk-active = <0x01>;
					phandle = <0x189>;
				};
			};

			ports {
				#address-cells = <0x01>;
				#size-cells = <0x00>;

				port@0 {
					reg = <0x00>;

					endpoint {
						remote-endpoint = <0x8d>;
						phandle = <0x88>;
					};
				};
			};
		};
	};

	dsi@fe070000 {
		compatible = "rockchip,rk3568-mipi-dsi";
		reg = <0x00 0xfe070000 0x00 0x10000>;
		interrupts = <0x00 0x45 0x04>;
		clocks = <0x1d 0xe9 0x1d 0xda 0x8e>;
		clock-names = "pclk", "hclk", "hs_clk";
		resets = <0x1d 0x111>;
		reset-names = "apb";
		phys = <0x8e>;
		phy-names = "mipi_dphy";
		power-domains = <0x1f 0x09>;
		rockchip,grf = <0x31>;
		#address-cells = <0x01>;
		#size-cells = <0x00>;
		status = "disabled";
		phandle = <0x18a>;

		ports {
			#address-cells = <0x01>;
			#size-cells = <0x00>;

			port@0 {
				reg = <0x00>;
				#address-cells = <0x01>;
				#size-cells = <0x00>;
				phandle = <0x18b>;

				endpoint@0 {
					reg = <0x00>;
					remote-endpoint = <0x14>;
					status = "disabled";
					phandle = <0x7d>;
				};

				endpoint@1 {
					reg = <0x01>;
					remote-endpoint = <0x8f>;
					status = "disabled";
					phandle = <0x81>;
				};
			};
		};
	};

	hdmi@fe0a0000 {
		compatible = "rockchip,rk3568-dw-hdmi";
		reg = <0x00 0xfe0a0000 0x00 0x20000>;
		interrupts = <0x00 0x2d 0x04>;
		clocks = <0x1d 0xe6 0x1d 0xe7 0x1d 0x193 0x30 0x02 0x1d 0xde>;
		clock-names = "iahb", "isfr", "cec", "ref", "hclk";
		power-domains = <0x1f 0x09>;
		reg-io-width = <0x04>;
		rockchip,grf = <0x31>;
		#sound-dai-cells = <0x00>;
		pinctrl-names = "default";
		pinctrl-0 = <0x90 0x91 0x92>;
		status = "okay";
		phandle = <0x11f>;

		ports {
			#address-cells = <0x01>;
			#size-cells = <0x00>;

			port {
				reg = <0x00>;
				#address-cells = <0x01>;
				#size-cells = <0x00>;
				phandle = <0x18c>;

				endpoint@0 {
					reg = <0x00>;
					remote-endpoint = <0x93>;
					status = "okay";
					phandle = <0x7f>;
				};

				endpoint@1 {
					reg = <0x01>;
					remote-endpoint = <0x16>;
					status = "disabled";
					phandle = <0x83>;
				};
			};
		};
	};

	edp@fe0c0000 {
		compatible = "rockchip,rk3568-edp";
		reg = <0x00 0xfe0c0000 0x00 0x10000>;
		interrupts = <0x00 0x12 0x04>;
		clocks = <0x30 0x29 0x1d 0xea 0x1d 0xeb 0x1d 0xda>;
		clock-names = "dp", "pclk", "spdif", "hclk";
		resets = <0x1d 0x113 0x1d 0x112>;
		reset-names = "dp", "apb";
		phys = <0x94>;
		phy-names = "dp";
		power-domains = <0x1f 0x09>;
		status = "disabled";
		phandle = <0x18d>;

		ports {
			#address-cells = <0x01>;
			#size-cells = <0x00>;

			port@0 {
				reg = <0x00>;
				#address-cells = <0x01>;
				#size-cells = <0x00>;
				phandle = <0x18e>;

				endpoint@0 {
					reg = <0x00>;
					remote-endpoint = <0x15>;
					status = "disabled";
					phandle = <0x7e>;
				};

				endpoint@1 {
					reg = <0x01>;
					remote-endpoint = <0x95>;
					status = "disabled";
					phandle = <0x82>;
				};
			};
		};
	};

	qos@fe128000 {
		compatible = "syscon";
		reg = <0x00 0xfe128000 0x00 0x20>;
		phandle = <0x46>;
	};

	qos@fe138080 {
		compatible = "syscon";
		reg = <0x00 0xfe138080 0x00 0x20>;
		phandle = <0x55>;
	};

	qos@fe138100 {
		compatible = "syscon";
		reg = <0x00 0xfe138100 0x00 0x20>;
		phandle = <0x56>;
	};

	qos@fe138180 {
		compatible = "syscon";
		reg = <0x00 0xfe138180 0x00 0x20>;
		phandle = <0x57>;
	};

	qos@fe148000 {
		compatible = "syscon";
		reg = <0x00 0xfe148000 0x00 0x20>;
		phandle = <0x47>;
	};

	qos@fe148080 {
		compatible = "syscon";
		reg = <0x00 0xfe148080 0x00 0x20>;
		phandle = <0x48>;
	};

	qos@fe148100 {
		compatible = "syscon";
		reg = <0x00 0xfe148100 0x00 0x20>;
		phandle = <0x49>;
	};

	qos@fe150000 {
		compatible = "syscon";
		reg = <0x00 0xfe150000 0x00 0x20>;
		phandle = <0x53>;
	};

	qos@fe158000 {
		compatible = "syscon";
		reg = <0x00 0xfe158000 0x00 0x20>;
		phandle = <0x4d>;
	};

	qos@fe158100 {
		compatible = "syscon";
		reg = <0x00 0xfe158100 0x00 0x20>;
		phandle = <0x4e>;
	};

	qos@fe158180 {
		compatible = "syscon";
		reg = <0x00 0xfe158180 0x00 0x20>;
		phandle = <0x4f>;
	};

	qos@fe158200 {
		compatible = "syscon";
		reg = <0x00 0xfe158200 0x00 0x20>;
		phandle = <0x50>;
	};

	qos@fe158280 {
		compatible = "syscon";
		reg = <0x00 0xfe158280 0x00 0x20>;
		phandle = <0x51>;
	};

	qos@fe158300 {
		compatible = "syscon";
		reg = <0x00 0xfe158300 0x00 0x20>;
		phandle = <0x52>;
	};

	qos@fe180000 {
		compatible = "syscon";
		reg = <0x00 0xfe180000 0x00 0x20>;
		phandle = <0x45>;
	};

	qos@fe190000 {
		compatible = "syscon";
		reg = <0x00 0xfe190000 0x00 0x20>;
		phandle = <0x58>;
	};

	qos@fe190280 {
		compatible = "syscon";
		reg = <0x00 0xfe190280 0x00 0x20>;
		phandle = <0x59>;
	};

	qos@fe190300 {
		compatible = "syscon";
		reg = <0x00 0xfe190300 0x00 0x20>;
		phandle = <0x5a>;
	};

	qos@fe190380 {
		compatible = "syscon";
		reg = <0x00 0xfe190380 0x00 0x20>;
		phandle = <0x5b>;
	};

	qos@fe190400 {
		compatible = "syscon";
		reg = <0x00 0xfe190400 0x00 0x20>;
		phandle = <0x5c>;
	};

	qos@fe198000 {
		compatible = "syscon";
		reg = <0x00 0xfe198000 0x00 0x20>;
		phandle = <0x54>;
	};

	qos@fe1a8000 {
		compatible = "syscon";
		reg = <0x00 0xfe1a8000 0x00 0x20>;
		phandle = <0x4a>;
	};

	qos@fe1a8080 {
		compatible = "syscon";
		reg = <0x00 0xfe1a8080 0x00 0x20>;
		phandle = <0x4b>;
	};

	qos@fe1a8100 {
		compatible = "syscon";
		reg = <0x00 0xfe1a8100 0x00 0x20>;
		phandle = <0x4c>;
	};

	dwmmc@fe000000 {
		compatible = "rockchip,rk3568-dw-mshc", "rockchip,rk3288-dw-mshc";
		reg = <0x00 0xfe000000 0x00 0x4000>;
		interrupts = <0x00 0x64 0x04>;
		max-frequency = <0x8f0d180>;
		clocks = <0x1d 0xc1 0x1d 0xc2 0x1d 0x18e 0x1d 0x18f>;
		clock-names = "biu", "ciu", "ciu-drive", "ciu-sample";
		fifo-depth = <0x100>;
		resets = <0x1d 0xeb>;
		reset-names = "reset";
		status = "disabled";
		phandle = <0x18f>;
	};

	dfi@fe230000 {
		reg = <0x00 0xfe230000 0x00 0x400>;
		compatible = "rockchip,rk3568-dfi";
		rockchip,pmugrf = <0x32>;
		status = "disabled";
		phandle = <0x96>;
	};

	dmc {
		compatible = "rockchip,rk3568-dmc";
		interrupts = <0x00 0x0a 0x04>;
		interrupt-names = "complete";
		devfreq-events = <0x96>;
		clocks = <0x1d 0x1a2>;
		clock-names = "dmc_clk";
		operating-points-v2 = <0x97>;
		ddr_timing = <0x98>;
		vop-bw-dmc-freq = <0x00 0x1f9 0x4f1a0 0x1fa 0x1869f 0x80e80>;
		upthreshold = <0x28>;
		downdifferential = <0x14>;
		system-status-freq = <0x01 0xbe6e0 0x08 0x101d00 0x02 0x4f1a0 0x10 0xbe6e0 0x10000 0xbe6e0 0x1000 0x101d00 0x4000 0x101d00 0x2000 0x101d00 0xc00 0x101d00>;
		auto-min-freq = <0x4f1a0>;
		auto-freq-en = <0x01>;
		#cooling-cells = <0x02>;
		status = "disabled";
		center-supply = <0x99>;
		phandle = <0x12>;
	};

	dmc-opp-table {
		compatible = "operating-points-v2";
		mbist-vmin = <0xc96a8 0xdbba0 0xe7ef0>;
		nvmem-cells = <0x9a 0x06 0x07>;
		nvmem-cell-names = "leakage", "pvtm", "mbist-vmin";
		rockchip,temp-hysteresis = <0x1388>;
		rockchip,low-temp = <0x00>;
		rockchip,low-temp-adjust-volt = <0x00 0x618 0x61a8>;
		rockchip,leakage-voltage-sel = <0x01 0x50 0x00 0x51 0xfe 0x01>;
		phandle = <0x97>;

		opp-324000000 {
			opp-hz = <0x00 0x134fd900>;
			opp-microvolt = <0xdbba0>;
			opp-microvolt-L0 = <0xdbba0>;
			opp-microvolt-L1 = <0xcf850>;
		};

		opp-528000000 {
			opp-hz = <0x00 0x1f78a400>;
			opp-microvolt = <0xdbba0>;
			opp-microvolt-L0 = <0xdbba0>;
			opp-microvolt-L1 = <0xcf850>;
		};

		opp-780000000 {
			opp-hz = <0x00 0x2e7ddb00>;
			opp-microvolt = <0xdbba0>;
			opp-microvolt-L0 = <0xdbba0>;
			opp-microvolt-L1 = <0xcf850>;
		};

		opp-920000000 {
			opp-hz = <0x00 0x36d61600>;
			opp-microvolt = <0xdbba0>;
			opp-microvolt-L0 = <0xdbba0>;
			opp-microvolt-L1 = <0xcf850>;
			status = "disabled";
		};

		opp-1056000000 {
			opp-hz = <0x00 0x3ef14800>;
			opp-microvolt = <0xdbba0>;
			opp-microvolt-L0 = <0xdbba0>;
			opp-microvolt-L1 = <0xcf850>;
		};
	};

	pcie@fe260000 {
		compatible = "rockchip,rk3568-pcie", "snps,dw-pcie";
		#address-cells = <0x03>;
		#size-cells = <0x02>;
		bus-range = <0x00 0x0f>;
		clocks = <0x1d 0x81 0x1d 0x82 0x1d 0x83 0x1d 0x84 0x1d 0x85>;
		clock-names = "aclk_mst", "aclk_slv", "aclk_dbi", "pclk", "aux";
		device_type = "pci";
		interrupts = <0x00 0x4b 0x04 0x00 0x4a 0x04 0x00 0x49 0x04 0x00 0x48 0x04 0x00 0x47 0x04>;
		interrupt-names = "sys", "pmc", "msg", "legacy", "err";
		#interrupt-cells = <0x01>;
		interrupt-map-mask = <0x00 0x00 0x00 0x07>;
		interrupt-map = <0x00 0x00 0x00 0x01 0x9b 0x00 0x00 0x00 0x00 0x02 0x9b 0x01 0x00 0x00 0x00 0x03 0x9b 0x02 0x00 0x00 0x00 0x04 0x9b 0x03>;
		linux,pci-domain = <0x00>;
		num-ib-windows = <0x06>;
		num-ob-windows = <0x02>;
		max-link-speed = <0x02>;
		msi-map = <0x00 0x9c 0x00 0x1000>;
		num-lanes = <0x01>;
		phys = <0x20 0x02>;
		phy-names = "pcie-phy";
		power-domains = <0x1f 0x0f>;
		ranges = <0x800 0x00 0x00 0x03 0x00 0x00 0x800000 0x81000000 0x00 0x800000 0x03 0x800000 0x00 0x100000 0x83000000 0x00 0x900000 0x03 0x900000 0x00 0x3f700000>;
		reg = <0x03 0xc0000000 0x00 0x400000 0x00 0xfe260000 0x00 0x10000>;
		reg-names = "pcie-dbi", "pcie-apb";
		resets = <0x1d 0xa1>;
		reset-names = "pipe";
		status = "disabled";
		phandle = <0x190>;

		legacy-interrupt-controller {
			interrupt-controller;
			#address-cells = <0x00>;
			#interrupt-cells = <0x01>;
			interrupt-parent = <0x01>;
			interrupts = <0x00 0x48 0x01>;
			phandle = <0x9b>;
		};
	};

	dwmmc@fe2b0000 {
		compatible = "rockchip,rk3568-dw-mshc", "rockchip,rk3288-dw-mshc";
		reg = <0x00 0xfe2b0000 0x00 0x4000>;
		interrupts = <0x00 0x62 0x04>;
		max-frequency = <0x8f0d180>;
		clocks = <0x1d 0xb0 0x1d 0xb1 0x1d 0x18a 0x1d 0x18b>;
		clock-names = "biu", "ciu", "ciu-drive", "ciu-sample";
		fifo-depth = <0x100>;
		resets = <0x1d 0xd4>;
		reset-names = "reset";
		status = "okay";
		supports-sd;
		bus-width = <0x04>;
		cap-mmc-highspeed;
		cap-sd-highspeed;
		disable-wp;
		sd-uhs-sdr104;
		vmmc-supply = <0x9d>;
		vqmmc-supply = <0x2a>;
		pinctrl-names = "default";
		pinctrl-0 = <0x9e 0x9f 0xa0 0xa1>;
		phandle = <0x191>;
	};

	dwmmc@fe2c0000 {
		compatible = "rockchip,rk3568-dw-mshc", "rockchip,rk3288-dw-mshc";
		reg = <0x00 0xfe2c0000 0x00 0x4000>;
		interrupts = <0x00 0x63 0x04>;
		max-frequency = <0x2faf080>;
		clocks = <0x1d 0xb2 0x1d 0xb3 0x1d 0x18c 0x1d 0x18d>;
		clock-names = "biu", "ciu", "ciu-drive", "ciu-sample";
		fifo-depth = <0x100>;
		resets = <0x1d 0xd6>;
		reset-names = "reset";
		status = "okay";
		supports-sdio;
		bus-width = <0x04>;
		disable-wp;
		cap-sd-highspeed;
		cap-sdio-irq;
		keep-power-in-suspend;
		mmc-pwrseq = <0xa2>;
		non-removable;
		pinctrl-names = "default";
		pinctrl-0 = <0xa3 0xa4 0xa5>;
		sd-uhs-sdr50;
		phandle = <0x192>;
	};

	sfc@fe300000 {
		compatible = "rockchip,sfc";
		reg = <0x00 0xfe300000 0x00 0x4000>;
		interrupts = <0x00 0x65 0x04>;
		clocks = <0x1d 0x78 0x1d 0x76>;
		clock-names = "clk_sfc", "hclk_sfc";
		assigned-clocks = <0x1d 0x78>;
		assigned-clock-rates = <0x5f5e100>;
		status = "disabled";
		phandle = <0x193>;
	};

	sdhci@fe310000 {
		compatible = "rockchip,dwcmshc-sdhci", "snps,dwcmshc-sdhci";
		reg = <0x00 0xfe310000 0x00 0x10000>;
		interrupts = <0x00 0x13 0x04>;
		assigned-clocks = <0x1d 0x7b 0x1d 0x7d>;
		assigned-clock-rates = <0xbebc200 0x16e3600>;
		clocks = <0x1d 0x7c 0x1d 0x7a 0x1d 0x79 0x1d 0x7b 0x1d 0x7d>;
		clock-names = "core", "bus", "axi", "block", "timer";
		status = "okay";
		bus-width = <0x08>;
		supports-emmc;
		non-removable;
		rockchip,txclk-tapnum = <0x08>;
		max-frequency = <0xbebc200>;
		mmc-hs400-1_8v;
		mmc-hs400-enhanced-strobe;
		phandle = <0x194>;
	};

	nandc@fe330000 {
		compatible = "rockchip,rk-nandc-v9";
		reg = <0x00 0xfe330000 0x00 0x4000>;
		interrupts = <0x00 0x46 0x04>;
		nandc_id = <0x00>;
		clocks = <0x1d 0x75 0x1d 0x74>;
		clock-names = "clk_nandc", "hclk_nandc";
		status = "okay";
		phandle = <0x195>;
	};

	crypto@fe380000 {
		compatible = "rockchip,rk3568-crypto";
		reg = <0x00 0xfe380000 0x00 0x4000>;
		interrupts = <0x00 0x04 0x04>;
		clocks = <0x1d 0x6a 0x1d 0x6b 0x1d 0x6c 0x1d 0x6d>;
		clock-names = "aclk", "hclk", "sclk", "apb_pclk";
		assigned-clocks = <0x1d 0x6c>;
		assigned-clock-rates = <0xbebc200>;
		resets = <0x1d 0x69>;
		reset-names = "crypto-rst";
		status = "disabled";
		phandle = <0x196>;
	};

	rng@fe388000 {
		compatible = "rockchip,cryptov2-rng";
		reg = <0x00 0xfe388000 0x00 0x2000>;
		clocks = <0x1d 0x70 0x1d 0x6f>;
		clock-names = "clk_trng", "hclk_trng";
		resets = <0x1d 0x6d>;
		reset-names = "reset";
		status = "okay";
		phandle = <0x197>;
	};

	otp@fe38c000 {
		compatible = "rockchip,rk3568-otp";
		reg = <0x00 0xfe38c000 0x00 0x4000>;
		#address-cells = <0x01>;
		#size-cells = <0x01>;
		clocks = <0x1d 0x73 0x1d 0x72 0x1d 0x71 0x1d 0x181>;
		clock-names = "usr", "sbpi", "apb", "phy";
		resets = <0x1d 0x1cf>;
		reset-names = "otp_phy";
		phandle = <0x198>;

		cpu-code@2 {
			reg = <0x02 0x02>;
			phandle = <0x0e>;
		};

		cpu-version@8 {
			reg = <0x08 0x01>;
			bits = <0x03 0x03>;
			phandle = <0x0d>;
		};

		mbist-vmin@9 {
			reg = <0x09 0x01>;
			bits = <0x00 0x04>;
			phandle = <0x07>;
		};

		id@a {
			reg = <0x0a 0x10>;
			phandle = <0x0c>;
		};

		cpu-leakage@1a {
			reg = <0x1a 0x01>;
			phandle = <0x05>;
		};

		log-leakage@1b {
			reg = <0x1b 0x01>;
			phandle = <0x9a>;
		};

		npu-leakage@1c {
			reg = <0x1c 0x01>;
			phandle = <0x5f>;
		};

		gpu-leakage@1d {
			reg = <0x1d 0x01>;
			phandle = <0x63>;
		};

		core-pvtm@2a {
			reg = <0x2a 0x02>;
			phandle = <0x06>;
		};
	};

	i2s@fe400000 {
		compatible = "rockchip,rk3568-i2s-tdm";
		reg = <0x00 0xfe400000 0x00 0x1000>;
		interrupts = <0x00 0x34 0x04>;
		clocks = <0x1d 0x3f 0x1d 0x43 0x1d 0x39>;
		clock-names = "mclk_tx", "mclk_rx", "hclk";
		dmas = <0xa6 0x00>;
		dma-names = "tx";
		resets = <0x1d 0x50 0x1d 0x51>;
		reset-names = "tx-m", "rx-m";
		rockchip,cru = <0x1d>;
		rockchip,grf = <0x31>;
		rockchip,playback-only;
		#sound-dai-cells = <0x00>;
		status = "okay";
		phandle = <0x11e>;
	};

	i2s@fe410000 {
		compatible = "rockchip,rk3568-i2s-tdm";
		reg = <0x00 0xfe410000 0x00 0x1000>;
		interrupts = <0x00 0x35 0x04>;
		clocks = <0x1d 0x47 0x1d 0x4b 0x1d 0x3a>;
		clock-names = "mclk_tx", "mclk_rx", "hclk";
		dmas = <0xa6 0x02 0xa6 0x03>;
		dma-names = "tx", "rx";
		resets = <0x1d 0x52 0x1d 0x53>;
		reset-names = "tx-m", "rx-m";
		rockchip,cru = <0x1d>;
		rockchip,grf = <0x31>;
		#sound-dai-cells = <0x00>;
		pinctrl-names = "default";
		pinctrl-0 = <0xa7 0xa8 0xa9 0xaa>;
		status = "okay";
		rockchip,clk-trcm = <0x01>;
		phandle = <0x121>;
	};

	i2s@fe420000 {
		compatible = "rockchip,rk3568-i2s-tdm";
		reg = <0x00 0xfe420000 0x00 0x1000>;
		interrupts = <0x00 0x36 0x04>;
		clocks = <0x1d 0x4f 0x1d 0x4f 0x1d 0x3b>;
		clock-names = "mclk_tx", "mclk_rx", "hclk";
		dmas = <0xa6 0x04 0xa6 0x05>;
		dma-names = "tx", "rx";
		rockchip,cru = <0x1d>;
		rockchip,grf = <0x31>;
		rockchip,clk-trcm = <0x01>;
		#sound-dai-cells = <0x00>;
		pinctrl-names = "default";
		pinctrl-0 = <0xab 0xac 0xad 0xae>;
		status = "disabled";
		phandle = <0x199>;
	};

	i2s@fe430000 {
		compatible = "rockchip,rk3568-i2s-tdm";
		reg = <0x00 0xfe430000 0x00 0x1000>;
		interrupts = <0x00 0x37 0x04>;
		clocks = <0x1d 0x53 0x1d 0x57 0x1d 0x3c>;
		clock-names = "mclk_tx", "mclk_rx", "hclk";
		dmas = <0xa6 0x06 0xa6 0x07>;
		dma-names = "tx", "rx";
		resets = <0x1d 0x55 0x1d 0x56>;
		reset-names = "tx-m", "rx-m";
		rockchip,cru = <0x1d>;
		rockchip,grf = <0x31>;
		rockchip,clk-trcm = <0x01>;
		#sound-dai-cells = <0x00>;
		pinctrl-names = "default";
		pinctrl-0 = <0xaf 0xb0 0xb1 0xb2>;
		status = "disabled";
		phandle = <0x19a>;
	};

	pdm@fe440000 {
		compatible = "rockchip,rk3568-pdm", "rockchip,pdm";
		reg = <0x00 0xfe440000 0x00 0x1000>;
		clocks = <0x1d 0x5a 0x1d 0x59>;
		clock-names = "pdm_clk", "pdm_hclk";
		dmas = <0xa6 0x09>;
		dma-names = "rx";
		pinctrl-names = "default";
		pinctrl-0 = <0xb3 0xb4 0xb5 0xb6 0xb7 0xb8>;
		#sound-dai-cells = <0x00>;
		status = "disabled";
		phandle = <0x19b>;
	};

	vad@fe450000 {
		compatible = "rockchip,rk3568-vad";
		reg = <0x00 0xfe450000 0x00 0x10000>;
		reg-names = "vad";
		clocks = <0x1d 0x5b>;
		clock-names = "hclk";
		interrupts = <0x00 0x89 0x04>;
		rockchip,audio-src = <0x00>;
		rockchip,det-channel = <0x00>;
		rockchip,mode = <0x00>;
		#sound-dai-cells = <0x00>;
		status = "disabled";
		phandle = <0x19c>;
	};

	spdif@fe460000 {
		compatible = "rockchip,rk3568-spdif";
		reg = <0x00 0xfe460000 0x00 0x1000>;
		interrupts = <0x00 0x66 0x04>;
		dmas = <0xa6 0x01>;
		dma-names = "tx";
		clock-names = "mclk", "hclk";
		clocks = <0x1d 0x5f 0x1d 0x5c>;
		#sound-dai-cells = <0x00>;
		pinctrl-names = "default";
		pinctrl-0 = <0xb9>;
		status = "disabled";
		phandle = <0x19d>;
	};

	audpwm@fe470000 {
		compatible = "rockchip,rk3568-audio-pwm", "rockchip,audio-pwm-v1";
		reg = <0x00 0xfe470000 0x00 0x1000>;
		clocks = <0x1d 0x63 0x1d 0x60>;
		clock-names = "clk", "hclk";
		dmas = <0xa6 0x08>;
		dma-names = "tx";
		#sound-dai-cells = <0x00>;
		rockchip,sample-width-bits = <0x0b>;
		rockchip,interpolat-points = <0x01>;
		status = "disabled";
		phandle = <0x19e>;
	};

	codec-digital@fe478000 {
		compatible = "rockchip,rk3568-codec-digital", "rockchip,codec-digital-v1";
		reg = <0x00 0xfe478000 0x00 0x1000>;
		clocks = <0x1d 0x67 0x1d 0x66 0x1d 0x65 0x1d 0x64>;
		clock-names = "adc", "dac", "i2c", "pclk";
		pinctrl-names = "default";
		pinctrl-0 = <0xba>;
		resets = <0x1d 0x5f>;
		reset-names = "reset";
		rockchip,grf = <0x31>;
		#sound-dai-cells = <0x00>;
		status = "disabled";
		phandle = <0x19f>;
	};

	dmac@fe530000 {
		compatible = "arm,pl330", "arm,primecell";
		reg = <0x00 0xfe530000 0x00 0x4000>;
		interrupts = <0x00 0x0e 0x04 0x00 0x0d 0x04>;
		clocks = <0x1d 0x10d>;
		clock-names = "apb_pclk";
		#dma-cells = <0x01>;
		arm,pl330-periph-burst;
		phandle = <0x3f>;
	};

	dmac@fe550000 {
		compatible = "arm,pl330", "arm,primecell";
		reg = <0x00 0xfe550000 0x00 0x4000>;
		interrupts = <0x00 0x10 0x04 0x00 0x0f 0x04>;
		clocks = <0x1d 0x10d>;
		clock-names = "apb_pclk";
		#dma-cells = <0x01>;
		arm,pl330-periph-burst;
		phandle = <0xa6>;
	};

	rkscr@fe560000 {
		compatible = "rockchip-scr";
		reg = <0x00 0xfe560000 0x00 0x10000>;
		interrupts = <0x00 0x61 0x04>;
		pinctrl-names = "default";
		pinctrl-0 = <0xbb>;
		clocks = <0x1d 0x114>;
		clock-names = "g_pclk_sim_card";
		status = "disabled";
		phandle = <0x1a0>;
	};

	can@fe570000 {
		compatible = "rockchip,canfd-1.0";
		reg = <0x00 0xfe570000 0x00 0x1000>;
		interrupts = <0x00 0x01 0x04>;
		clocks = <0x1d 0x141 0x1d 0x140>;
		clock-names = "baudclk", "apb_pclk";
		resets = <0x1d 0x155 0x1d 0x154>;
		reset-names = "can", "can-apb";
		tx-fifo-depth = <0x01>;
		rx-fifo-depth = <0x06>;
		status = "disabled";
		phandle = <0x1a1>;
	};

	can@fe580000 {
		compatible = "rockchip,canfd-1.0";
		reg = <0x00 0xfe580000 0x00 0x1000>;
		interrupts = <0x00 0x02 0x04>;
		clocks = <0x1d 0x143 0x1d 0x142>;
		clock-names = "baudclk", "apb_pclk";
		resets = <0x1d 0x157 0x1d 0x156>;
		reset-names = "can", "can-apb";
		tx-fifo-depth = <0x01>;
		rx-fifo-depth = <0x06>;
		status = "disabled";
		phandle = <0x1a2>;
	};

	can@fe590000 {
		compatible = "rockchip,canfd-1.0";
		reg = <0x00 0xfe590000 0x00 0x1000>;
		interrupts = <0x00 0x03 0x04>;
		clocks = <0x1d 0x145 0x1d 0x144>;
		clock-names = "baudclk", "apb_pclk";
		resets = <0x1d 0x159 0x1d 0x158>;
		reset-names = "can", "can-apb";
		tx-fifo-depth = <0x01>;
		rx-fifo-depth = <0x06>;
		status = "disabled";
		phandle = <0x1a3>;
	};

	i2c@fe5a0000 {
		compatible = "rockchip,rk3399-i2c";
		reg = <0x00 0xfe5a0000 0x00 0x1000>;
		clocks = <0x1d 0x148 0x1d 0x147>;
		clock-names = "i2c", "pclk";
		interrupts = <0x00 0x2f 0x04>;
		pinctrl-names = "default";
		pinctrl-0 = <0xbc>;
		#address-cells = <0x01>;
		#size-cells = <0x00>;
		status = "okay";
		clock-frequency = <0x61a80>;
		i2c-scl-rising-time-ns = <0x8a>;
		i2c-scl-falling-time-ns = <0x04>;
		phandle = <0x1a4>;

		ts@40 {
			status = "okay";
			compatible = "GSL,GSL3673_800X1280";
			reg = <0x40>;
			irq_gpio_number = <0x35 0x08 0x08>;
			rst_gpio_number = <0x35 0x12 0x04>;
		};

		gt9xx@5d {
			status = "okay";
			compatible = "goodix,gt9xx";
			reg = <0x5d>;
			pinctrl-names = "default";
			pinctrl-0 = <0xbd>;
			touch-gpio = <0x3e 0x08 0x08>;
			reset-gpio = <0x3e 0x09 0x04>;
			max-x = <0x500>;
			max-y = <0x320>;
			tp-size = <0x59>;
		};

		sensor@19 {
			compatible = "gs_sc7a20";
			reg = <0x19>;
			type = <0x02>;
			irq_enable = <0x00>;
			pinctrl-names = "default";
			pinctrl-0 = <0xbe>;
			irq-gpio = <0x3e 0x02 0x08>;
			poll_delay_ms = <0x0a>;
			layout = <0x07>;
			reprobe_en = <0x00>;
			swap_xy = <0x00>;
			revert_x = <0x00>;
			revert_y = <0x00>;
			revert_z = <0x00>;
			status = "okay";
		};

		sensorda@27 {
			status = "okay";
			compatible = "gs_da223";
			reg = <0x27>;
			type = <0x02>;
			irq_enable = <0x00>;
			poll_delay_ms = <0x1e>;
			layout = <0x06>;
			swap_xy = <0x01>;
			revert_x = <0x00>;
			revert_y = <0x01>;
			revert_z = <0x00>;
			power-off-in-suspend = <0x01>;
		};
	};

	i2c@fe5b0000 {
		compatible = "rockchip,rk3399-i2c";
		reg = <0x00 0xfe5b0000 0x00 0x1000>;
		clocks = <0x1d 0x14a 0x1d 0x149>;
		clock-names = "i2c", "pclk";
		interrupts = <0x00 0x30 0x04>;
		pinctrl-names = "default";
		pinctrl-0 = <0xbf>;
		#address-cells = <0x01>;
		#size-cells = <0x00>;
		status = "okay";
		phandle = <0x1a5>;

		dw9714@c {
			compatible = "dongwoon,dw9714";
			status = "okay";
			reg = <0x0c>;
			rockchip,camera-module-index = <0x00>;
			rockchip,vcm-start-current = <0x0a>;
			rockchip,vcm-rated-current = <0x32>;
			rockchip,vcm-step-mode = <0x05>;
			rockchip,camera-module-facing = "back";
			phandle = <0xc4>;
		};

		gc02m1@37 {
			compatible = "galaxycore,gc02m1";
			status = "okay";
			reg = <0x37>;
			clocks = <0x1d 0xd6>;
			clock-names = "xvclk";
			power-domains = <0x1f 0x08>;
			reset-gpios = <0xc0 0x08 0x00>;
			pwdn-gpios = <0xc0 0x0b 0x00>;
			rockchip,camera-module-index = <0x01>;
			rockchip,camera-module-facing = "front";
			rockchip,camera-module-name = "KYT-4877-V01";
			rockchip,camera-module-lens-name = "default";
			phandle = <0x1a6>;

			port {

				endpoint {
					remote-endpoint = <0xc1>;
					data-lanes = <0x01>;
					phandle = <0x10c>;
				};
			};
		};

		gc02m2@37 {
			compatible = "galaxycore,gc02m2";
			status = "okay";
			reg = <0x37>;
			clocks = <0x1d 0xd6>;
			clock-names = "xvclk";
			power-domains = <0x1f 0x08>;
			reset-gpios = <0xc0 0x08 0x00>;
			pwdn-gpios = <0xc0 0x0b 0x00>;
			rockchip,camera-module-index = <0x01>;
			rockchip,camera-module-facing = "front";
			rockchip,camera-module-name = "KYT-4877-V01";
			rockchip,camera-module-lens-name = "default";
			phandle = <0x1a7>;

			port {

				endpoint {
					remote-endpoint = <0xc2>;
					data-lanes = <0x01>;
					phandle = <0x109>;
				};
			};
		};

		gc02m3@37 {
			compatible = "galaxycore,gc02m3";
			status = "okay";
			reg = <0x37>;
			clocks = <0x1d 0xd6>;
			clock-names = "xvclk";
			power-domains = <0x1f 0x08>;
			reset-gpios = <0xc0 0x08 0x00>;
			pwdn-gpios = <0xc0 0x0a 0x00>;
			rockchip,camera-module-index = <0x00>;
			rockchip,camera-module-facing = "back";
			rockchip,camera-module-name = "KYT-4877-V01";
			rockchip,camera-module-lens-name = "default";
			phandle = <0x1a8>;

			port {

				endpoint {
					remote-endpoint = <0xc3>;
					data-lanes = <0x01>;
					phandle = <0x107>;
				};
			};
		};

		gc5035@37 {
			status = "okay";
			compatible = "galaxycore,gc5035";
			reg = <0x37>;
			clocks = <0x1d 0xd6>;
			clock-names = "xvclk";
			power-domains = <0x1f 0x08>;
			reset-gpios = <0xc0 0x07 0x00>;
			pwdn-gpios = <0xc0 0x0a 0x00>;
			rockchip,camera-module-index = <0x00>;
			rockchip,camera-module-facing = "back";
			rockchip,camera-module-name = "KYT-4877-V01";
			rockchip,camera-module-lens-name = "default";
			lens-focus = <0xc4>;
			phandle = <0x1a9>;

			port {

				endpoint {
					remote-endpoint = <0xc5>;
					data-lanes = <0x01 0x02>;
					phandle = <0x101>;
				};
			};
		};

		sp250a@3c {
			compatible = "superpix,sp250a";
			status = "okay";
			reg = <0x3c>;
			clocks = <0x1d 0xd6>;
			clock-names = "xvclk";
			power-domains = <0x1f 0x08>;
			reset-gpios = <0xc0 0x08 0x00>;
			pwdn-gpios = <0xc0 0x0b 0x00>;
			rockchip,camera-module-index = <0x01>;
			rockchip,camera-module-facing = "front";
			rockchip,camera-module-name = "LM50A60-S107-YK-XJL-V2";
			rockchip,camera-module-lens-name = "default";
			phandle = <0x1aa>;

			port {

				endpoint {
					remote-endpoint = <0xc6>;
					data-lanes = <0x01>;
					phandle = <0x10a>;
				};
			};
		};

		ov5670@36 {
			status = "okay";
			compatible = "ovti,ov5670";
			reg = <0x36>;
			clocks = <0x1d 0xd6>;
			clock-names = "xvclk";
			power-domains = <0x1f 0x08>;
			reset-gpios = <0xc0 0x07 0x00>;
			pwdn-gpios = <0xc0 0x0a 0x00>;
			rockchip,camera-module-index = <0x00>;
			rockchip,camera-module-facing = "back";
			rockchip,camera-module-name = "LM50A60-S107-YK-XJL-V2";
			rockchip,camera-module-lens-name = "default";
			flash-leds = <0xc7>;
			lens-focus = <0xc4>;
			phandle = <0x1ab>;

			port {

				endpoint {
					remote-endpoint = <0xc8>;
					data-lanes = <0x01 0x02>;
					phandle = <0x102>;
				};
			};
		};

		hi556@20 {
			status = "okay";
			compatible = "Hynix,hi556";
			reg = <0x20>;
			clocks = <0x1d 0xd6>;
			clock-names = "xvclk";
			power-domains = <0x1f 0x08>;
			reset-gpios = <0xc0 0x07 0x00>;
			pwdn-gpios = <0xc0 0x0a 0x00>;
			rockchip,camera-module-index = <0x00>;
			rockchip,camera-module-facing = "back";
			rockchip,camera-module-name = "KYT-8607-V1.0";
			rockchip,camera-module-lens-name = "default";
			flash-leds = <0xc7>;
			lens-focus = <0xc4>;
			phandle = <0x1ac>;

			port {

				endpoint {
					remote-endpoint = <0xc9>;
					data-lanes = <0x01 0x02>;
					phandle = <0x103>;
				};
			};
		};

		gc5025@37 {
			compatible = "galaxycore,gc5025";
			status = "okay";
			reg = <0x37>;
			clocks = <0x1d 0xd6>;
			clock-names = "xvclk";
			power-domains = <0x1f 0x08>;
			reset-gpios = <0xc0 0x08 0x01>;
			pwdn-gpios = <0xc0 0x0b 0x01>;
			rockchip,camera-module-index = <0x01>;
			rockchip,camera-module-facing = "front";
			rockchip,camera-module-name = "KYT-8647-V1.0";
			rockchip,camera-module-lens-name = "default";
			phandle = <0x1ad>;

			port {

				endpoint {
					remote-endpoint = <0xca>;
					data-lanes = <0x01 0x02>;
					phandle = <0x10b>;
				};
			};
		};

		gc8034@37 {
			status = "okay";
			compatible = "galaxycore,gc8034";
			reg = <0x37>;
			clocks = <0x1d 0xd6>;
			clock-names = "xvclk";
			power-domains = <0x1f 0x08>;
			reset-gpios = <0xc0 0x07 0x01>;
			pwdn-gpios = <0xc0 0x0a 0x01>;
			rockchip,camera-module-index = <0x00>;
			rockchip,camera-module-facing = "back";
			rockchip,camera-module-name = "KYT-8647-V1.0";
			rockchip,camera-module-lens-name = "default";
			flash-leds = <0xc7>;
			lens-focus = <0xc4>;
			phandle = <0x1ae>;

			port {

				endpoint {
					remote-endpoint = <0xcb>;
					data-lanes = <0x01 0x02>;
					phandle = <0x104>;
				};
			};
		};

		ov8858@36 {
			status = "okay";
			compatible = "ovti,ov8858";
			reg = <0x36>;
			clocks = <0x1d 0xd6>;
			clock-names = "xvclk";
			power-domains = <0x1f 0x08>;
			reset-gpios = <0xc0 0x09 0x00>;
			pwdn-gpios = <0xc0 0x0a 0x00>;
			rockchip,camera-module-index = <0x00>;
			rockchip,camera-module-facing = "back";
			rockchip,camera-module-name = "HS5885-BNSM1018-V01";
			rockchip,camera-module-lens-name = "default";
			flash-leds = <0xc7>;
			lens-focus = <0xc4>;
			phandle = <0x1af>;

			port {

				endpoint {
					remote-endpoint = <0xcc>;
					data-lanes = <0x01 0x02>;
					phandle = <0xff>;
				};
			};
		};

		hi846@20 {
			status = "okay";
			compatible = "Hynix,hi846";
			reg = <0x20>;
			clocks = <0x1d 0xd6>;
			clock-names = "xvclk";
			power-domains = <0x1f 0x08>;
			reset-gpios = <0xc0 0x07 0x00>;
			pwdn-gpios = <0xc0 0x0a 0x00>;
			rockchip,camera-module-index = <0x00>;
			rockchip,camera-module-facing = "back";
			rockchip,camera-module-name = "KYT-8648-V1.0";
			rockchip,camera-module-lens-name = "default";
			flash-leds = <0xc7>;
			lens-focus = <0xc4>;
			phandle = <0x1b0>;

			port {

				endpoint {
					remote-endpoint = <0xcd>;
					data-lanes = <0x01 0x02>;
					phandle = <0x105>;
				};
			};
		};

		ov5648@36 {
			status = "okay";
			compatible = "ovti,ov5648";
			reg = <0x36>;
			clocks = <0x1d 0xd6>;
			clock-names = "xvclk";
			power-domains = <0x1f 0x08>;
			reset-gpios = <0xc0 0x09 0x00>;
			pwdn-gpios = <0xc0 0x0a 0x00>;
			rockchip,camera-module-index = <0x00>;
			rockchip,camera-module-facing = "back";
			rockchip,camera-module-name = "HS5885-BNSM1018-V01";
			rockchip,camera-module-lens-name = "default";
			flash-leds = <0xc7>;
			lens-focus = <0xc4>;
			phandle = <0x1b1>;

			port {

				endpoint {
					remote-endpoint = <0xce>;
					data-lanes = <0x01 0x02>;
					phandle = <0x106>;
				};
			};
		};
	};

	i2c@fe5c0000 {
		compatible = "rockchip,rk3399-i2c";
		reg = <0x00 0xfe5c0000 0x00 0x1000>;
		clocks = <0x1d 0x14c 0x1d 0x14b>;
		clock-names = "i2c", "pclk";
		interrupts = <0x00 0x31 0x04>;
		pinctrl-names = "default";
		pinctrl-0 = <0xcf>;
		#address-cells = <0x01>;
		#size-cells = <0x00>;
		status = "disabled";
		phandle = <0x1b2>;
	};

	i2c@fe5d0000 {
		compatible = "rockchip,rk3399-i2c";
		reg = <0x00 0xfe5d0000 0x00 0x1000>;
		clocks = <0x1d 0x14e 0x1d 0x14d>;
		clock-names = "i2c", "pclk";
		interrupts = <0x00 0x32 0x04>;
		pinctrl-names = "default";
		pinctrl-0 = <0xd0>;
		#address-cells = <0x01>;
		#size-cells = <0x00>;
		status = "disabled";
		phandle = <0x1b3>;
	};

	i2c@fe5e0000 {
		compatible = "rockchip,rk3399-i2c";
		reg = <0x00 0xfe5e0000 0x00 0x1000>;
		clocks = <0x1d 0x150 0x1d 0x14f>;
		clock-names = "i2c", "pclk";
		interrupts = <0x00 0x33 0x04>;
		pinctrl-names = "default";
		pinctrl-0 = <0xd1>;
		#address-cells = <0x01>;
		#size-cells = <0x00>;
		status = "okay";
		clock-frequency = <0x61a80>;
		i2c-scl-rising-time-ns = <0x90>;
		i2c-scl-falling-time-ns = <0x04>;
		phandle = <0x1b4>;
	};

	timer@fe5f0000 {
		compatible = "rockchip,rk3568-timer", "rockchip,rk3288-timer";
		reg = <0x00 0xfe5f0000 0x00 0x1000>;
		interrupts = <0x00 0x6d 0x04>;
		clocks = <0x1d 0x16c 0x1d 0x16d>;
		clock-names = "pclk", "timer";
		phandle = <0x1b5>;
	};

	watchdog@fe600000 {
		compatible = "snps,dw-wdt";
		reg = <0x00 0xfe600000 0x00 0x100>;
		clocks = <0x1d 0x116 0x1d 0x115>;
		clock-names = "tclk", "pclk";
		interrupts = <0x00 0x95 0x04>;
		status = "okay";
		phandle = <0x1b6>;
	};

	spi@fe610000 {
		compatible = "rockchip,rk3066-spi";
		reg = <0x00 0xfe610000 0x00 0x1000>;
		interrupts = <0x00 0x67 0x04>;
		#address-cells = <0x01>;
		#size-cells = <0x00>;
		clocks = <0x1d 0x152 0x1d 0x151>;
		clock-names = "spiclk", "apb_pclk";
		dmas = <0x3f 0x14 0x3f 0x15>;
		dma-names = "tx", "rx";
		pinctrl-names = "default", "high_speed";
		pinctrl-0 = <0xd2 0xd3 0xd4>;
		pinctrl-1 = <0xd2 0xd3 0xd5>;
		status = "disabled";
		phandle = <0x1b7>;
	};

	spi@fe620000 {
		compatible = "rockchip,rk3066-spi";
		reg = <0x00 0xfe620000 0x00 0x1000>;
		interrupts = <0x00 0x68 0x04>;
		#address-cells = <0x01>;
		#size-cells = <0x00>;
		clocks = <0x1d 0x154 0x1d 0x153>;
		clock-names = "spiclk", "apb_pclk";
		dmas = <0x3f 0x16 0x3f 0x17>;
		dma-names = "tx", "rx";
		pinctrl-names = "default", "high_speed";
		pinctrl-0 = <0xd6 0xd7 0xd8>;
		pinctrl-1 = <0xd6 0xd7 0xd9>;
		status = "disabled";
		phandle = <0x1b8>;
	};

	spi@fe630000 {
		compatible = "rockchip,rk3066-spi";
		reg = <0x00 0xfe630000 0x00 0x1000>;
		interrupts = <0x00 0x69 0x04>;
		#address-cells = <0x01>;
		#size-cells = <0x00>;
		clocks = <0x1d 0x156 0x1d 0x155>;
		clock-names = "spiclk", "apb_pclk";
		dmas = <0x3f 0x18 0x3f 0x19>;
		dma-names = "tx", "rx";
		pinctrl-names = "default", "high_speed";
		pinctrl-0 = <0xda 0xdb 0xdc>;
		pinctrl-1 = <0xda 0xdb 0xdd>;
		status = "disabled";
		phandle = <0x1b9>;
	};

	spi@fe640000 {
		compatible = "rockchip,rk3066-spi";
		reg = <0x00 0xfe640000 0x00 0x1000>;
		interrupts = <0x00 0x6a 0x04>;
		#address-cells = <0x01>;
		#size-cells = <0x00>;
		clocks = <0x1d 0x158 0x1d 0x157>;
		clock-names = "spiclk", "apb_pclk";
		dmas = <0x3f 0x1a 0x3f 0x1b>;
		dma-names = "tx", "rx";
		pinctrl-names = "default", "high_speed";
		pinctrl-0 = <0xde 0xdf 0xe0>;
		pinctrl-1 = <0xde 0xdf 0xe1>;
		status = "disabled";
		phandle = <0x1ba>;
	};

	serial@fe650000 {
		compatible = "rockchip,rk3568-uart", "snps,dw-apb-uart";
		reg = <0x00 0xfe650000 0x00 0x100>;
		interrupts = <0x00 0x75 0x04>;
		clocks = <0x1d 0x11f 0x1d 0x11c>;
		clock-names = "baudclk", "apb_pclk";
		reg-shift = <0x02>;
		reg-io-width = <0x04>;
		dmas = <0x3f 0x02 0x3f 0x03>;
		pinctrl-names = "default";
		pinctrl-0 = <0xe2 0xe3>;
		status = "okay";
		phandle = <0x1bb>;
	};

	serial@fe660000 {
		compatible = "rockchip,rk3568-uart", "snps,dw-apb-uart";
		reg = <0x00 0xfe660000 0x00 0x100>;
		interrupts = <0x00 0x76 0x04>;
		clocks = <0x1d 0x123 0x1d 0x120>;
		clock-names = "baudclk", "apb_pclk";
		reg-shift = <0x02>;
		reg-io-width = <0x04>;
		dmas = <0x3f 0x04 0x3f 0x05>;
		pinctrl-names = "default";
		pinctrl-0 = <0xe4>;
		status = "disabled";
		phandle = <0x1bc>;
	};

	serial@fe670000 {
		compatible = "rockchip,rk3568-uart", "snps,dw-apb-uart";
		reg = <0x00 0xfe670000 0x00 0x100>;
		interrupts = <0x00 0x77 0x04>;
		clocks = <0x1d 0x127 0x1d 0x124>;
		clock-names = "baudclk", "apb_pclk";
		reg-shift = <0x02>;
		reg-io-width = <0x04>;
		dmas = <0x3f 0x06 0x3f 0x07>;
		pinctrl-names = "default";
		pinctrl-0 = <0xe5>;
		status = "disabled";
		phandle = <0x1bd>;
	};

	serial@fe680000 {
		compatible = "rockchip,rk3568-uart", "snps,dw-apb-uart";
		reg = <0x00 0xfe680000 0x00 0x100>;
		interrupts = <0x00 0x78 0x04>;
		clocks = <0x1d 0x12b 0x1d 0x128>;
		clock-names = "baudclk", "apb_pclk";
		reg-shift = <0x02>;
		reg-io-width = <0x04>;
		dmas = <0x3f 0x08 0x3f 0x09>;
		pinctrl-names = "default";
		pinctrl-0 = <0xe6>;
		status = "disabled";
		phandle = <0x1be>;
	};

	serial@fe690000 {
		compatible = "rockchip,rk3568-uart", "snps,dw-apb-uart";
		reg = <0x00 0xfe690000 0x00 0x100>;
		interrupts = <0x00 0x79 0x04>;
		clocks = <0x1d 0x12f 0x1d 0x12c>;
		clock-names = "baudclk", "apb_pclk";
		reg-shift = <0x02>;
		reg-io-width = <0x04>;
		dmas = <0x3f 0x0a 0x3f 0x0b>;
		pinctrl-names = "default";
		pinctrl-0 = <0xe7>;
		status = "disabled";
		phandle = <0x1bf>;
	};

	serial@fe6a0000 {
		compatible = "rockchip,rk3568-uart", "snps,dw-apb-uart";
		reg = <0x00 0xfe6a0000 0x00 0x100>;
		interrupts = <0x00 0x7a 0x04>;
		clocks = <0x1d 0x133 0x1d 0x130>;
		clock-names = "baudclk", "apb_pclk";
		reg-shift = <0x02>;
		reg-io-width = <0x04>;
		dmas = <0x3f 0x0c 0x3f 0x0d>;
		pinctrl-names = "default";
		pinctrl-0 = <0xe8>;
		status = "disabled";
		phandle = <0x1c0>;
	};

	serial@fe6b0000 {
		compatible = "rockchip,rk3568-uart", "snps,dw-apb-uart";
		reg = <0x00 0xfe6b0000 0x00 0x100>;
		interrupts = <0x00 0x7b 0x04>;
		clocks = <0x1d 0x137 0x1d 0x134>;
		clock-names = "baudclk", "apb_pclk";
		reg-shift = <0x02>;
		reg-io-width = <0x04>;
		dmas = <0x3f 0x0e 0x3f 0x0f>;
		pinctrl-names = "default";
		pinctrl-0 = <0xe9>;
		status = "disabled";
		phandle = <0x1c1>;
	};

	serial@fe6c0000 {
		compatible = "rockchip,rk3568-uart", "snps,dw-apb-uart";
		reg = <0x00 0xfe6c0000 0x00 0x100>;
		interrupts = <0x00 0x7c 0x04>;
		clocks = <0x1d 0x13b 0x1d 0x138>;
		clock-names = "baudclk", "apb_pclk";
		reg-shift = <0x02>;
		reg-io-width = <0x04>;
		dmas = <0x3f 0x10 0x3f 0x11>;
		pinctrl-names = "default";
		pinctrl-0 = <0xea>;
		status = "disabled";
		phandle = <0x1c2>;
	};

	serial@fe6d0000 {
		compatible = "rockchip,rk3568-uart", "snps,dw-apb-uart";
		reg = <0x00 0xfe6d0000 0x00 0x100>;
		interrupts = <0x00 0x7d 0x04>;
		clocks = <0x1d 0x13f 0x1d 0x13c>;
		clock-names = "baudclk", "apb_pclk";
		reg-shift = <0x02>;
		reg-io-width = <0x04>;
		dmas = <0x3f 0x12 0x3f 0x13>;
		pinctrl-names = "default";
		pinctrl-0 = <0xeb>;
		status = "disabled";
		phandle = <0x1c3>;
	};

	pwm@fe6e0000 {
		compatible = "rockchip,rk3568-pwm", "rockchip,rk3328-pwm";
		reg = <0x00 0xfe6e0000 0x00 0x10>;
		#pwm-cells = <0x03>;
		pinctrl-names = "active";
		pinctrl-0 = <0xec>;
		clocks = <0x1d 0x15a 0x1d 0x159>;
		clock-names = "pwm", "pclk";
		status = "disabled";
		phandle = <0x1c4>;
	};

	pwm@fe6e0010 {
		compatible = "rockchip,rk3568-pwm", "rockchip,rk3328-pwm";
		reg = <0x00 0xfe6e0010 0x00 0x10>;
		#pwm-cells = <0x03>;
		pinctrl-names = "active";
		pinctrl-0 = <0xed>;
		clocks = <0x1d 0x15a 0x1d 0x159>;
		clock-names = "pwm", "pclk";
		status = "disabled";
		phandle = <0x1c5>;
	};

	pwm@fe6e0020 {
		compatible = "rockchip,rk3568-pwm", "rockchip,rk3328-pwm";
		reg = <0x00 0xfe6e0020 0x00 0x10>;
		#pwm-cells = <0x03>;
		pinctrl-names = "active";
		pinctrl-0 = <0xee>;
		clocks = <0x1d 0x15a 0x1d 0x159>;
		clock-names = "pwm", "pclk";
		status = "disabled";
		phandle = <0x1c6>;
	};

	pwm@fe6e0030 {
		compatible = "rockchip,rk3568-pwm", "rockchip,rk3328-pwm";
		reg = <0x00 0xfe6e0030 0x00 0x10>;
		interrupts = <0x00 0x53 0x04 0x00 0x57 0x04>;
		#pwm-cells = <0x03>;
		pinctrl-names = "active";
		pinctrl-0 = <0xef>;
		clocks = <0x1d 0x15a 0x1d 0x159>;
		clock-names = "pwm", "pclk";
		status = "disabled";
		phandle = <0x1c7>;
	};

	pwm@fe6f0000 {
		compatible = "rockchip,rk3568-pwm", "rockchip,rk3328-pwm";
		reg = <0x00 0xfe6f0000 0x00 0x10>;
		#pwm-cells = <0x03>;
		pinctrl-names = "active";
		pinctrl-0 = <0xf0>;
		clocks = <0x1d 0x15d 0x1d 0x15c>;
		clock-names = "pwm", "pclk";
		status = "disabled";
		phandle = <0x1c8>;
	};

	pwm@fe6f0010 {
		compatible = "rockchip,rk3568-pwm", "rockchip,rk3328-pwm";
		reg = <0x00 0xfe6f0010 0x00 0x10>;
		#pwm-cells = <0x03>;
		pinctrl-names = "active";
		pinctrl-0 = <0xf1>;
		clocks = <0x1d 0x15d 0x1d 0x15c>;
		clock-names = "pwm", "pclk";
		status = "disabled";
		phandle = <0x1c9>;
	};

	pwm@fe6f0020 {
		compatible = "rockchip,rk3568-pwm", "rockchip,rk3328-pwm";
		reg = <0x00 0xfe6f0020 0x00 0x10>;
		#pwm-cells = <0x03>;
		pinctrl-names = "active";
		pinctrl-0 = <0xf2>;
		clocks = <0x1d 0x15d 0x1d 0x15c>;
		clock-names = "pwm", "pclk";
		status = "disabled";
		phandle = <0x1ca>;
	};

	pwm@fe6f0030 {
		compatible = "rockchip,rk3568-pwm", "rockchip,rk3328-pwm";
		reg = <0x00 0xfe6f0030 0x00 0x10>;
		interrupts = <0x00 0x54 0x04 0x00 0x58 0x04>;
		#pwm-cells = <0x03>;
		pinctrl-names = "active";
		pinctrl-0 = <0xf3>;
		clocks = <0x1d 0x15d 0x1d 0x15c>;
		clock-names = "pwm", "pclk";
		status = "disabled";
		phandle = <0x1cb>;
	};

	pwm@fe700000 {
		compatible = "rockchip,rk3568-pwm", "rockchip,rk3328-pwm";
		reg = <0x00 0xfe700000 0x00 0x10>;
		#pwm-cells = <0x03>;
		pinctrl-names = "active";
		pinctrl-0 = <0xf4>;
		clocks = <0x1d 0x160 0x1d 0x15f>;
		clock-names = "pwm", "pclk";
		status = "disabled";
		phandle = <0x1cc>;
	};

	pwm@fe700010 {
		compatible = "rockchip,rk3568-pwm", "rockchip,rk3328-pwm";
		reg = <0x00 0xfe700010 0x00 0x10>;
		#pwm-cells = <0x03>;
		pinctrl-names = "active";
		pinctrl-0 = <0xf5>;
		clocks = <0x1d 0x160 0x1d 0x15f>;
		clock-names = "pwm", "pclk";
		status = "disabled";
		phandle = <0x1cd>;
	};

	pwm@fe700020 {
		compatible = "rockchip,rk3568-pwm", "rockchip,rk3328-pwm";
		reg = <0x00 0xfe700020 0x00 0x10>;
		#pwm-cells = <0x03>;
		pinctrl-names = "active";
		pinctrl-0 = <0xf6>;
		clocks = <0x1d 0x160 0x1d 0x15f>;
		clock-names = "pwm", "pclk";
		status = "okay";
		phandle = <0x11c>;
	};

	pwm@fe700030 {
		compatible = "rockchip,rk3568-pwm", "rockchip,rk3328-pwm";
		reg = <0x00 0xfe700030 0x00 0x10>;
		interrupts = <0x00 0x55 0x04 0x00 0x59 0x04>;
		#pwm-cells = <0x03>;
		pinctrl-names = "active";
		pinctrl-0 = <0xf7>;
		clocks = <0x1d 0x160 0x1d 0x15f>;
		clock-names = "pwm", "pclk";
		status = "disabled";
		phandle = <0x1ce>;
	};

	tsadc@fe710000 {
		compatible = "rockchip,rk3568-tsadc";
		reg = <0x00 0xfe710000 0x00 0x100>;
		interrupts = <0x00 0x73 0x04>;
		rockchip,grf = <0x31>;
		clocks = <0x1d 0x111 0x1d 0x10f>;
		clock-names = "tsadc", "apb_pclk";
		assigned-clocks = <0x1d 0x110 0x1d 0x111>;
		assigned-clock-rates = <0x1036640 0xaae60>;
		resets = <0x1d 0x182 0x1d 0x181 0x1d 0x1d7>;
		reset-names = "tsadc", "tsadc-apb", "tsadc-phy";
		#thermal-sensor-cells = <0x01>;
		rockchip,hw-tshut-temp = <0x1d4c0>;
		rockchip,hw-tshut-mode = <0x00>;
		rockchip,hw-tshut-polarity = <0x00>;
		pinctrl-names = "gpio", "otpout";
		pinctrl-0 = <0xf8>;
		pinctrl-1 = <0xf9>;
		status = "okay";
		phandle = <0x1a>;
	};

	saradc@fe720000 {
		compatible = "rockchip,rk3568-saradc", "rockchip,rk3399-saradc";
		reg = <0x00 0xfe720000 0x00 0x100>;
		interrupts = <0x00 0x5d 0x04>;
		#io-channel-cells = <0x01>;
		clocks = <0x1d 0x113 0x1d 0x112>;
		clock-names = "saradc", "apb_pclk";
		resets = <0x1d 0x180>;
		reset-names = "saradc-apb";
		status = "okay";
		vref-supply = <0xfa>;
		phandle = <0x11b>;
	};

	mailbox@fe780000 {
		compatible = "rockchip,rk3568-mailbox", "rockchip,rk3368-mailbox";
		reg = <0x00 0xfe780000 0x00 0x1000>;
		interrupts = <0x00 0xb7 0x04 0x00 0xb8 0x04 0x00 0xb9 0x04 0x00 0xba 0x04>;
		clocks = <0x1d 0x11b>;
		clock-names = "pclk_mailbox";
		#mbox-cells = <0x01>;
		status = "disabled";
		phandle = <0x1cf>;
	};

	phy@fe830000 {
		compatible = "rockchip,rk3568-naneng-combphy";
		reg = <0x00 0xfe830000 0x00 0x100>;
		#phy-cells = <0x01>;
		clocks = <0x30 0x22 0x1d 0x17d 0x1d 0x7f>;
		clock-names = "refclk", "apbclk", "pipe_clk";
		assigned-clocks = <0x30 0x22>;
		assigned-clock-rates = <0x5f5e100>;
		resets = <0x1d 0x1c6 0x1d 0x1c7>;
		reset-names = "combphy-apb", "combphy";
		rockchip,pipe-grf = <0xfb>;
		rockchip,pipe-phy-grf = <0xfc>;
		status = "disabled";
		phandle = <0x1e>;
	};

	phy@fe840000 {
		compatible = "rockchip,rk3568-naneng-combphy";
		reg = <0x00 0xfe840000 0x00 0x100>;
		#phy-cells = <0x01>;
		clocks = <0x30 0x25 0x1d 0x17e 0x1d 0x7f>;
		clock-names = "refclk", "apbclk", "pipe_clk";
		assigned-clocks = <0x30 0x25>;
		assigned-clock-rates = <0x5f5e100>;
		resets = <0x1d 0x1c8 0x1d 0x1c9>;
		reset-names = "combphy-apb", "combphy";
		rockchip,pipe-grf = <0xfb>;
		rockchip,pipe-phy-grf = <0xfd>;
		status = "disabled";
		phandle = <0x20>;
	};

	video-phy@fe850000 {
		compatible = "rockchip,rk3568-video-phy";
		reg = <0x00 0xfe850000 0x00 0x10000 0x00 0xfe060000 0x00 0x10000>;
		clocks = <0x30 0x17 0x1d 0x17a 0x1d 0xe8>;
		clock-names = "ref", "pclk_phy", "pclk_host";
		#clock-cells = <0x00>;
		resets = <0x1d 0x1bb>;
		reset-names = "rst";
		power-domains = <0x1f 0x09>;
		#phy-cells = <0x00>;
		status = "okay";
		phandle = <0x2d>;
	};

	video-phy@fe860000 {
		compatible = "rockchip,rk3568-video-phy";
		reg = <0x00 0xfe860000 0x00 0x10000 0x00 0xfe070000 0x00 0x10000>;
		clocks = <0x30 0x19 0x1d 0x17b 0x1d 0xe9>;
		clock-names = "ref", "pclk_phy", "pclk_host";
		#clock-cells = <0x00>;
		resets = <0x1d 0x1bc>;
		reset-names = "rst";
		power-domains = <0x1f 0x09>;
		#phy-cells = <0x00>;
		status = "disabled";
		phandle = <0x8e>;
	};

	csi2-dphy-hw@fe870000 {
		compatible = "rockchip,rk3568-csi2-dphy-hw";
		reg = <0x00 0xfe870000 0x00 0x1000>;
		clocks = <0x1d 0x179>;
		clock-names = "pclk";
		rockchip,grf = <0x31>;
		status = "okay";
		phandle = <0xfe>;
	};

	csi2-dphy0 {
		compatible = "rockchip,rk3568-csi2-dphy";
		rockchip,hw = <0xfe>;
		status = "disabled";
		phandle = <0x1d0>;

		ports {
			#address-cells = <0x01>;
			#size-cells = <0x00>;

			port@0 {
				reg = <0x00>;
				#address-cells = <0x01>;
				#size-cells = <0x00>;

				endpoint@2 {
					reg = <0x02>;
					remote-endpoint = <0xff>;
					data-lanes = <0x01 0x02 0x03 0x04>;
					phandle = <0x1d1>;
				};
			};

			port@1 {
				reg = <0x01>;
				#address-cells = <0x01>;
				#size-cells = <0x00>;

				endpoint@0 {
					reg = <0x00>;
					remote-endpoint = <0x100>;
					phandle = <0x75>;
				};
			};
		};
	};

	csi2-dphy1 {
		compatible = "rockchip,rk3568-csi2-dphy";
		rockchip,hw = <0xfe>;
		status = "okay";
		phandle = <0x1d2>;

		ports {
			#address-cells = <0x01>;
			#size-cells = <0x00>;

			port@0 {
				reg = <0x00>;
				#address-cells = <0x01>;
				#size-cells = <0x00>;

				endpoint@1 {
					reg = <0x01>;
					remote-endpoint = <0x101>;
					data-lanes = <0x01 0x02>;
					phandle = <0xc5>;
				};

				endpoint@2 {
					reg = <0x02>;
					remote-endpoint = <0x102>;
					data-lanes = <0x01 0x02>;
					phandle = <0xc8>;
				};

				endpoint@4 {
					reg = <0x04>;
					remote-endpoint = <0x103>;
					data-lanes = <0x01 0x02>;
					phandle = <0xc9>;
				};

				endpoint@5 {
					reg = <0x05>;
					remote-endpoint = <0x104>;
					data-lanes = <0x01 0x02>;
					phandle = <0xcb>;
				};

				endpoint@6 {
					reg = <0x06>;
					remote-endpoint = <0x105>;
					data-lanes = <0x01 0x02>;
					phandle = <0xcd>;
				};

				endpoint@7 {
					reg = <0x07>;
					remote-endpoint = <0x106>;
					data-lanes = <0x01 0x02>;
					phandle = <0xce>;
				};

				endpoint@8 {
					reg = <0x08>;
					remote-endpoint = <0xff>;
					data-lanes = <0x01 0x02>;
					phandle = <0xcc>;
				};

				endpoint@9 {
					reg = <0x09>;
					remote-endpoint = <0x107>;
					data-lanes = <0x01>;
					phandle = <0xc3>;
				};
			};

			port@1 {
				reg = <0x01>;
				#address-cells = <0x01>;
				#size-cells = <0x00>;

				endpoint@1 {
					reg = <0x01>;
					remote-endpoint = <0x108>;
					phandle = <0x76>;
				};
			};
		};
	};

	csi2-dphy2 {
		compatible = "rockchip,rk3568-csi2-dphy";
		rockchip,hw = <0xfe>;
		status = "okay";
		phandle = <0x1d3>;

		ports {
			#address-cells = <0x01>;
			#size-cells = <0x00>;

			port@0 {
				reg = <0x00>;
				#address-cells = <0x01>;
				#size-cells = <0x00>;

				endpoint@1 {
					reg = <0x01>;
					remote-endpoint = <0x109>;
					data-lanes = <0x01>;
					phandle = <0xc2>;
				};

				endpoint@0 {
					reg = <0x00>;
					remote-endpoint = <0x10a>;
					data-lanes = <0x01>;
					phandle = <0xc6>;
				};

				endpoint@2 {
					reg = <0x02>;
					remote-endpoint = <0x10b>;
					data-lanes = <0x01 0x02>;
					phandle = <0xca>;
				};

				endpoint@3 {
					reg = <0x03>;
					remote-endpoint = <0x10c>;
					data-lanes = <0x01>;
					phandle = <0xc1>;
				};
			};

			port@1 {
				reg = <0x01>;
				#address-cells = <0x01>;
				#size-cells = <0x00>;

				endpoint@1 {
					reg = <0x01>;
					remote-endpoint = <0x10d>;
					phandle = <0x77>;
				};
			};
		};
	};

	usb2-phy@fe8a0000 {
		compatible = "rockchip,rk3568-usb2phy";
		reg = <0x00 0xfe8a0000 0x00 0x10000>;
		interrupts = <0x00 0x87 0x04>;
		clocks = <0x30 0x13>;
		clock-names = "phyclk";
		#clock-cells = <0x00>;
		assigned-clocks = <0x1d 0x0b>;
		assigned-clock-parents = <0x22>;
		clock-output-names = "usb480m_phy";
		rockchip,usbgrf = <0x10e>;
		status = "okay";
		phandle = <0x22>;

		host-port {
			#phy-cells = <0x00>;
			status = "disabled";
			phandle = <0x23>;
		};

		otg-port {
			#phy-cells = <0x00>;
			status = "okay";
			phandle = <0x21>;
		};
	};

	usb2-phy@fe8b0000 {
		compatible = "rockchip,rk3568-usb2phy";
		reg = <0x00 0xfe8b0000 0x00 0x10000>;
		interrupts = <0x00 0x88 0x04>;
		clocks = <0x30 0x15>;
		clock-names = "phyclk";
		#clock-cells = <0x00>;
		rockchip,usbgrf = <0x10f>;
		status = "disabled";
		phandle = <0x24>;

		host-port {
			#phy-cells = <0x00>;
			status = "disabled";
			phandle = <0x26>;
		};

		otg-port {
			#phy-cells = <0x00>;
			status = "disabled";
			phandle = <0x25>;
		};
	};

	pinctrl {
		compatible = "rockchip,rk3568-pinctrl";
		rockchip,grf = <0x31>;
		rockchip,pmu = <0x32>;
		#address-cells = <0x02>;
		#size-cells = <0x02>;
		ranges;
		phandle = <0x110>;

		gpio@fdd60000 {
			compatible = "rockchip,gpio-bank";
			reg = <0x00 0xfdd60000 0x00 0x100>;
			interrupts = <0x00 0x21 0x04>;
			clocks = <0x30 0x2e 0x30 0x0c>;
			gpio-controller;
			#gpio-cells = <0x02>;
			gpio-ranges = <0x110 0x00 0x00 0x20>;
			interrupt-controller;
			#interrupt-cells = <0x02>;
			phandle = <0x35>;
		};

		gpio@fe740000 {
			compatible = "rockchip,gpio-bank";
			reg = <0x00 0xfe740000 0x00 0x100>;
			interrupts = <0x00 0x22 0x04>;
			clocks = <0x1d 0x163 0x1d 0x164>;
			gpio-controller;
			#gpio-cells = <0x02>;
			gpio-ranges = <0x110 0x00 0x20 0x20>;
			interrupt-controller;
			#interrupt-cells = <0x02>;
			phandle = <0x1d4>;
		};

		gpio@fe750000 {
			compatible = "rockchip,gpio-bank";
			reg = <0x00 0xfe750000 0x00 0x100>;
			interrupts = <0x00 0x23 0x04>;
			clocks = <0x1d 0x165 0x1d 0x166>;
			gpio-controller;
			#gpio-cells = <0x02>;
			gpio-ranges = <0x110 0x00 0x40 0x20>;
			interrupt-controller;
			#interrupt-cells = <0x02>;
			phandle = <0x129>;
		};

		gpio@fe760000 {
			compatible = "rockchip,gpio-bank";
			reg = <0x00 0xfe760000 0x00 0x100>;
			interrupts = <0x00 0x24 0x04>;
			clocks = <0x1d 0x167 0x1d 0x168>;
			gpio-controller;
			#gpio-cells = <0x02>;
			gpio-ranges = <0x110 0x00 0x60 0x20>;
			interrupt-controller;
			#interrupt-cells = <0x02>;
			phandle = <0x3e>;
		};

		gpio@fe770000 {
			compatible = "rockchip,gpio-bank";
			reg = <0x00 0xfe770000 0x00 0x100>;
			interrupts = <0x00 0x25 0x04>;
			clocks = <0x1d 0x169 0x1d 0x16a>;
			gpio-controller;
			#gpio-cells = <0x02>;
			gpio-ranges = <0x110 0x00 0x80 0x20>;
			interrupt-controller;
			#interrupt-cells = <0x02>;
			phandle = <0xc0>;
		};

		pcfg-pull-up {
			bias-pull-up;
			phandle = <0x113>;
		};

		pcfg-pull-down {
			bias-pull-down;
			phandle = <0x11a>;
		};

		pcfg-pull-none {
			bias-disable;
			phandle = <0x111>;
		};

		pcfg-pull-none-drv-level-1 {
			bias-disable;
			drive-strength = <0x01>;
			phandle = <0x115>;
		};

		pcfg-pull-none-drv-level-2 {
			bias-disable;
			drive-strength = <0x02>;
			phandle = <0x114>;
		};

		pcfg-pull-none-drv-level-3 {
			bias-disable;
			drive-strength = <0x03>;
			phandle = <0x119>;
		};

		pcfg-pull-up-drv-level-1 {
			bias-pull-up;
			drive-strength = <0x01>;
			phandle = <0x118>;
		};

		pcfg-pull-up-drv-level-2 {
			bias-pull-up;
			drive-strength = <0x02>;
			phandle = <0x112>;
		};

		pcfg-pull-none-smt {
			bias-disable;
			input-schmitt-enable;
			phandle = <0x116>;
		};

		pcfg-output-low {
			output-low;
			phandle = <0x117>;
		};

		acodec {

			acodec-pins {
				rockchip,pins = <0x01 0x09 0x05 0x111 0x01 0x01 0x05 0x111 0x01 0x00 0x05 0x111 0x01 0x07 0x05 0x111 0x01 0x08 0x05 0x111 0x01 0x03 0x05 0x111 0x01 0x05 0x05 0x111>;
				phandle = <0xba>;
			};
		};

		cam {

			camera-rst {
				rockchip,pins = <0x04 0x09 0x00 0x111>;
				phandle = <0x1d5>;
			};

			camera-af {
				rockchip,pins = <0x04 0x07 0x00 0x111>;
				phandle = <0x120>;
			};

			flash-led {
				rockchip,pins = <0x04 0x06 0x00 0x111>;
				phandle = <0x11d>;
			};
		};

		cif {

			cif-clk {
				rockchip,pins = <0x04 0x10 0x01 0x111>;
				phandle = <0x74>;
			};
		};

		ebc {

			ebc-pins {
				rockchip,pins = <0x04 0x10 0x02 0x111 0x04 0x0b 0x02 0x111 0x04 0x0c 0x02 0x111 0x04 0x06 0x02 0x111 0x04 0x11 0x02 0x111 0x03 0x16 0x02 0x111 0x03 0x17 0x02 0x111 0x03 0x18 0x02 0x111 0x03 0x19 0x02 0x111 0x03 0x1a 0x02 0x111 0x03 0x1b 0x02 0x111 0x03 0x1c 0x02 0x111 0x03 0x1d 0x02 0x111 0x03 0x1e 0x02 0x111 0x03 0x1f 0x02 0x111 0x04 0x00 0x02 0x111 0x04 0x01 0x02 0x111 0x04 0x02 0x02 0x111 0x04 0x03 0x02 0x111 0x04 0x04 0x02 0x111 0x04 0x05 0x02 0x111 0x04 0x0e 0x02 0x111 0x04 0x0f 0x02 0x111>;
				phandle = <0x66>;
			};
		};

		hdmitx {

			hdmitxm0-cec {
				rockchip,pins = <0x04 0x19 0x01 0x111>;
				phandle = <0x92>;
			};

			hdmitx-scl {
				rockchip,pins = <0x04 0x17 0x01 0x111>;
				phandle = <0x90>;
			};

			hdmitx-sda {
				rockchip,pins = <0x04 0x18 0x01 0x111>;
				phandle = <0x91>;
			};
		};

		i2c0 {

			i2c0-xfer {
				rockchip,pins = <0x00 0x09 0x01 0x116 0x00 0x0a 0x01 0x116>;
				phandle = <0x33>;
			};
		};

		i2c1 {

			i2c1-xfer {
				rockchip,pins = <0x00 0x0b 0x01 0x116 0x00 0x0c 0x01 0x116>;
				phandle = <0xbc>;
			};
		};

		i2c2 {

			i2c2m1-xfer {
				rockchip,pins = <0x04 0x0d 0x01 0x116 0x04 0x0c 0x01 0x116>;
				phandle = <0xbf>;
			};
		};

		i2c3 {

			i2c3m0-xfer {
				rockchip,pins = <0x01 0x01 0x01 0x116 0x01 0x00 0x01 0x116>;
				phandle = <0xcf>;
			};
		};

		i2c4 {

			i2c4m0-xfer {
				rockchip,pins = <0x04 0x0b 0x01 0x116 0x04 0x0a 0x01 0x116>;
				phandle = <0xd0>;
			};
		};

		i2c5 {

			i2c5m0-xfer {
				rockchip,pins = <0x03 0x0b 0x04 0x116 0x03 0x0c 0x04 0x116>;
				phandle = <0xd1>;
			};
		};

		i2s1 {

			i2s1m0-lrcktx {
				rockchip,pins = <0x01 0x05 0x01 0x111>;
				phandle = <0xa8>;
			};

			i2s1m0-mclk {
				rockchip,pins = <0x01 0x02 0x01 0x111>;
				phandle = <0x3d>;
			};

			i2s1m0-sclktx {
				rockchip,pins = <0x01 0x03 0x01 0x111>;
				phandle = <0xa7>;
			};

			i2s1m0-sdi0 {
				rockchip,pins = <0x01 0x0b 0x01 0x111>;
				phandle = <0xa9>;
			};

			i2s1m0-sdo0 {
				rockchip,pins = <0x01 0x07 0x01 0x111>;
				phandle = <0xaa>;
			};
		};

		i2s2 {

			i2s2m0-lrcktx {
				rockchip,pins = <0x02 0x13 0x01 0x111>;
				phandle = <0xac>;
			};

			i2s2m0-sclktx {
				rockchip,pins = <0x02 0x12 0x01 0x111>;
				phandle = <0xab>;
			};

			i2s2m0-sdi {
				rockchip,pins = <0x02 0x15 0x01 0x111>;
				phandle = <0xad>;
			};

			i2s2m0-sdo {
				rockchip,pins = <0x02 0x14 0x01 0x111>;
				phandle = <0xae>;
			};
		};

		i2s3 {

			i2s3m0-lrck {
				rockchip,pins = <0x03 0x04 0x04 0x111>;
				phandle = <0xb0>;
			};

			i2s3m0-sclk {
				rockchip,pins = <0x03 0x03 0x04 0x111>;
				phandle = <0xaf>;
			};

			i2s3m0-sdi {
				rockchip,pins = <0x03 0x06 0x04 0x111>;
				phandle = <0xb1>;
			};

			i2s3m0-sdo {
				rockchip,pins = <0x03 0x05 0x04 0x111>;
				phandle = <0xb2>;
			};
		};

		lcdc {

			lcdc-ctl {
				rockchip,pins = <0x03 0x00 0x01 0x111 0x02 0x18 0x01 0x111 0x02 0x19 0x01 0x111 0x02 0x1a 0x01 0x111 0x02 0x1b 0x01 0x111 0x02 0x1c 0x01 0x111 0x02 0x1d 0x01 0x111 0x02 0x1e 0x01 0x111 0x02 0x1f 0x01 0x111 0x03 0x01 0x01 0x111 0x03 0x02 0x01 0x111 0x03 0x03 0x01 0x111 0x03 0x04 0x01 0x111 0x03 0x05 0x01 0x111 0x03 0x06 0x01 0x111 0x03 0x07 0x01 0x111 0x03 0x08 0x01 0x111 0x03 0x09 0x01 0x111 0x03 0x0a 0x01 0x111 0x03 0x0b 0x01 0x111 0x03 0x0c 0x01 0x111 0x03 0x0d 0x01 0x111 0x03 0x0e 0x01 0x111 0x03 0x0f 0x01 0x111 0x03 0x10 0x01 0x111 0x03 0x13 0x01 0x111 0x03 0x11 0x01 0x111 0x03 0x12 0x01 0x111>;
				phandle = <0x2f>;
			};
		};

		pdm {

			pdmm0-clk {
				rockchip,pins = <0x01 0x06 0x03 0x111>;
				phandle = <0xb3>;
			};

			pdmm0-clk1 {
				rockchip,pins = <0x01 0x04 0x03 0x111>;
				phandle = <0xb4>;
			};

			pdmm0-sdi0 {
				rockchip,pins = <0x01 0x0b 0x02 0x111>;
				phandle = <0xb5>;
			};

			pdmm0-sdi1 {
				rockchip,pins = <0x01 0x0a 0x03 0x111>;
				phandle = <0xb6>;
			};

			pdmm0-sdi2 {
				rockchip,pins = <0x01 0x09 0x03 0x111>;
				phandle = <0xb7>;
			};

			pdmm0-sdi3 {
				rockchip,pins = <0x01 0x08 0x03 0x111>;
				phandle = <0xb8>;
			};
		};

		pmic {

			pmic_int {
				rockchip,pins = <0x00 0x03 0x00 0x113>;
				phandle = <0x36>;
			};

			soc_slppin_gpio {
				rockchip,pins = <0x00 0x02 0x00 0x117>;
				phandle = <0x39>;
			};

			soc_slppin_slp {
				rockchip,pins = <0x00 0x02 0x01 0x111>;
				phandle = <0x37>;
			};

			soc_slppin_rst {
				rockchip,pins = <0x00 0x02 0x02 0x111>;
				phandle = <0x1d6>;
			};
		};

		pwm0 {

			pwm0m0-pins {
				rockchip,pins = <0x00 0x0f 0x01 0x111>;
				phandle = <0x41>;
			};
		};

		pwm1 {

			pwm1m0-pins {
				rockchip,pins = <0x00 0x10 0x01 0x111>;
				phandle = <0x42>;
			};
		};

		pwm2 {

			pwm2m0-pins {
				rockchip,pins = <0x00 0x11 0x01 0x111>;
				phandle = <0x43>;
			};
		};

		pwm3 {

			pwm3-pins {
				rockchip,pins = <0x00 0x12 0x01 0x111>;
				phandle = <0x44>;
			};
		};

		pwm4 {

			pwm4-pins {
				rockchip,pins = <0x00 0x13 0x01 0x111>;
				phandle = <0xec>;
			};
		};

		pwm5 {

			pwm5-pins {
				rockchip,pins = <0x00 0x14 0x01 0x111>;
				phandle = <0xed>;
			};
		};

		pwm6 {

			pwm6-pins {
				rockchip,pins = <0x00 0x15 0x01 0x111>;
				phandle = <0xee>;
			};
		};

		pwm7 {

			pwm7-pins {
				rockchip,pins = <0x00 0x16 0x01 0x111>;
				phandle = <0xef>;
			};
		};

		pwm8 {

			pwm8m0-pins {
				rockchip,pins = <0x03 0x09 0x05 0x111>;
				phandle = <0xf0>;
			};
		};

		pwm9 {

			pwm9m0-pins {
				rockchip,pins = <0x03 0x0a 0x05 0x111>;
				phandle = <0xf1>;
			};
		};

		pwm10 {

			pwm10m0-pins {
				rockchip,pins = <0x03 0x0d 0x05 0x111>;
				phandle = <0xf2>;
			};
		};

		pwm11 {

			pwm11m0-pins {
				rockchip,pins = <0x03 0x0e 0x05 0x111>;
				phandle = <0xf3>;
			};
		};

		pwm12 {

			pwm12m0-pins {
				rockchip,pins = <0x03 0x0f 0x02 0x111>;
				phandle = <0xf4>;
			};
		};

		pwm13 {

			pwm13m0-pins {
				rockchip,pins = <0x03 0x10 0x02 0x111>;
				phandle = <0xf5>;
			};
		};

		pwm14 {

			pwm14m0-pins {
				rockchip,pins = <0x03 0x14 0x01 0x111>;
				phandle = <0xf6>;
			};
		};

		pwm15 {

			pwm15m0-pins {
				rockchip,pins = <0x03 0x15 0x01 0x111>;
				phandle = <0xf7>;
			};
		};

		scr {

			scr-pins {
				rockchip,pins = <0x01 0x02 0x03 0x111 0x01 0x07 0x03 0x113 0x01 0x03 0x03 0x113 0x01 0x05 0x03 0x111>;
				phandle = <0xbb>;
			};
		};

		sdmmc0 {

			sdmmc0-bus4 {
				rockchip,pins = <0x01 0x1d 0x01 0x112 0x01 0x1e 0x01 0x112 0x01 0x1f 0x01 0x112 0x02 0x00 0x01 0x112>;
				phandle = <0x9e>;
			};

			sdmmc0-clk {
				rockchip,pins = <0x02 0x02 0x01 0x112>;
				phandle = <0x9f>;
			};

			sdmmc0-cmd {
				rockchip,pins = <0x02 0x01 0x01 0x112>;
				phandle = <0xa0>;
			};

			sdmmc0-det {
				rockchip,pins = <0x00 0x04 0x01 0x113>;
				phandle = <0xa1>;
			};
		};

		sdmmc1 {

			sdmmc1-bus4 {
				rockchip,pins = <0x02 0x03 0x01 0x112 0x02 0x04 0x01 0x112 0x02 0x05 0x01 0x112 0x02 0x06 0x01 0x112>;
				phandle = <0xa3>;
			};

			sdmmc1-clk {
				rockchip,pins = <0x02 0x08 0x01 0x112>;
				phandle = <0xa5>;
			};

			sdmmc1-cmd {
				rockchip,pins = <0x02 0x07 0x01 0x112>;
				phandle = <0xa4>;
			};
		};

		spdif {

			spdifm0-tx {
				rockchip,pins = <0x01 0x04 0x04 0x111>;
				phandle = <0xb9>;
			};
		};

		spi0 {

			spi0m0-pins {
				rockchip,pins = <0x00 0x0d 0x02 0x111 0x00 0x15 0x02 0x111 0x00 0x0e 0x02 0x111>;
				phandle = <0xd4>;
			};

			spi0m0-cs0 {
				rockchip,pins = <0x00 0x16 0x02 0x111>;
				phandle = <0xd2>;
			};

			spi0m0-cs1 {
				rockchip,pins = <0x00 0x14 0x02 0x111>;
				phandle = <0xd3>;
			};
		};

		spi1 {

			spi1m0-pins {
				rockchip,pins = <0x02 0x0d 0x03 0x111 0x02 0x0e 0x03 0x111 0x02 0x0f 0x04 0x111>;
				phandle = <0xd8>;
			};

			spi1m0-cs0 {
				rockchip,pins = <0x02 0x10 0x04 0x111>;
				phandle = <0xd6>;
			};

			spi1m0-cs1 {
				rockchip,pins = <0x02 0x16 0x03 0x111>;
				phandle = <0xd7>;
			};
		};

		spi2 {

			spi2m0-pins {
				rockchip,pins = <0x02 0x11 0x04 0x111 0x02 0x12 0x04 0x111 0x02 0x13 0x04 0x111>;
				phandle = <0xdc>;
			};

			spi2m0-cs0 {
				rockchip,pins = <0x02 0x14 0x04 0x111>;
				phandle = <0xda>;
			};

			spi2m0-cs1 {
				rockchip,pins = <0x02 0x15 0x04 0x111>;
				phandle = <0xdb>;
			};
		};

		spi3 {

			spi3m0-pins {
				rockchip,pins = <0x04 0x0b 0x04 0x111 0x04 0x08 0x04 0x111 0x04 0x0a 0x04 0x111>;
				phandle = <0xe0>;
			};

			spi3m0-cs0 {
				rockchip,pins = <0x04 0x06 0x04 0x111>;
				phandle = <0xde>;
			};

			spi3m0-cs1 {
				rockchip,pins = <0x04 0x07 0x04 0x111>;
				phandle = <0xdf>;
			};
		};

		tsadc {

			tsadc-shutorg {
				rockchip,pins = <0x00 0x01 0x02 0x111>;
				phandle = <0xf9>;
			};
		};

		uart0 {

			uart0-xfer {
				rockchip,pins = <0x00 0x10 0x03 0x113 0x00 0x11 0x03 0x113>;
				phandle = <0x40>;
			};
		};

		uart1 {

			uart1m0-xfer {
				rockchip,pins = <0x02 0x0b 0x02 0x113 0x02 0x0c 0x02 0x113>;
				phandle = <0xe2>;
			};

			uart1m0-ctsn {
				rockchip,pins = <0x02 0x0e 0x02 0x111>;
				phandle = <0xe3>;
			};

			uart1m0-rtsn {
				rockchip,pins = <0x02 0x0d 0x02 0x111>;
				phandle = <0x12a>;
			};
		};

		uart2 {

			uart2m0-xfer {
				rockchip,pins = <0x00 0x18 0x01 0x113 0x00 0x19 0x01 0x113>;
				phandle = <0xe4>;
			};
		};

		uart3 {

			uart3m0-xfer {
				rockchip,pins = <0x01 0x00 0x02 0x113 0x01 0x01 0x02 0x113>;
				phandle = <0xe5>;
			};
		};

		uart4 {

			uart4m0-xfer {
				rockchip,pins = <0x01 0x04 0x02 0x113 0x01 0x06 0x02 0x113>;
				phandle = <0xe6>;
			};
		};

		uart5 {

			uart5m0-xfer {
				rockchip,pins = <0x02 0x01 0x03 0x113 0x02 0x02 0x03 0x113>;
				phandle = <0xe7>;
			};
		};

		uart6 {

			uart6m0-xfer {
				rockchip,pins = <0x02 0x03 0x03 0x113 0x02 0x04 0x03 0x113>;
				phandle = <0xe8>;
			};
		};

		uart7 {

			uart7m0-xfer {
				rockchip,pins = <0x02 0x05 0x03 0x113 0x02 0x06 0x03 0x113>;
				phandle = <0xe9>;
			};
		};

		uart8 {

			uart8m0-xfer {
				rockchip,pins = <0x02 0x16 0x02 0x113 0x02 0x15 0x03 0x113>;
				phandle = <0xea>;
			};
		};

		uart9 {

			uart9m0-xfer {
				rockchip,pins = <0x02 0x07 0x03 0x113 0x02 0x08 0x03 0x113>;
				phandle = <0xeb>;
			};
		};

		spi0-hs {

			spi0m0-pins {
				rockchip,pins = <0x00 0x0d 0x02 0x118 0x00 0x15 0x02 0x118 0x00 0x0e 0x02 0x118>;
				phandle = <0xd5>;
			};
		};

		spi1-hs {

			spi1m0-pins {
				rockchip,pins = <0x02 0x0d 0x03 0x118 0x02 0x0e 0x03 0x118 0x02 0x0f 0x04 0x118>;
				phandle = <0xd9>;
			};
		};

		spi2-hs {

			spi2m0-pins {
				rockchip,pins = <0x02 0x11 0x04 0x118 0x02 0x12 0x04 0x118 0x02 0x13 0x04 0x118>;
				phandle = <0xdd>;
			};
		};

		spi3-hs {

			spi3m0-pins {
				rockchip,pins = <0x04 0x0b 0x04 0x118 0x04 0x08 0x04 0x118 0x04 0x0a 0x04 0x118>;
				phandle = <0xe1>;
			};
		};

		gpio-func {

			tsadc-gpio-func {
				rockchip,pins = <0x00 0x01 0x00 0x111>;
				phandle = <0xf8>;
			};
		};

		tp {

			tp-gpio {
				rockchip,pins = <0x00 0x08 0x00 0x113 0x00 0x12 0x00 0x111>;
				phandle = <0xbd>;
			};
		};

		headphone {

			hp-det {
				rockchip,pins = <0x03 0x01 0x00 0x11a>;
				phandle = <0x123>;
			};
		};

		lcd {

			lcd-rst-gpio {
				rockchip,pins = <0x03 0x13 0x00 0x111>;
				phandle = <0x8b>;
			};

			lcd-enable-gpio {
				rockchip,pins = <0x03 0x09 0x00 0x111>;
				phandle = <0x8a>;
			};
		};

		sensor {

			sensor-gpio {
				rockchip,pins = <0x03 0x02 0x00 0x111>;
				phandle = <0xbe>;
			};
		};

		sdio-pwrseq {

			wifi-enable-h {
				rockchip,pins = <0x00 0x10 0x00 0x111>;
				phandle = <0x125>;
			};

			wifi-vbat {
				rockchip,pins = <0x00 0x00 0x00 0x111>;
				phandle = <0x126>;
			};
		};

		vcc_sd {

			vcc-sd-h {
				rockchip,pins = <0x00 0x05 0x00 0x111>;
				phandle = <0x127>;
			};
		};

		wireless-wlan {

			wifi-host-wake-irq {
				rockchip,pins = <0x00 0x14 0x00 0x11a>;
				phandle = <0x128>;
			};
		};

		wireless-bluetooth {

			uart1-gpios {
				rockchip,pins = <0x02 0x0d 0x00 0x111>;
				phandle = <0x12b>;
			};

			bt-reset-gpio {
				rockchip,pins = <0x00 0x11 0x00 0x11a>;
				phandle = <0x12c>;
			};

			bt-wake-gpio {
				rockchip,pins = <0x00 0x13 0x00 0x11a>;
				phandle = <0x12d>;
			};

			bt-irq-gpio {
				rockchip,pins = <0x00 0x0f 0x00 0x11a>;
				phandle = <0x12e>;
			};
		};
	};

	chosen {
		bootargs = "earlycon=uart8250,mmio32,0xfe660000 console=ttyFIQ0";
		phandle = <0x1d7>;
	};

	fiq-debugger {
		compatible = "rockchip,fiq-debugger";
		rockchip,serial-id = <0x02>;
		rockchip,wake-irq = <0x00>;
		rockchip,irq-mode-enable = <0x01>;
		rockchip,baudrate = <0x16e360>;
		interrupts = <0x00 0xfc 0x08>;
		pinctrl-names = "default";
		pinctrl-0 = <0xe4>;
		status = "okay";
	};

	debug@fd904000 {
		compatible = "rockchip,debug";
		reg = <0x00 0xfd904000 0x00 0x1000 0x00 0xfd905000 0x00 0x1000 0x00 0xfd906000 0x00 0x1000 0x00 0xfd907000 0x00 0x1000>;
		phandle = <0x1d8>;
	};

	cspmu@fd90c000 {
		compatible = "rockchip,cspmu";
		reg = <0x00 0xfd90c000 0x00 0x1000 0x00 0xfd90d000 0x00 0x1000 0x00 0xfd90e000 0x00 0x1000 0x00 0xfd90f000 0x00 0x1000>;
		phandle = <0x1d9>;
	};

	adc-keys {
		compatible = "adc-keys";
		io-channels = <0x11b 0x00>;
		io-channel-names = "buttons";
		keyup-threshold-microvolt = <0x1b7740>;
		poll-interval = <0x64>;
		phandle = <0x1da>;

		vol-up-key {
			label = "volume up";
			linux,code = <0x73>;
			press-threshold-microvolt = <0xcb20>;
		};

		vol-down-key {
			label = "volume down";
			linux,code = <0x72>;
			press-threshold-microvolt = <0x6b2d8>;
		};
	};

	backlight {
		compatible = "pwm-backlight";
		pwms = <0x11c 0x00 0x61a8 0x00>;
		brightness-levels = <0x00 0x14 0x14 0x15 0x15 0x16 0x16 0x17 0x17 0x18 0x18 0x19 0x19 0x1a 0x1a 0x1b 0x1b 0x1c 0x1c 0x1d 0x1d 0x1e 0x1e 0x1f 0x1f 0x20 0x20 0x21 0x21 0x22 0x22 0x23 0x23 0x24 0x24 0x25 0x25 0x26 0x26 0x27 0x28 0x29 0x2a 0x2b 0x2c 0x2d 0x2e 0x2f 0x30 0x31 0x32 0x33 0x34 0x35 0x36 0x37 0x38 0x39 0x3a 0x3b 0x3c 0x3d 0x3e 0x3f 0x40 0x41 0x42 0x43 0x44 0x45 0x46 0x47 0x48 0x49 0x4a 0x4b 0x4c 0x4d 0x4e 0x4f 0x50 0x51 0x52 0x53 0x54 0x55 0x56 0x57 0x58 0x59 0x5a 0x5b 0x5c 0x5d 0x5e 0x5f 0x60 0x61 0x62 0x63 0x64 0x65 0x66 0x67 0x68 0x69 0x6a 0x6b 0x6c 0x6d 0x6e 0x6f 0x70 0x71 0x72 0x73 0x74 0x75 0x76 0x77 0x78 0x79 0x7a 0x7b 0x7c 0x7d 0x7e 0x7f 0x80 0x81 0x82 0x83 0x84 0x85 0x86 0x87 0x88 0x89 0x8a 0x8b 0x8c 0x8d 0x8e 0x8f 0x90 0x91 0x92 0x93 0x94 0x95 0x96 0x97 0x98 0x99 0x9a 0x9b 0x9c 0x9d 0x9e 0x9f 0xa0 0xa1 0xa2 0xa3 0xa4 0xa5 0xa6 0xa7 0xa8 0xa9 0xaa 0xab 0xac 0xad 0xae 0xaf 0xb0 0xb1 0xb2 0xb3 0xb4 0xb5 0xb6 0xb7 0xb8 0xb9 0xba 0xbb 0xbc 0xbd 0xbe 0xbf 0xc0 0xc1 0xc2 0xc3 0xc4 0xc5 0xc6 0xc7 0xc8 0xc9 0xca 0xcb 0xcc 0xcd 0xce 0xcf 0xd0 0xd1 0xd2 0xd3 0xd4 0xd5 0xd6 0xd7 0xd8 0xd9 0xda 0xdb 0xdc 0xdd 0xde 0xdf 0xe0 0xe1 0xe2 0xe3 0xe4 0xe5 0xe6 0xe7 0xe8 0xe9 0xea 0xeb 0xec 0xed 0xee 0xef 0xf0 0xf1 0xf2 0xf3 0xf4 0xf5 0xf6 0xf7 0xf8 0xf9 0xfa 0xfb 0xfc 0xfd 0xfe 0xff>;
		default-brightness-level = <0xa0>;
		phandle = <0x89>;
	};

	charge-animation {
		compatible = "rockchip,uboot-charge";
		rockchip,uboot-charge-on = <0x00>;
		rockchip,android-charge-on = <0x01>;
		rockchip,uboot-low-power-voltage = <0xd16>;
		rockchip,screen-on-voltage = <0xd48>;
		status = "okay";
	};

	flash-rgb13h {
		status = "okay";
		compatible = "led,rgb13h";
		label = "gpio-flash";
		pinctrl-names = "default";
		pinctrl-0 = <0x11d>;
		led-max-microamp = <0x4e20>;
		flash-max-microamp = <0x4e20>;
		flash-max-timeout-us = <0xf4240>;
		enable-gpio = <0xc0 0x06 0x00>;
		rockchip,camera-module-index = <0x00>;
		rockchip,camera-module-facing = "back";
		phandle = <0xc7>;
	};

	hdmi-sound {
		compatible = "simple-audio-card";
		simple-audio-card,format = "i2s";
		simple-audio-card,mclk-fs = <0x80>;
		simple-audio-card,name = "rockchip,hdmi";
		status = "okay";
		phandle = <0x1db>;

		simple-audio-card,cpu {
			sound-dai = <0x11e>;
		};

		simple-audio-card,codec {
			sound-dai = <0x11f>;
		};
	};

	vccsys {
		compatible = "regulator-fixed";
		regulator-name = "vcc3v8_sys";
		regulator-always-on;
		regulator-boot-on;
		regulator-min-microvolt = <0x39fbc0>;
		regulator-max-microvolt = <0x39fbc0>;
		phandle = <0x34>;
	};

	vcc-camera-regulator {
		compatible = "regulator-fixed";
		gpio = <0xc0 0x07 0x00>;
		pinctrl-names = "default";
		pinctrl-0 = <0x120>;
		regulator-name = "vcc_camera";
		enable-active-high;
		regulator-always-on;
		regulator-boot-on;
		phandle = <0x1dc>;
	};

	rk817-sound {
		compatible = "simple-audio-card";
		simple-audio-card,format = "i2s";
		simple-audio-card,name = "rockchip,rk817-codec";
		simple-audio-card,mclk-fs = <0x100>;

		simple-audio-card,cpu {
			sound-dai = <0x121>;
		};

		simple-audio-card,codec {
			sound-dai = <0x122>;
		};
	};

	rk-headset {
		compatible = "rockchip_headset";
		headset_gpio = <0x3e 0x01 0x01>;
		pinctrl-names = "default";
		pinctrl-0 = <0x123>;
		io-channels = <0x11b 0x02>;
		phandle = <0x1dd>;
	};

	sdio-pwrseq {
		compatible = "mmc-pwrseq-simple";
		clocks = <0x124 0x01>;
		clock-names = "ext_clock";
		pinctrl-names = "default";
		pinctrl-0 = <0x125 0x126>;
		vbat-gpios = <0x35 0x00 0x01>;
		reset-gpios = <0x35 0x10 0x01>;
		phandle = <0xa2>;
	};

	vcc-sd {
		compatible = "regulator-gpio";
		enable-active-low;
		enable-gpio = <0x35 0x05 0x01>;
		regulator-min-microvolt = <0x325aa0>;
		regulator-max-microvolt = <0x325aa0>;
		pinctrl-names = "default";
		pinctrl-0 = <0x127>;
		regulator-name = "vcc_sd";
		states = <0x325aa0 0x00 0x325aa0 0x01>;
		phandle = <0x9d>;
	};

	wireless-wlan {
		compatible = "wlan-platdata";
		rockchip,grf = <0x31>;
		wifi_chip_type = "rtl8723cs";
		pinctrl-names = "default";
		pinctrl-0 = <0x128>;
		WIFI,host_wake_irq = <0x35 0x14 0x00>;
		status = "okay";
	};

	wireless-bluetooth {
		compatible = "bluetooth-platdata";
		clocks = <0x124 0x01>;
		clock-names = "ext_clock";
		uart_rts_gpios = <0x129 0x0d 0x01>;
		pinctrl-names = "default", "rts_gpio";
		pinctrl-0 = <0x12a>;
		pinctrl-1 = <0x12b 0x12c 0x12d 0x12e>;
		BT,reset_gpio = <0x35 0x11 0x00>;
		BT,wake_gpio = <0x35 0x13 0x00>;
		BT,wake_host_irq = <0x35 0x0f 0x00>;
		status = "okay";
	};

	__symbols__ {
		ddr_timing = "/ddr_timing";
		cpu0 = "/cpus/cpu@0";
		cpu1 = "/cpus/cpu@100";
		cpu2 = "/cpus/cpu@200";
		cpu3 = "/cpus/cpu@300";
		CPU_SLEEP = "/cpus/idle-states/cpu-sleep";
		cpu0_opp_table = "/cpu0-opp-table";
		display_subsystem = "/display-subsystem";
		route_dsi0 = "/display-subsystem/route/route-dsi0";
		route_dsi1 = "/display-subsystem/route/route-dsi1";
		route_edp = "/display-subsystem/route/route-edp";
		route_hdmi = "/display-subsystem/route/route-hdmi";
		route_lvds = "/display-subsystem/route/route-lvds";
		route_rgb = "/display-subsystem/route/route-rgb";
		optee = "/firmware/optee";
		scmi = "/firmware/scmi";
		scmi_clk = "/firmware/scmi/protocol@14";
		sdei = "/firmware/sdei";
		mpp_srv = "/mpp-srv";
		reserved_memory = "/reserved-memory";
		drm_logo = "/reserved-memory/drm-logo@00000000";
		drm_cubic_lut = "/reserved-memory/drm-cubic-lut@00000000";
		ramoops = "/reserved-memory/ramoops@110000";
		rockchip_suspend = "/rockchip-suspend";
		rockchip_system_monitor = "/rockchip-system-monitor";
		thermal_zones = "/thermal-zones";
		soc_thermal = "/thermal-zones/soc-thermal";
		threshold = "/thermal-zones/soc-thermal/trips/trip-point-0";
		target = "/thermal-zones/soc-thermal/trips/trip-point-1";
		soc_crit = "/thermal-zones/soc-thermal/trips/soc-crit";
		gpu_thermal = "/thermal-zones/gpu-thermal";
		gmac1_clkin = "/external-gmac1-clock";
		gmac1_xpcsclk = "/xpcs-gmac1-clock";
		i2s1_mclkin_rx = "/i2s1-mclkin-rx";
		i2s1_mclkin_tx = "/i2s1-mclkin-tx";
		i2s2_mclkin = "/i2s2-mclkin";
		i2s3_mclkin = "/i2s3-mclkin";
		mpll = "/mpll";
		xin24m = "/xin24m";
		scmi_shmem = "/scmi-shmem@10f000";
		sata1 = "/sata@fc400000";
		sata2 = "/sata@fc800000";
		usbdrd30 = "/usbdrd";
		usbdrd_dwc3 = "/usbdrd/dwc3@fcc00000";
		usbhost30 = "/usbhost";
		usbhost_dwc3 = "/usbhost/dwc3@fd000000";
		gic = "/interrupt-controller@fd400000";
		its = "/interrupt-controller@fd400000/interrupt-controller@fd440000";
		usb_host0_ehci = "/usb@fd800000";
		usb_host0_ohci = "/usb@fd840000";
		usb_host1_ehci = "/usb@fd880000";
		usb_host1_ohci = "/usb@fd8c0000";
		xpcs = "/syscon@fda00000";
		pmugrf = "/syscon@fdc20000";
		pmu_io_domains = "/syscon@fdc20000/io-domains";
		reboot_mode = "/syscon@fdc20000/reboot-mode";
		pipegrf = "/syscon@fdc50000";
		grf = "/syscon@fdc60000";
		io_domains = "/syscon@fdc60000/io-domains";
		lvds = "/syscon@fdc60000/lvds";
		lvds_in_vp1 = "/syscon@fdc60000/lvds/ports/port@0/endpoint@1";
		lvds_in_vp2 = "/syscon@fdc60000/lvds/ports/port@0/endpoint@2";
		rgb = "/syscon@fdc60000/rgb";
		rgb_in_vp2 = "/syscon@fdc60000/rgb/ports/port@0/endpoint@2";
		pipe_phy_grf0 = "/syscon@fdc70000";
		pipe_phy_grf1 = "/syscon@fdc80000";
		pipe_phy_grf2 = "/syscon@fdc90000";
		usb2phy0_grf = "/syscon@fdca0000";
		usb2phy1_grf = "/syscon@fdca8000";
		edp_phy = "/edp-phy@fdcb0000";
		sram = "/sram@fdcc0000";
		rkvdec_sram = "/sram@fdcc0000/rkvdec-sram@0";
		pmucru = "/clock-controller@fdd00000";
		cru = "/clock-controller@fdd20000";
		i2c0 = "/i2c@fdd40000";
		tcs4525 = "/i2c@fdd40000/tcs4525@1c";
		tcs4526 = "/i2c@fdd40000/tcs4526@10";
		xz3215 = "/i2c@fdd40000/xz3215@60";
		vdd_cpu_1 = "/i2c@fdd40000/xz3215@60/regulators/regulator@0";
		vdd_cpu_b = "/i2c@fdd40000/syr837@40";
		rk817 = "/i2c@fdd40000/pmic@20";
		pinctrl_rk8xx = "/i2c@fdd40000/pmic@20/pinctrl_rk8xx";
		rk817_slppin_null = "/i2c@fdd40000/pmic@20/pinctrl_rk8xx/rk817_slppin_null";
		rk817_slppin_slp = "/i2c@fdd40000/pmic@20/pinctrl_rk8xx/rk817_slppin_slp";
		rk817_slppin_pwrdn = "/i2c@fdd40000/pmic@20/pinctrl_rk8xx/rk817_slppin_pwrdn";
		rk817_slppin_rst = "/i2c@fdd40000/pmic@20/pinctrl_rk8xx/rk817_slppin_rst";
		vdd_logic = "/i2c@fdd40000/pmic@20/regulators/DCDC_REG1";
		vdd_gpu = "/i2c@fdd40000/pmic@20/regulators/DCDC_REG2";
		vcc_ddr = "/i2c@fdd40000/pmic@20/regulators/DCDC_REG3";
		vcc_3v3 = "/i2c@fdd40000/pmic@20/regulators/DCDC_REG4";
		vcca1v8_pmu = "/i2c@fdd40000/pmic@20/regulators/LDO_REG1";
		vdda_0v9 = "/i2c@fdd40000/pmic@20/regulators/LDO_REG2";
		vdda0v9_pmu = "/i2c@fdd40000/pmic@20/regulators/LDO_REG3";
		vccio_acodec = "/i2c@fdd40000/pmic@20/regulators/LDO_REG4";
		vccio_sd = "/i2c@fdd40000/pmic@20/regulators/LDO_REG5";
		vcc3v3_pmu = "/i2c@fdd40000/pmic@20/regulators/LDO_REG6";
		vcc_1v8 = "/i2c@fdd40000/pmic@20/regulators/LDO_REG7";
		vcc1v8_dvp = "/i2c@fdd40000/pmic@20/regulators/LDO_REG8";
		vcc2v8_dvp = "/i2c@fdd40000/pmic@20/regulators/LDO_REG9";
		dcdc_boost = "/i2c@fdd40000/pmic@20/regulators/BOOST";
		otg_switch = "/i2c@fdd40000/pmic@20/regulators/OTG_SWITCH";
		rk817_codec = "/i2c@fdd40000/pmic@20/codec";
		uart0 = "/serial@fdd50000";
		pwm0 = "/pwm@fdd70000";
		pwm1 = "/pwm@fdd70010";
		pwm2 = "/pwm@fdd70020";
		pwm3 = "/pwm@fdd70030";
		pmu = "/power-management@fdd90000";
		power = "/power-management@fdd90000/power-controller";
		rknpu = "/npu@fde40000";
		npu_opp_table = "/npu-opp-table";
		bus_npu = "/bus-npu";
		bus_npu_opp_table = "/bus-npu-opp-table";
		rknpu_mmu = "/iommu@fde4b000";
		gpu = "/gpu@fde60000";
		gpu_power_model = "/gpu@fde60000/power-model";
		gpu_opp_table = "/opp-table2";
		vdpu = "/vdpu@fdea0400";
		vdpu_mmu = "/iommu@fdea0800";
		rk_rga = "/rk_rga@fdeb0000";
		ebc = "/ebc@fdec0000";
		jpegd = "/jpegd@fded0000";
		jpegd_mmu = "/iommu@fded0480";
		vepu = "/vepu@fdee0000";
		vepu_mmu = "/iommu@fdee0800";
		iep = "/iep@fdef0000";
		iep_mmu = "/iommu@fdef0800";
		eink = "/eink@fdf00000";
		rkvenc = "/rkvenc@fdf40000";
		rkvenc_opp_table = "/rkvenc-opp-table";
		rkvenc_mmu = "/iommu@fdf40f00";
		rkvdec = "/rkvdec@fdf80200";
		rkvdec_mmu = "/iommu@fdf80800";
		mipi_csi2 = "/mipi-csi2@fdfb0000";
		rkcif = "/rkcif@fdfe0000";
		rkcif_mmu = "/iommu@fdfe0800";
		rkcif_dvp = "/rkcif_dvp";
		rkcif_dvp_sditf = "/rkcif_dvp_sditf";
		rkcif_mipi_lvds = "/rkcif_mipi_lvds";
		rkcif_mipi_lvds_sditf = "/rkcif_mipi_lvds_sditf";
		rkisp = "/rkisp@fdff0000";
		rkisp_mmu = "/iommu@fdff1a00";
		rkisp_vir0 = "/rkisp-vir0";
		isp_in0 = "/rkisp-vir0/port/endpoint@0";
		isp_in1 = "/rkisp-vir0/port/endpoint@1";
		isp_in2 = "/rkisp-vir0/port/endpoint@2";
		rkisp_vir1 = "/rkisp-vir1";
		gmac1 = "/ethernet@fe010000";
		mdio1 = "/ethernet@fe010000/mdio";
		gmac1_stmmac_axi_setup = "/ethernet@fe010000/stmmac-axi-config";
		gmac1_mtl_rx_setup = "/ethernet@fe010000/rx-queues-config";
		gmac1_mtl_tx_setup = "/ethernet@fe010000/tx-queues-config";
		vop = "/vop@fe040000";
		vop_out = "/vop@fe040000/ports";
		vp0 = "/vop@fe040000/ports/port@0";
		vp0_out_dsi0 = "/vop@fe040000/ports/port@0/endpoint@0";
		vp0_out_dsi1 = "/vop@fe040000/ports/port@0/endpoint@1";
		vp0_out_edp = "/vop@fe040000/ports/port@0/endpoint@2";
		vp0_out_hdmi = "/vop@fe040000/ports/port@0/endpoint@3";
		vp1 = "/vop@fe040000/ports/port@1";
		vp1_out_dsi0 = "/vop@fe040000/ports/port@1/endpoint@0";
		vp1_out_dsi1 = "/vop@fe040000/ports/port@1/endpoint@1";
		vp1_out_edp = "/vop@fe040000/ports/port@1/endpoint@2";
		vp1_out_hdmi = "/vop@fe040000/ports/port@1/endpoint@3";
		vp1_out_lvds = "/vop@fe040000/ports/port@1/endpoint@4";
		vp2 = "/vop@fe040000/ports/port@2";
		vp2_out_lvds = "/vop@fe040000/ports/port@2/endpoint@0";
		vp2_out_rgb = "/vop@fe040000/ports/port@2/endpoint@1";
		vop_mmu = "/iommu@fe043e00";
		dsi0 = "/dsi@fe060000";
		dsi0_in = "/dsi@fe060000/ports/port@0";
		dsi0_in_vp0 = "/dsi@fe060000/ports/port@0/endpoint@0";
		dsi0_in_vp1 = "/dsi@fe060000/ports/port@0/endpoint@1";
		dsi_out_panel = "/dsi@fe060000/ports/port@1/endpoint";
		timing0 = "/dsi@fe060000/panel@0/display-timings/timing0";
		timing1 = "/dsi@fe060000/panel@0/display-timings/timing1";
		timing2 = "/dsi@fe060000/panel@0/display-timings/timing2";
		panel_in_dsi = "/dsi@fe060000/panel@0/ports/port@0/endpoint";
		dsi1 = "/dsi@fe070000";
		dsi1_in = "/dsi@fe070000/ports/port@0";
		dsi1_in_vp0 = "/dsi@fe070000/ports/port@0/endpoint@0";
		dsi1_in_vp1 = "/dsi@fe070000/ports/port@0/endpoint@1";
		hdmi = "/hdmi@fe0a0000";
		hdmi_in = "/hdmi@fe0a0000/ports/port";
		hdmi_in_vp0 = "/hdmi@fe0a0000/ports/port/endpoint@0";
		hdmi_in_vp1 = "/hdmi@fe0a0000/ports/port/endpoint@1";
		edp = "/edp@fe0c0000";
		edp_in = "/edp@fe0c0000/ports/port@0";
		edp_in_vp0 = "/edp@fe0c0000/ports/port@0/endpoint@0";
		edp_in_vp1 = "/edp@fe0c0000/ports/port@0/endpoint@1";
		qos_gpu = "/qos@fe128000";
		qos_rkvenc_rd_m0 = "/qos@fe138080";
		qos_rkvenc_rd_m1 = "/qos@fe138100";
		qos_rkvenc_wr_m0 = "/qos@fe138180";
		qos_isp = "/qos@fe148000";
		qos_vicap0 = "/qos@fe148080";
		qos_vicap1 = "/qos@fe148100";
		qos_vpu = "/qos@fe150000";
		qos_ebc = "/qos@fe158000";
		qos_iep = "/qos@fe158100";
		qos_jpeg_dec = "/qos@fe158180";
		qos_jpeg_enc = "/qos@fe158200";
		qos_rga_rd = "/qos@fe158280";
		qos_rga_wr = "/qos@fe158300";
		qos_npu = "/qos@fe180000";
		qos_pcie2x1 = "/qos@fe190000";
		qos_sata1 = "/qos@fe190280";
		qos_sata2 = "/qos@fe190300";
		qos_usb3_0 = "/qos@fe190380";
		qos_usb3_1 = "/qos@fe190400";
		qos_rkvdec = "/qos@fe198000";
		qos_hdcp = "/qos@fe1a8000";
		qos_vop_m0 = "/qos@fe1a8080";
		qos_vop_m1 = "/qos@fe1a8100";
		sdmmc2 = "/dwmmc@fe000000";
		dfi = "/dfi@fe230000";
		dmc = "/dmc";
		dmc_opp_table = "/dmc-opp-table";
		pcie2x1 = "/pcie@fe260000";
		pcie2x1_intc = "/pcie@fe260000/legacy-interrupt-controller";
		sdmmc0 = "/dwmmc@fe2b0000";
		sdmmc1 = "/dwmmc@fe2c0000";
		sfc = "/sfc@fe300000";
		sdhci = "/sdhci@fe310000";
		nandc0 = "/nandc@fe330000";
		crypto = "/crypto@fe380000";
		rng = "/rng@fe388000";
		otp = "/otp@fe38c000";
		cpu_code = "/otp@fe38c000/cpu-code@2";
		otp_cpu_version = "/otp@fe38c000/cpu-version@8";
		mbist_vmin = "/otp@fe38c000/mbist-vmin@9";
		otp_id = "/otp@fe38c000/id@a";
		cpu_leakage = "/otp@fe38c000/cpu-leakage@1a";
		log_leakage = "/otp@fe38c000/log-leakage@1b";
		npu_leakage = "/otp@fe38c000/npu-leakage@1c";
		gpu_leakage = "/otp@fe38c000/gpu-leakage@1d";
		core_pvtm = "/otp@fe38c000/core-pvtm@2a";
		i2s0_8ch = "/i2s@fe400000";
		i2s1_8ch = "/i2s@fe410000";
		i2s2_2ch = "/i2s@fe420000";
		i2s3_2ch = "/i2s@fe430000";
		pdm = "/pdm@fe440000";
		vad = "/vad@fe450000";
		spdif_8ch = "/spdif@fe460000";
		audpwm = "/audpwm@fe470000";
		dig_acodec = "/codec-digital@fe478000";
		dmac0 = "/dmac@fe530000";
		dmac1 = "/dmac@fe550000";
		scr = "/rkscr@fe560000";
		can0 = "/can@fe570000";
		can1 = "/can@fe580000";
		can2 = "/can@fe590000";
		i2c1 = "/i2c@fe5a0000";
		i2c2 = "/i2c@fe5b0000";
		dw9714 = "/i2c@fe5b0000/dw9714@c";
		gc02m1 = "/i2c@fe5b0000/gc02m1@37";
		gc02m1_out = "/i2c@fe5b0000/gc02m1@37/port/endpoint";
		gc02m2 = "/i2c@fe5b0000/gc02m2@37";
		gc02m2_out = "/i2c@fe5b0000/gc02m2@37/port/endpoint";
		gc02m3 = "/i2c@fe5b0000/gc02m3@37";
		gc02m3_out = "/i2c@fe5b0000/gc02m3@37/port/endpoint";
		gc5035 = "/i2c@fe5b0000/gc5035@37";
		gc5035_out = "/i2c@fe5b0000/gc5035@37/port/endpoint";
		sp250a = "/i2c@fe5b0000/sp250a@3c";
		sp250a_out = "/i2c@fe5b0000/sp250a@3c/port/endpoint";
		ov5670 = "/i2c@fe5b0000/ov5670@36";
		ov5670_out = "/i2c@fe5b0000/ov5670@36/port/endpoint";
		hi556 = "/i2c@fe5b0000/hi556@20";
		hi556_out = "/i2c@fe5b0000/hi556@20/port/endpoint";
		gc5025 = "/i2c@fe5b0000/gc5025@37";
		gc5025_out = "/i2c@fe5b0000/gc5025@37/port/endpoint";
		gc8034 = "/i2c@fe5b0000/gc8034@37";
		gc8034_out = "/i2c@fe5b0000/gc8034@37/port/endpoint";
		ov8858 = "/i2c@fe5b0000/ov8858@36";
		ov8858_out = "/i2c@fe5b0000/ov8858@36/port/endpoint";
		hi846 = "/i2c@fe5b0000/hi846@20";
		hi846_out = "/i2c@fe5b0000/hi846@20/port/endpoint";
		ov5648 = "/i2c@fe5b0000/ov5648@36";
		ov5648_out = "/i2c@fe5b0000/ov5648@36/port/endpoint";
		i2c3 = "/i2c@fe5c0000";
		i2c4 = "/i2c@fe5d0000";
		i2c5 = "/i2c@fe5e0000";
		rktimer = "/timer@fe5f0000";
		wdt = "/watchdog@fe600000";
		spi0 = "/spi@fe610000";
		spi1 = "/spi@fe620000";
		spi2 = "/spi@fe630000";
		spi3 = "/spi@fe640000";
		uart1 = "/serial@fe650000";
		uart2 = "/serial@fe660000";
		uart3 = "/serial@fe670000";
		uart4 = "/serial@fe680000";
		uart5 = "/serial@fe690000";
		uart6 = "/serial@fe6a0000";
		uart7 = "/serial@fe6b0000";
		uart8 = "/serial@fe6c0000";
		uart9 = "/serial@fe6d0000";
		pwm4 = "/pwm@fe6e0000";
		pwm5 = "/pwm@fe6e0010";
		pwm6 = "/pwm@fe6e0020";
		pwm7 = "/pwm@fe6e0030";
		pwm8 = "/pwm@fe6f0000";
		pwm9 = "/pwm@fe6f0010";
		pwm10 = "/pwm@fe6f0020";
		pwm11 = "/pwm@fe6f0030";
		pwm12 = "/pwm@fe700000";
		pwm13 = "/pwm@fe700010";
		pwm14 = "/pwm@fe700020";
		pwm15 = "/pwm@fe700030";
		tsadc = "/tsadc@fe710000";
		saradc = "/saradc@fe720000";
		mailbox = "/mailbox@fe780000";
		combphy1_usq = "/phy@fe830000";
		combphy2_psq = "/phy@fe840000";
		video_phy0 = "/video-phy@fe850000";
		video_phy1 = "/video-phy@fe860000";
		csi2_dphy_hw = "/csi2-dphy-hw@fe870000";
		csi2_dphy0 = "/csi2-dphy0";
		mipi_in_ucam5 = "/csi2-dphy0/ports/port@0/endpoint@2";
		dphy0_out = "/csi2-dphy0/ports/port@1/endpoint@0";
		csi2_dphy1 = "/csi2-dphy1";
		mipi_in_ucam1 = "/csi2-dphy1/ports/port@0/endpoint@1";
		mipi_in_ucam3 = "/csi2-dphy1/ports/port@0/endpoint@2";
		mipi_in_ucam4 = "/csi2-dphy1/ports/port@0/endpoint@4";
		mipi_in_gc8034 = "/csi2-dphy1/ports/port@0/endpoint@5";
		mipi_in_hi846 = "/csi2-dphy1/ports/port@0/endpoint@6";
		mipi_in_ov5648 = "/csi2-dphy1/ports/port@0/endpoint@7";
		mipi_in_ov8858 = "/csi2-dphy1/ports/port@0/endpoint@8";
		mipi_in_gc02m3 = "/csi2-dphy1/ports/port@0/endpoint@9";
		dphy1_out = "/csi2-dphy1/ports/port@1/endpoint@1";
		csi2_dphy2 = "/csi2-dphy2";
		mipi_in_ucam0 = "/csi2-dphy2/ports/port@0/endpoint@1";
		mipi_in_ucam2 = "/csi2-dphy2/ports/port@0/endpoint@0";
		mipi_in_gc5025 = "/csi2-dphy2/ports/port@0/endpoint@2";
		mipi_in_gc02m1 = "/csi2-dphy2/ports/port@0/endpoint@3";
		dphy2_out = "/csi2-dphy2/ports/port@1/endpoint@1";
		usb2phy0 = "/usb2-phy@fe8a0000";
		u2phy0_host = "/usb2-phy@fe8a0000/host-port";
		u2phy0_otg = "/usb2-phy@fe8a0000/otg-port";
		usb2phy1 = "/usb2-phy@fe8b0000";
		u2phy1_host = "/usb2-phy@fe8b0000/host-port";
		u2phy1_otg = "/usb2-phy@fe8b0000/otg-port";
		pinctrl = "/pinctrl";
		gpio0 = "/pinctrl/gpio@fdd60000";
		gpio1 = "/pinctrl/gpio@fe740000";
		gpio2 = "/pinctrl/gpio@fe750000";
		gpio3 = "/pinctrl/gpio@fe760000";
		gpio4 = "/pinctrl/gpio@fe770000";
		pcfg_pull_up = "/pinctrl/pcfg-pull-up";
		pcfg_pull_down = "/pinctrl/pcfg-pull-down";
		pcfg_pull_none = "/pinctrl/pcfg-pull-none";
		pcfg_pull_none_drv_level_1 = "/pinctrl/pcfg-pull-none-drv-level-1";
		pcfg_pull_none_drv_level_2 = "/pinctrl/pcfg-pull-none-drv-level-2";
		pcfg_pull_none_drv_level_3 = "/pinctrl/pcfg-pull-none-drv-level-3";
		pcfg_pull_up_drv_level_1 = "/pinctrl/pcfg-pull-up-drv-level-1";
		pcfg_pull_up_drv_level_2 = "/pinctrl/pcfg-pull-up-drv-level-2";
		pcfg_pull_none_smt = "/pinctrl/pcfg-pull-none-smt";
		pcfg_output_low = "/pinctrl/pcfg-output-low";
		acodec_pins = "/pinctrl/acodec/acodec-pins";
		camera_rst = "/pinctrl/cam/camera-rst";
		camera_af_en = "/pinctrl/cam/camera-af";
		flash_led_gpios = "/pinctrl/cam/flash-led";
		cif_clk = "/pinctrl/cif/cif-clk";
		ebc_pins = "/pinctrl/ebc/ebc-pins";
		hdmitxm0_cec = "/pinctrl/hdmitx/hdmitxm0-cec";
		hdmitx_scl = "/pinctrl/hdmitx/hdmitx-scl";
		hdmitx_sda = "/pinctrl/hdmitx/hdmitx-sda";
		i2c0_xfer = "/pinctrl/i2c0/i2c0-xfer";
		i2c1_xfer = "/pinctrl/i2c1/i2c1-xfer";
		i2c2m1_xfer = "/pinctrl/i2c2/i2c2m1-xfer";
		i2c3m0_xfer = "/pinctrl/i2c3/i2c3m0-xfer";
		i2c4m0_xfer = "/pinctrl/i2c4/i2c4m0-xfer";
		i2c5m0_xfer = "/pinctrl/i2c5/i2c5m0-xfer";
		i2s1m0_lrcktx = "/pinctrl/i2s1/i2s1m0-lrcktx";
		i2s1m0_mclk = "/pinctrl/i2s1/i2s1m0-mclk";
		i2s1m0_sclktx = "/pinctrl/i2s1/i2s1m0-sclktx";
		i2s1m0_sdi0 = "/pinctrl/i2s1/i2s1m0-sdi0";
		i2s1m0_sdo0 = "/pinctrl/i2s1/i2s1m0-sdo0";
		i2s2m0_lrcktx = "/pinctrl/i2s2/i2s2m0-lrcktx";
		i2s2m0_sclktx = "/pinctrl/i2s2/i2s2m0-sclktx";
		i2s2m0_sdi = "/pinctrl/i2s2/i2s2m0-sdi";
		i2s2m0_sdo = "/pinctrl/i2s2/i2s2m0-sdo";
		i2s3m0_lrck = "/pinctrl/i2s3/i2s3m0-lrck";
		i2s3m0_sclk = "/pinctrl/i2s3/i2s3m0-sclk";
		i2s3m0_sdi = "/pinctrl/i2s3/i2s3m0-sdi";
		i2s3m0_sdo = "/pinctrl/i2s3/i2s3m0-sdo";
		lcdc_ctl = "/pinctrl/lcdc/lcdc-ctl";
		pdmm0_clk = "/pinctrl/pdm/pdmm0-clk";
		pdmm0_clk1 = "/pinctrl/pdm/pdmm0-clk1";
		pdmm0_sdi0 = "/pinctrl/pdm/pdmm0-sdi0";
		pdmm0_sdi1 = "/pinctrl/pdm/pdmm0-sdi1";
		pdmm0_sdi2 = "/pinctrl/pdm/pdmm0-sdi2";
		pdmm0_sdi3 = "/pinctrl/pdm/pdmm0-sdi3";
		pmic_int = "/pinctrl/pmic/pmic_int";
		soc_slppin_gpio = "/pinctrl/pmic/soc_slppin_gpio";
		soc_slppin_slp = "/pinctrl/pmic/soc_slppin_slp";
		soc_slppin_rst = "/pinctrl/pmic/soc_slppin_rst";
		pwm0m0_pins = "/pinctrl/pwm0/pwm0m0-pins";
		pwm1m0_pins = "/pinctrl/pwm1/pwm1m0-pins";
		pwm2m0_pins = "/pinctrl/pwm2/pwm2m0-pins";
		pwm3_pins = "/pinctrl/pwm3/pwm3-pins";
		pwm4_pins = "/pinctrl/pwm4/pwm4-pins";
		pwm5_pins = "/pinctrl/pwm5/pwm5-pins";
		pwm6_pins = "/pinctrl/pwm6/pwm6-pins";
		pwm7_pins = "/pinctrl/pwm7/pwm7-pins";
		pwm8m0_pins = "/pinctrl/pwm8/pwm8m0-pins";
		pwm9m0_pins = "/pinctrl/pwm9/pwm9m0-pins";
		pwm10m0_pins = "/pinctrl/pwm10/pwm10m0-pins";
		pwm11m0_pins = "/pinctrl/pwm11/pwm11m0-pins";
		pwm12m0_pins = "/pinctrl/pwm12/pwm12m0-pins";
		pwm13m0_pins = "/pinctrl/pwm13/pwm13m0-pins";
		pwm14m0_pins = "/pinctrl/pwm14/pwm14m0-pins";
		pwm15m0_pins = "/pinctrl/pwm15/pwm15m0-pins";
		scr_pins = "/pinctrl/scr/scr-pins";
		sdmmc0_bus4 = "/pinctrl/sdmmc0/sdmmc0-bus4";
		sdmmc0_clk = "/pinctrl/sdmmc0/sdmmc0-clk";
		sdmmc0_cmd = "/pinctrl/sdmmc0/sdmmc0-cmd";
		sdmmc0_det = "/pinctrl/sdmmc0/sdmmc0-det";
		sdmmc1_bus4 = "/pinctrl/sdmmc1/sdmmc1-bus4";
		sdmmc1_clk = "/pinctrl/sdmmc1/sdmmc1-clk";
		sdmmc1_cmd = "/pinctrl/sdmmc1/sdmmc1-cmd";
		spdifm0_tx = "/pinctrl/spdif/spdifm0-tx";
		spi0m0_pins = "/pinctrl/spi0/spi0m0-pins";
		spi0m0_cs0 = "/pinctrl/spi0/spi0m0-cs0";
		spi0m0_cs1 = "/pinctrl/spi0/spi0m0-cs1";
		spi1m0_pins = "/pinctrl/spi1/spi1m0-pins";
		spi1m0_cs0 = "/pinctrl/spi1/spi1m0-cs0";
		spi1m0_cs1 = "/pinctrl/spi1/spi1m0-cs1";
		spi2m0_pins = "/pinctrl/spi2/spi2m0-pins";
		spi2m0_cs0 = "/pinctrl/spi2/spi2m0-cs0";
		spi2m0_cs1 = "/pinctrl/spi2/spi2m0-cs1";
		spi3m0_pins = "/pinctrl/spi3/spi3m0-pins";
		spi3m0_cs0 = "/pinctrl/spi3/spi3m0-cs0";
		spi3m0_cs1 = "/pinctrl/spi3/spi3m0-cs1";
		tsadc_shutorg = "/pinctrl/tsadc/tsadc-shutorg";
		uart0_xfer = "/pinctrl/uart0/uart0-xfer";
		uart1m0_xfer = "/pinctrl/uart1/uart1m0-xfer";
		uart1m0_ctsn = "/pinctrl/uart1/uart1m0-ctsn";
		uart1m0_rtsn = "/pinctrl/uart1/uart1m0-rtsn";
		uart2m0_xfer = "/pinctrl/uart2/uart2m0-xfer";
		uart3m0_xfer = "/pinctrl/uart3/uart3m0-xfer";
		uart4m0_xfer = "/pinctrl/uart4/uart4m0-xfer";
		uart5m0_xfer = "/pinctrl/uart5/uart5m0-xfer";
		uart6m0_xfer = "/pinctrl/uart6/uart6m0-xfer";
		uart7m0_xfer = "/pinctrl/uart7/uart7m0-xfer";
		uart8m0_xfer = "/pinctrl/uart8/uart8m0-xfer";
		uart9m0_xfer = "/pinctrl/uart9/uart9m0-xfer";
		spi0m0_pins_hs = "/pinctrl/spi0-hs/spi0m0-pins";
		spi1m0_pins_hs = "/pinctrl/spi1-hs/spi1m0-pins";
		spi2m0_pins_hs = "/pinctrl/spi2-hs/spi2m0-pins";
		spi3m0_pins_hs = "/pinctrl/spi3-hs/spi3m0-pins";
		tsadc_gpio_func = "/pinctrl/gpio-func/tsadc-gpio-func";
		tp_gpio = "/pinctrl/tp/tp-gpio";
		hp_det = "/pinctrl/headphone/hp-det";
		lcd_rst_gpio = "/pinctrl/lcd/lcd-rst-gpio";
		lcd_enable_gpio = "/pinctrl/lcd/lcd-enable-gpio";
		sensor_gpio = "/pinctrl/sensor/sensor-gpio";
		wifi_enable_h = "/pinctrl/sdio-pwrseq/wifi-enable-h";
		wifi_vbat = "/pinctrl/sdio-pwrseq/wifi-vbat";
		vcc_sd_h = "/pinctrl/vcc_sd/vcc-sd-h";
		wifi_host_wake_irq = "/pinctrl/wireless-wlan/wifi-host-wake-irq";
		uart1_gpios = "/pinctrl/wireless-bluetooth/uart1-gpios";
		bt_reset_gpio = "/pinctrl/wireless-bluetooth/bt-reset-gpio";
		bt_wake_gpio = "/pinctrl/wireless-bluetooth/bt-wake-gpio";
		bt_irq_gpio = "/pinctrl/wireless-bluetooth/bt-irq-gpio";
		chosen = "/chosen";
		debug = "/debug@fd904000";
		cspmu = "/cspmu@fd90c000";
		adc_keys = "/adc-keys";
		backlight = "/backlight";
		flash_rgb13h = "/flash-rgb13h";
		hdmi_sound = "/hdmi-sound";
		vccsys = "/vccsys";
		vcc_camera = "/vcc-camera-regulator";
		rk_headset = "/rk-headset";
		sdio_pwrseq = "/sdio-pwrseq";
		vcc_sd = "/vcc-sd";
	};
};
