// SPDX-License-Identifier: GPL-2.0+
#include "rk3399-u-boot.dtsi"

// DRAM
// #include "rk3399-sdram-ddr3-1333.dtsi"
// #include "rk3399-sdram-ddr3-1600.dtsi"
// #include "rk3399-sdram-ddr3-1866.dtsi"
// #include "rk3399-sdram-lpddr3-2GB-1600.dtsi"
// #include "rk3399-sdram-lpddr3-4GB-1600.dtsi"
// #include "rk3399-sdram-lpddr3-samsung-4GB-1866.dtsi"
#include "rk3399-sdram-lpddr4-100.dtsi"

/ {
	chosen {
		u-boot,spl-boot-order = "same-as-spl", &sdhci, &sdmmc;
	};
};

&vdd_log {
	regulator-init-microvolt = <950000>;
};
