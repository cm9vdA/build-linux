// SPDX-License-Identifier: (GPL-2.0+ OR MIT)
/dts-v1/;

#include <dt-bindings/pwm/pwm.h>
#include <dt-bindings/input/input.h>
#include <dt-bindings/usb/pd.h>
#include "rk3399.dtsi"
#include "rk3399-opp.dtsi"
// #include "rk3399-aio.dtsi"

/ {
	model = "AIO On Core-3399J";
	compatible = "rockchip,rk3399";
};